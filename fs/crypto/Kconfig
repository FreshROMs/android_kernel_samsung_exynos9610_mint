## fs/crypto/Kconfig
```kconfig
config FS_ENCRYPTION
	tristate "FS Encryption (Per-file encryption)"
	select CRYPTO
	select CRYPTO_AES
	select CRYPTO_CBC
	select CRYPTO_ECB
	select CRYPTO_XTS
	select CRYPTO_CTS
	select CRYPTO_CTR
	select CRYPTO_SHA256
	select KEYS
	help
	  Enable encryption of files and directories.  This
	  feature is similar to ecryptfs, but it is more memory
	  efficient since it avoids caching the encrypted and
	  decrypted pages in the page cache.

config FS_INLINE_ENCRYPTION
	bool "Enable inline encryption"
	depends on FS_ENCRYPTION
	depends on BLK_DEV_CRYPT
	default y
	help
	  This option enables inline encryption to support inline crypto H/W.

config FSCRYPT_SDP
	bool "Sensitive Data Protection for Per-file-encryption"
	depends on FS_ENCRYPTION
	depends on SDP
	help
	  Enable SDP functional to fscrypto module.
	  This feature is supporting "Data-At-Rest" for file systems using
	  Per-file-encryption being controlled by SDP user status.
```

## kernel/Kconfig.freezer
```kconfig
config FREEZER
	def_bool PM_SLEEP || CGROUP_FREEZER
config OLAF_SUPPORT
	bool "thaw frozen process when recieve sig"
	default n
	help
		thaw frozen process when recieve sig. enable if samsung olaf solution exist
```

## kernel/Kconfig.fresh
```kconfig
config MINT
	def_bool y
	help
	 This is a Mint kernel build. Enabled by default
	 for Mint Kernel trees.

config MINT_SESL
	depends on MINT
	bool "One UI support"
	default n
	help
		Build Mint Kernel components for One UI support

config MINT_PLATFORM_VERSION
	depends on MINT
	int "Android platform version"
	range 9 13
	help
		Android platform version of Mint build
```

## kernel/ftt/Kconfig
```kconfig
config FAST_TRACK
    bool "ftt feature"
    default y
    help
      This option enables ftt feature, which is to reduce vruntime
      and modify some preemption policy.

      Ftt thread also can acquire firstly in case of binder, mutex,
      futex and semaphore.
```

## mm/sec_mm/Kconfig
```kconfig
menu "SEC Memory Management Options"

config SEC_MM
	tristate "Enable SEC MM"
	default y
	help
	  SEC memory management module

endmenu
```

## security/defex_lsm/defex_lsm_1.0/Kconfig
```kconfig
config SECURITY_DEFEX
	bool "Defex Support"
	depends on SECURITY
	default n
	help
	  This selects the Defex support.
	  If you are unsure how to answer this question, answer N.
```

## sound/soc/codecs/dbmdx/Kconfig
```kconfig
#
# DBMDX SoC audio configuration
#
#

# DBMDX SOC enabler.
# .
# y - Enable DSPG VT/VE Chip
# n - Disable DSPG VT/VE Chip
config SND_SOC_DBMDX
	bool "DSPG Voice Trigger/Enhancement Chip"
	default n
	help
		DSPG Voice Trigger/Enhancement Chip
		.
		y - Enable DSPG VT/VE Chip
		n - Disable DSPG VT/VE Chip

# Register DBMDX SOC as a separate sound card.
# .
# y - Register DBMDX SOC as separate sound card
# n - Do not register DBMDX SOC as separate sound card
config SND_SOC_DBMDX_SND_CAPTURE
	bool "DSPG Capture Device Support"
	depends on SND_SOC_DBMDX
	default n
	help
		Register DBMDX SOC as a separate sound card.
		.
		y - Register DBMDX SOC as separate sound card
		n - Do not register DBMDX SOC as separate sound card
```

## sound/soc/samsung/abox/Kconfig
```kconfig
config SND_SOC_SAMSUNG_ABOX
	tristate "ASoC support for Samsung ABOX Audio"
	select REGMAP_MMIO
	select SND_SOC_COMPRESS
	select SND_HWDEP
	help
	  Say Y or M if you want to add support for codecs attached to
	  the Samsung SoC ABOX interface. You will also need to
	  select the audio interfaces to support below.

config SEC_SND_SYNCHRONIZED_IPC
	tristate "Samsung ABOX Synchronized IPC for Audio"
	depends on SND_SOC_SAMSUNG_ABOX
	help
	  Say Y or M if you want to add support for external devices attached to
	  the Samsung SoC ABOX interface. You will also need to
	  select the audio interfaces to support below.

config SEC_SND_SYNCHRONIZED_IPC_RICHTEK
	tristate "Samsung ABOX Synchronized IPC for Audio AMP Richtek"
	depends on SND_SOC_SAMSUNG_ABOX
	help
	  Say Y or M if you want to add support for external devices attached to
	  the Samsung SoC ABOX interface. You will also need to
	  select the audio interfaces to support below.
```
