/dts-v1/;

/ {
	compatible = "samsung, A50S EUR OPEN BRINGUP", "samsung,EXYNOS9611";
	dtbo-hw_rev = <0x0>;
	dtbo-hw_rev_end = <0x0>;

	fragment@modemif {
		target-path = [2f 00];

		__overlay__ {
			#address-cells = <0x2>;
			#size-cells = <0x1>;

			mif_pdata {
				reg = <0x0 0x10000 0x0>;
				compatible = "sec_modem,modem_pdata";
				status = "okay";
				interrupts = <0x0 0x4b 0x0>;
				mif,name = "s337ap";
				mif,modem_net = <0x0>;
				mif,modem_type = <0xa>;
				mif,use_handover = <0x0>;
				mif,ipc_version = <0x32>;
				mif,link_types = <0x200>;
				mif,link_name = "shmem";
				mif,link_attrs = <0x7c9>;
				mif,num_iodevs = <0x16>;
				mif,use_usb_phy = <0x0>;
				mbx_ap2cp_msg = <0x0>;
				mbx_cp2ap_msg = <0x1>;
				mbx_ap2cp_united_status = <0x2>;
				mbx_cp2ap_united_status = <0x3>;
				mbx_ap2cp_mif_value = <0x4>;
				mbx_ap2cp_kerneltime = <0x9>;
				mbx_cp2ap_pcie_l1ss_disable = <0x11>;
				mif,int_ap2cp_msg = <0x0>;
				mif,int_ap2cp_wakeup = <0x1>;
				mif,int_ap2cp_status = <0x2>;
				mif,int_ap2cp_active = <0x3>;
				mif,irq_cp2ap_msg = <0x0>;
				mif,irq_cp2ap_status = <0x2>;
				mif,irq_cp2ap_active = <0x3>;
				mif,irq_cp2ap_wakelock = <0x8>;
				mif,irq_cp2ap_pcie_l1ss_disable = <0x9>;
				mif,int_ap2cp_uart_noti = <0xf>;
				mbx_cp2ap_dvfsreq = <0x4>;
				mbx_cp2ap_dvfsreq_cpu = <0x5>;
				mbx_cp2ap_dvfsreq_mif = <0x6>;
				mbx_cp2ap_dvfsreq_int = <0x7>;
				mif,irq_cp2ap_perf_req_cpu = <0x5>;
				mif,irq_cp2ap_perf_req_mif = <0x6>;
				mif,irq_cp2ap_perf_req_int = <0x7>;
				sbi_cp_rat_mode_mask = <0x3f>;
				sbi_cp_rat_mode_pos = <0x1a>;
				sbi_cp_evs_mode_mask = <0x1>;
				sbi_cp_evs_mode_pos = <0x7>;
				sbi_cp2ap_wakelock_mask = <0x1>;
				sbi_cp2ap_wakelock_pos = <0x6>;
				sbi_lte_active_mask = <0x1>;
				sbi_lte_active_pos = <0x5>;
				sbi_cp_status_mask = <0xf>;
				sbi_cp_status_pos = <0x1>;
				sbi_pda_active_mask = <0x1>;
				sbi_pda_active_pos = <0x5>;
				sbi_ap_status_mask = <0xf>;
				sbi_ap_status_pos = <0x1>;
				sbi_crash_type_mask = <0xf>;
				sbi_crash_type_pos = <0x19>;
				sbi_device_type_mask = <0x1f>;
				sbi_device_type_pos = <0x14>;
				sbi_ext_backtrace_mask = <0x1>;
				sbi_ext_backtrace_pos = <0x11>;
				sbi_ds_det_mask = <0x3>;
				sbi_ds_det_pos = <0xe>;
				sbi_sys_rev_mask = <0xff>;
				sbi_sys_rev_pos = <0x6>;
				sbi_lockval_cp2ap_dvfsreq_endian_mask = <0x1>;
				sbi_lockval_cp2ap_dvfsreq_endian_pos = <0x1f>;
				sbi_lockval_cp2ap_dvfsreq_index_mask = <0x7fff>;
				sbi_lockval_cp2ap_dvfsreq_index_pos = <0x0>;
				sbi_ap2cp_kerneltime_sec_mask = <0xfff>;
				sbi_ap2cp_kerneltime_sec_pos = <0x14>;
				sbi_ap2cp_kerneltime_usec_mask = <0xfffff>;
				sbi_ap2cp_kerneltime_usec_pos = <0x0>;
				sbi_uart_noti_mask = <0x1>;
				sbi_uart_noti_pos = <0x10>;

				iodevs {

					io_device_0 {
						iod,name = "umts_cass";
						iod,id = <0x23>;
						iod,format = <0x1>;
						iod,io_type = <0x0>;
						iod,links = <0x200>;
						iod,attrs = <0x82>;
						iod,max_tx_size = <0x800>;
						iod,ul_num_buffers = <0x10>;
						iod,ul_buffer_size = <0x800>;
						iod,dl_num_buffers = <0x10>;
						iod,dl_buffer_size = <0x800>;
					};

					io_device_1 {
						iod,name = "umts_ipc0";
						iod,id = <0xeb>;
						iod,format = <0x0>;
						iod,io_type = <0x0>;
						iod,links = <0x200>;
						iod,attrs = <0x82>;
						iod,app = "RIL";
						iod,ul_num_buffers = <0x10>;
						iod,ul_buffer_size = <0x1000>;
						iod,dl_num_buffers = <0x20>;
						iod,dl_buffer_size = <0x1000>;
					};

					io_device_2 {
						iod,name = "umts_ipc1";
						iod,id = <0xec>;
						iod,format = <0x0>;
						iod,io_type = <0x0>;
						iod,links = <0x200>;
						iod,attrs = <0x82>;
						iod,app = "RIL";
						iod,ul_num_buffers = <0x10>;
						iod,ul_buffer_size = <0x1000>;
						iod,dl_num_buffers = <0x20>;
						iod,dl_buffer_size = <0x1000>;
					};

					io_device_3 {
						iod,name = "umts_rfs0";
						iod,id = <0xf5>;
						iod,format = <0x2>;
						iod,io_type = <0x0>;
						iod,links = <0x200>;
						iod,attrs = <0x82>;
						iod,app = "RFS";
						iod,ul_num_buffers = <0x10>;
						iod,ul_buffer_size = <0x800>;
						iod,dl_num_buffers = <0x200>;
						iod,dl_buffer_size = <0x800>;
					};

					io_device_4 {
						iod,name = "umts_csd";
						iod,id = <0x1>;
						iod,format = <0x1>;
						iod,io_type = <0x0>;
						iod,links = <0x200>;
						iod,attrs = <0x82>;
						iod,app = "CSVT";
						iod,ul_num_buffers = <0x20>;
						iod,ul_buffer_size = <0x800>;
						iod,dl_num_buffers = <0x40>;
						iod,dl_buffer_size = <0x800>;
					};

					io_device_5 {
						iod,name = "umts_router";
						iod,id = <0x19>;
						iod,format = <0x1>;
						iod,io_type = <0x0>;
						iod,links = <0x200>;
						iod,attrs = <0x82>;
						iod,app = "Data Router";
						iod,max_tx_size = <0x60e>;
						iod,ul_num_buffers = <0x10>;
						iod,ul_buffer_size = <0x800>;
						iod,dl_num_buffers = <0x10>;
						iod,dl_buffer_size = <0x800>;
					};

					io_device_6 {
						iod,name = "umts_dm0";
						iod,id = <0x1c>;
						iod,format = <0x1>;
						iod,io_type = <0x0>;
						iod,links = <0x200>;
						iod,attrs = <0x82>;
						iod,app = "DIAG";
						iod,ul_num_buffers = <0x10>;
						iod,ul_buffer_size = <0x800>;
						iod,dl_num_buffers = <0x80>;
						iod,dl_buffer_size = <0x800>;
					};

					io_device_7 {
						iod,name = "rmnet0";
						iod,id = <0xa>;
						iod,format = <0x1>;
						iod,io_type = <0x1>;
						iod,links = <0x200>;
						iod,attrs = <0x180>;
						iod,app = "NET";
						iod,ul_num_buffers = <0x0>;
						iod,ul_buffer_size = <0x800>;
						iod,dl_num_buffers = <0x0>;
						iod,dl_buffer_size = <0x800>;
					};

					io_device_8 {
						iod,name = "rmnet1";
						iod,id = <0xb>;
						iod,format = <0x1>;
						iod,io_type = <0x1>;
						iod,links = <0x200>;
						iod,attrs = <0x180>;
						iod,app = "NET";
						iod,ul_num_buffers = <0x0>;
						iod,ul_buffer_size = <0x800>;
						iod,dl_num_buffers = <0x0>;
						iod,dl_buffer_size = <0x800>;
					};

					io_device_9 {
						iod,name = "rmnet2";
						iod,id = <0xc>;
						iod,format = <0x1>;
						iod,io_type = <0x1>;
						iod,links = <0x200>;
						iod,attrs = <0x180>;
						iod,app = "NET";
						iod,ul_num_buffers = <0x0>;
						iod,ul_buffer_size = <0x800>;
						iod,dl_num_buffers = <0x0>;
						iod,dl_buffer_size = <0x800>;
					};

					io_device_10 {
						iod,name = "rmnet3";
						iod,id = <0xd>;
						iod,format = <0x1>;
						iod,io_type = <0x1>;
						iod,links = <0x200>;
						iod,attrs = <0x180>;
						iod,app = "NET";
						iod,ul_num_buffers = <0x0>;
						iod,ul_buffer_size = <0x800>;
						iod,dl_num_buffers = <0x0>;
						iod,dl_buffer_size = <0x800>;
					};

					io_device_11 {
						iod,name = "rmnet4";
						iod,id = <0xe>;
						iod,format = <0x1>;
						iod,io_type = <0x1>;
						iod,links = <0x200>;
						iod,attrs = <0x180>;
						iod,ul_num_buffers = <0x0>;
						iod,ul_buffer_size = <0x800>;
						iod,dl_num_buffers = <0x0>;
						iod,dl_buffer_size = <0x800>;
					};

					io_device_12 {
						iod,name = "rmnet5";
						iod,id = <0xf>;
						iod,format = <0x1>;
						iod,io_type = <0x1>;
						iod,links = <0x200>;
						iod,attrs = <0x180>;
						iod,ul_num_buffers = <0x0>;
						iod,ul_buffer_size = <0x800>;
						iod,dl_num_buffers = <0x0>;
						iod,dl_buffer_size = <0x800>;
					};

					io_device_13 {
						iod,name = "rmnet6";
						iod,id = <0x10>;
						iod,format = <0x1>;
						iod,io_type = <0x1>;
						iod,links = <0x200>;
						iod,attrs = <0x180>;
						iod,ul_num_buffers = <0x0>;
						iod,ul_buffer_size = <0x800>;
						iod,dl_num_buffers = <0x0>;
						iod,dl_buffer_size = <0x800>;
					};

					io_device_14 {
						iod,name = "rmnet7";
						iod,id = <0x11>;
						iod,format = <0x1>;
						iod,io_type = <0x1>;
						iod,links = <0x200>;
						iod,attrs = <0x180>;
						iod,ul_num_buffers = <0x0>;
						iod,ul_buffer_size = <0x800>;
						iod,dl_num_buffers = <0x0>;
						iod,dl_buffer_size = <0x800>;
					};

					io_device_15 {
						iod,name = "multipdp_hiprio";
						iod,id = <0x0>;
						iod,format = <0x3>;
						iod,io_type = <0x2>;
						iod,links = <0x200>;
						iod,attrs = <0x180>;
						iod,app = "RIL";
						iod,ul_num_buffers = <0x100>;
						iod,ul_buffer_size = <0x800>;
						iod,dl_num_buffers = <0x100>;
						iod,dl_buffer_size = <0x800>;
					};

					io_device_16 {
						iod,name = "multipdp";
						iod,id = <0x0>;
						iod,format = <0x3>;
						iod,io_type = <0x2>;
						iod,links = <0x200>;
						iod,attrs = <0x180>;
						iod,app = "RIL";
						iod,ul_num_buffers = <0x200>;
						iod,ul_buffer_size = <0x800>;
						iod,dl_num_buffers = <0x400>;
						iod,dl_buffer_size = <0x800>;
					};

					io_device_17 {
						iod,name = "umts_boot0";
						iod,id = <0xd7>;
						iod,format = <0x4>;
						iod,io_type = <0x0>;
						iod,links = <0x200>;
						iod,attrs = <0x2>;
						iod,app = "CBD";
					};

					io_device_18 {
						iod,name = "umts_ramdump0";
						iod,id = <0xe1>;
						iod,format = <0x5>;
						iod,io_type = <0x0>;
						iod,links = <0x200>;
						iod,attrs = <0x202>;
						iod,app = "CBD";
					};

					io_device_19 {
						iod,name = "umts_atc0";
						iod,id = <0x20>;
						iod,format = <0x1>;
						iod,io_type = <0x0>;
						iod,links = <0x200>;
						iod,attrs = <0x882>;
						iod,app = "VCD";
						iod,max_tx_size = <0x800>;
						iod,ul_num_buffers = <0x10>;
						iod,ul_buffer_size = <0x800>;
						iod,dl_num_buffers = <0x80>;
						iod,dl_buffer_size = <0x800>;
						iod,option_region = "usa_vzw";
					};

					io_device_20 {
						iod,name = "smd4";
						iod,id = <0x21>;
						iod,format = <0x1>;
						iod,io_type = <0x0>;
						iod,links = <0x200>;
						iod,attrs = <0x882>;
						iod,ul_num_buffers = <0x10>;
						iod,ul_buffer_size = <0x800>;
						iod,dl_num_buffers = <0x80>;
						iod,dl_buffer_size = <0x800>;
						iod,option_region = "kor_single";
					};

					io_device_21 {
						iod,name = "umts_ciq0";
						iod,id = <0x1a>;
						iod,format = <0x1>;
						iod,io_type = <0x0>;
						iod,links = <0x200>;
						iod,attrs = <0x882>;
						iod,ul_num_buffers = <0x10>;
						iod,ul_buffer_size = <0x800>;
						iod,dl_num_buffers = <0x80>;
						iod,dl_buffer_size = <0x800>;
						iod,option_region = "usa_";
					};
				};
			};

			shmem@F0000000 {
				compatible = "samsung,exynos-shm_ipc";
				shmem,cp_size = <0x7900000>;
				shmem,vss_size = <0x700000>;
				shmem,ipc_offset = <0x8000000>;
				shmem,ipc_size = <0x800000>;
				linux,phandle = <0x2a>;
				phandle = <0x2a>;
			};
		};
	};

	fragment@lcd {
		target-path = [2f 00];

		__overlay__ {

			decon_board_ea8076 {
				gpio_pcd = <0xffffffff 0x1 0x1>;
				gpio_err = <0xffffffff 0x1 0x1>;
				gpio_con = <0xffffffff 0x7 0x0>;
				gpio_lcd_rst = <0xffffffff 0x3 0x0>;
				gpio_lcd_en_3p0 = <0xffffffff 0x4 0x0>;
				gpio_lcd_en_1p8 = <0xffffffff 0x2 0x0>;
				linux,phandle = <0x1>;
				phandle = <0x1>;

				dsim_set_panel_power_enable {
					type = "gpio,high", "gpio_lcd_en_1p8", "delay,usleep", "1000", "gpio,high", "gpio_lcd_en_3p0", "delay,usleep", "10000";
				};

				dsim_set_panel_power_disable {
					type = "gpio,low", "gpio_lcd_rst", "delay,usleep", "10000", "gpio,low", "gpio_lcd_en_1p8", "delay,usleep", "5000", "gpio,low", "gpio_lcd_en_3p0", "delay,usleep", "5000";
				};

				dsim_reset_panel {
					type = "gpio,high", "gpio_lcd_rst", "delay,usleep", "1000", "gpio,low", "gpio_lcd_rst", "delay,usleep", "1000", "gpio,high", "gpio_lcd_rst", "delay,usleep", "10000";
				};
			};

			ea8076 {
				mode = <0x2>;
				resolution = <0x438 0x924>;
				size = <0x44 0x93>;
				timing,refresh = <0x3c>;
				timing,h-porch = <0x2 0x2 0x2>;
				timing,v-porch = <0xf 0x3 0x1>;
				timing,dsi-hs-clk = <0x4b0>;
				timing,pmsk = <0x3 0x115 0x1 0x0>;
				timing,dsi-escape-clk = <0x10>;
				update_min = <0x438 0x2>;
				mic_en = <0x0>;
				mic_ratio = <0x0>;
				mic_ver = <0x0>;
				type_of_ddi = <0x1>;
				dsc_en = <0x0>;
				dsc_cnt = <0x0>;
				dsc_slice_num = <0x0>;
				data_lane = <0x4>;
				cmd_underrun_lp_ref = <0x81c>;
				mres_en = <0x0>;
				noncontinuous_clklane = <0x0>;
				decon_board = <0x1>;
				linux,phandle = <0x2>;
				phandle = <0x2>;
			};
		};
	};

	fragment@0 {
		target = <0xffffffff>;

		__overlay__ {
			lcd_info = <0x2>;
		};
	};

	fragment@1 {
		target = <0xffffffff>;

		__overlay__ {
			psr_mode = <0x2>;
			trig_mode = <0x0>;
			dsi_mode = <0x0>;
		};
	};

	fragment@camera {
		target-path = [2f 00];

		__overlay__ {

			fimc-fimc_is_sensor_imx582@1A {
				compatible = "samsung,sensor-module-imx582";
				pinctrl-names = "pin0", "pin1", "pin2", "release";
				pinctrl-0 = <0xffffffff>;
				pinctrl-1 = <0xffffffff>;
				pinctrl-2;
				pinctrl-3;
				id = <0x0>;
				mclk_ch = <0x0>;
				sensor_i2c_ch = <0x1>;
				sensor_i2c_addr = <0x1a>;
				position = <0x0>;
				use_pdaf;
				shared_mclk;
				gpio_mclk = <0xffffffff 0x0 0x1>;
				gpio_reset = <0xffffffff 0x1 0x1>;
				gpio_ldo_en = <0xffffffff 0x0 0x1>;
				status = "okay";
				linux,phandle = <0x2b>;
				phandle = <0x2b>;

				af {
					product_name = <0x13>;
					i2c_addr = <0x18>;
					i2c_ch = <0x5>;
				};

				flash {
					product_name = <0xb>;
				};

				internal_vc {
					vc_list = <0x2 0x2 0x1 0x3 0x4 0x1>;
				};
			};

			fimc-is-flash-gpio@0 {
				compatible = "samsung,sensor-flash-sm5713";
				id = <0x0>;
				status = "okay";
				torch-gpio = <0xffffffff 0x3 0x1>;
				flash-gpio = <0xffffffff 0x6 0x1>;
				linux,phandle = <0x2c>;
				phandle = <0x2c>;
			};

			fimc-is_sensor_gc5035@6E {
				compatible = "samsung,sensor-module-gc5035";
				pinctrl-names = "pin0", "pin1", "pin2", "release";
				pinctrl-0;
				pinctrl-1 = <0xffffffff>;
				pinctrl-2 = <0xffffffff>;
				pinctrl-3;
				position = <0x2>;
				id = <0x2>;
				mclk_ch = <0x0>;
				shared_mclk;
				gpio_mclk = <0xffffffff 0x0 0x1>;
				gpio_reset = <0xffffffff 0x7 0x1>;
				status = "okay";
				linux,phandle = <0x2d>;
				phandle = <0x2d>;
			};

			fimc-is_sensor_4ha@5A {
				compatible = "samsung,sensor-module-4ha";
				pinctrl-names = "pin0", "pin1", "pin2", "release";
				pinctrl-0;
				pinctrl-1 = <0xffffffff>;
				pinctrl-2 = <0xffffffff>;
				pinctrl-3;
				position = <0x4>;
				id = <0x3>;
				mclk_ch = <0x2>;
				gpio_mclk = <0xffffffff 0x2 0x1>;
				gpio_reset = <0xffffffff 0x4 0x1>;
				gpio_cam_a2p8_en = <0xffffffff 0x6 0x1>;
				status = "okay";
				linux,phandle = <0x2e>;
				phandle = <0x2e>;
			};

			fimc-is_sensor_imx616@1A {
				compatible = "samsung,sensor-module-imx616";
				pinctrl-names = "pin0", "pin1", "pin2", "release";
				pinctrl-0;
				pinctrl-1 = <0xffffffff>;
				pinctrl-2 = <0xffffffff>;
				pinctrl-3;
				position = <0x1>;
				id = <0x1>;
				mclk_ch = <0x1>;
				sensor_i2c_ch = <0x0>;
				gpio_mclk = <0xffffffff 0x1 0x1>;
				gpio_reset = <0xffffffff 0x7 0x1>;
				status = "okay";
				linux,phandle = <0x2f>;
				phandle = <0x2f>;
			};
		};
	};

	fragment@2 {
		target = <0xffffffff>;

		__overlay__ {
			pinctrl-names = "default", "release";
			pinctrl-0 = <0xffffffff 0xffffffff 0xffffffff>;
			pinctrl-1;

			vender {
				rear_sensor_id = <0x78>;
				front_sensor_id = <0x79>;
				rear2_sensor_id = <0xd2>;
				rear3_sensor_id = <0x27>;
				need_i2c_config;
				use_module_check;
				check_sensor_vendor;
				max_supported_camera = <0x5>;
				supported_cameraId = <0x0 0x1 0x17 0x32 0x34>;
				max_camera_num = <0x4>;

				camera_info0 {
					isp = <0x0>;
					cal_memory = <0x2>;
					read_version = <0x0>;
					core_voltage = <0x0>;
					upgrade = <0x0>;
					companion = <0x0>;
					ois = <0x0>;
					valid = <0x1>;
					dual_open = <0x0>;
					position = <0x0>;
				};

				camera_info1 {
					isp = <0x0>;
					cal_memory = <0x2>;
					read_version = <0x0>;
					core_voltage = <0x0>;
					upgrade = <0x0>;
					companion = <0x0>;
					ois = <0x0>;
					valid = <0x1>;
					dual_open = <0x0>;
					position = <0x1>;
				};

				camera_info2 {
					isp = <0x0>;
					cal_memory = <0x2>;
					read_version = <0x0>;
					core_voltage = <0x0>;
					upgrade = <0x0>;
					companion = <0x0>;
					ois = <0x0>;
					valid = <0x1>;
					dual_open = <0x1>;
					position = <0x2>;
				};

				camera_info3 {
					isp = <0x0>;
					cal_memory = <0x2>;
					read_version = <0x0>;
					core_voltage = <0x0>;
					upgrade = <0x0>;
					companion = <0x0>;
					ois = <0x0>;
					valid = <0x1>;
					dual_open = <0x0>;
					position = <0x4>;
				};
			};

			fimc_is_dvfs {

				table0 {
					desc = "dvfs table v0.0 for 48M/32M";
					default_int_cam = <0xa8750>;
					default_cam = <0xa8750>;
					default_mif = <0x1fefc8>;
					default_int = <0x186a0>;
					default_hpg = <0x1>;
					front_preview_int_cam = <0xa1220>;
					front_preview_cam = <0xa6040>;
					front_preview_mif = <0x14a140>;
					front_preview_int = <0x186a0>;
					front_preview_hpg = <0x1>;
					front_preview_full_int_cam = <0xa6040>;
					front_preview_full_cam = <0xa6040>;
					front_preview_full_mif = <0x1b5fd0>;
					front_preview_full_int = <0x186a0>;
					front_preview_full_hpg = <0x1>;
					front_preview_remosaic_int_cam = <0xa6040>;
					front_preview_remosaic_cam = <0xa8750>;
					front_preview_remosaic_mif = <0x1fefc8>;
					front_preview_remosaic_int = <0x186a0>;
					front_preview_remosaic_hpg = <0x1>;
					front_capture_int_cam = <0xa6040>;
					front_capture_cam = <0xa6040>;
					front_capture_mif = <0x1fefc8>;
					front_capture_int = <0x186a0>;
					front_capture_hpg = <0x1>;
					front_capture_remosaic_int_cam = <0xa6040>;
					front_capture_remosaic_cam = <0xa8750>;
					front_capture_remosaic_mif = <0x1fefc8>;
					front_capture_remosaic_int = <0x186a0>;
					front_capture_remosaic_hpg = <0x1>;
					front_video_int_cam = <0xa1220>;
					front_video_cam = <0xa6040>;
					front_video_mif = <0x14a140>;
					front_video_int = <0x186a0>;
					front_video_hpg = <0x1>;
					front_video_capture_int_cam = <0xa3930>;
					front_video_capture_cam = <0xa6040>;
					front_video_capture_mif = <0x1b5fd0>;
					front_video_capture_int = <0x186a0>;
					front_video_capture_hpg = <0x1>;
					front_vt1_int_cam = <0xa1220>;
					front_vt1_cam = <0xa6040>;
					front_vt1_mif = <0xf78f0>;
					front_vt1_int = <0x186a0>;
					front_vt1_hpg = <0x1>;
					front_vt2_int_cam = <0xa1220>;
					front_vt2_cam = <0xa6040>;
					front_vt2_mif = <0xf78f0>;
					front_vt2_int = <0x186a0>;
					front_vt2_hpg = <0x1>;
					front_vt4_int_cam = <0xa1220>;
					front_vt4_cam = <0xa6040>;
					front_vt4_mif = <0xf78f0>;
					front_vt4_int = <0x186a0>;
					front_vt4_hpg = <0x1>;
					front_video_high_speed_120fps_int_cam = <0xa8750>;
					front_video_high_speed_120fps_cam = <0xa8750>;
					front_video_high_speed_120fps_mif = <0x1fefc8>;
					front_video_high_speed_120fps_int = <0xa2d78>;
					front_video_high_speed_120fps_hpg = <0x1>;
					rear2_preview_fhd_int_cam = <0xa1220>;
					rear2_preview_fhd_cam = <0x9eb10>;
					rear2_preview_fhd_mif = <0x14a140>;
					rear2_preview_fhd_int = <0x186a0>;
					rear2_preview_fhd_hpg = <0x1>;
					rear2_capture_int_cam = <0xa1220>;
					rear2_capture_cam = <0xa1220>;
					rear2_capture_mif = <0x177bb8>;
					rear2_capture_int = <0x186a0>;
					rear2_capture_hpg = <0x1>;
					rear3_preview_int_cam = <0xa1220>;
					rear3_preview_cam = <0xa1220>;
					rear3_preview_mif = <0x14a140>;
					rear3_preview_int = <0x186a0>;
					rear3_preview_hpg = <0x1>;
					rear3_capture_int_cam = <0xa1220>;
					rear3_capture_cam = <0xa1220>;
					rear3_capture_mif = <0x177bb8>;
					rear3_capture_int = <0x186a0>;
					rear3_capture_hpg = <0x1>;
					rear3_video_int_cam = <0xa1220>;
					rear3_video_cam = <0xa1220>;
					rear3_video_mif = <0x14a140>;
					rear3_video_int = <0x186a0>;
					rear3_video_hpg = <0x1>;
					rear3_video_capture_int_cam = <0xa1220>;
					rear3_video_capture_cam = <0xa1220>;
					rear3_video_capture_mif = <0x177bb8>;
					rear3_video_capture_int = <0x186a0>;
					rear3_video_capture_hpg = <0x1>;
					rear_preview_fhd_int_cam = <0xa3930>;
					rear_preview_fhd_cam = <0xa6040>;
					rear_preview_fhd_mif = <0x1fefc8>;
					rear_preview_fhd_int = <0x186a0>;
					rear_preview_fhd_hpg = <0x1>;
					rear_preview_hd_int_cam = <0xa3930>;
					rear_preview_hd_cam = <0xa6040>;
					rear_preview_hd_mif = <0x14a140>;
					rear_preview_hd_int = <0x186a0>;
					rear_preview_hd_hpg = <0x1>;
					rear_preview_uhd_int_cam = <0xa6040>;
					rear_preview_uhd_cam = <0xa6040>;
					rear_preview_uhd_mif = <0x177bb8>;
					rear_preview_uhd_int = <0x186a0>;
					rear_preview_uhd_hpg = <0x1>;
					rear_preview_full_int_cam = <0xa6040>;
					rear_preview_full_cam = <0xa6040>;
					rear_preview_full_mif = <0x1b5fd0>;
					rear_preview_full_int = <0x186a0>;
					rear_preview_full_hpg = <0x1>;
					rear_preview_remosaic_int_cam = <0xa6040>;
					rear_preview_remosaic_cam = <0xa8750>;
					rear_preview_remosaic_mif = <0x1fefc8>;
					rear_preview_remosaic_int = <0x186a0>;
					rear_preview_remosaic_hpg = <0x1>;
					rear_capture_int_cam = <0xa6040>;
					rear_capture_cam = <0xa6040>;
					rear_capture_mif = <0x1b5fd0>;
					rear_capture_int = <0x186a0>;
					rear_capture_hpg = <0x1>;
					rear_capture_remosaic_int_cam = <0xa6040>;
					rear_capture_remosaic_cam = <0xa8750>;
					rear_capture_remosaic_mif = <0x1fefc8>;
					rear_capture_remosaic_int = <0x186a0>;
					rear_capture_remosaic_hpg = <0x1>;
					rear_video_fhd_int_cam = <0xa3930>;
					rear_video_fhd_cam = <0xa6040>;
					rear_video_fhd_mif = <0x14a140>;
					rear_video_fhd_int = <0x186a0>;
					rear_video_fhd_hpg = <0x1>;
					rear_video_hd_int_cam = <0xa1220>;
					rear_video_hd_cam = <0xa6040>;
					rear_video_hd_mif = <0x14a140>;
					rear_video_hd_int = <0x186a0>;
					rear_video_hd_hpg = <0x1>;
					rear_video_uhd_int_cam = <0xa3930>;
					rear_video_uhd_cam = <0xa6040>;
					rear_video_uhd_mif = <0x177bb8>;
					rear_video_uhd_int = <0x186a0>;
					rear_video_uhd_hpg = <0x1>;
					rear_video_fhd_capture_int_cam = <0xa3930>;
					rear_video_fhd_capture_cam = <0xa6040>;
					rear_video_fhd_capture_mif = <0x177bb8>;
					rear_video_fhd_capture_int = <0x186a0>;
					rear_video_fhd_capture_hpg = <0x1>;
					rear_video_hd_capture_int_cam = <0xa3930>;
					rear_video_hd_capture_cam = <0xa6040>;
					rear_video_hd_capture_mif = <0x177bb8>;
					rear_video_hd_capture_int = <0x186a0>;
					rear_video_hd_capture_hpg = <0x1>;
					rear_video_uhd_capture_int_cam = <0xa6040>;
					rear_video_uhd_capture_cam = <0xa6040>;
					rear_video_uhd_capture_mif = <0x1b5fd0>;
					rear_video_uhd_capture_int = <0x186a0>;
					rear_video_uhd_capture_hpg = <0x1>;
					dual_preview_int_cam = <0xa1220>;
					dual_preview_cam = <0xa6040>;
					dual_preview_mif = <0x14a140>;
					dual_preview_int = <0x186a0>;
					dual_preview_hpg = <0x1>;
					dual_capture_int_cam = <0xa6040>;
					dual_capture_cam = <0xa6040>;
					dual_capture_mif = <0x1b5fd0>;
					dual_capture_int = <0x186a0>;
					dual_capture_hpg = <0x1>;
					dual_video_fhd_int_cam = <0xa1220>;
					dual_video_fhd_cam = <0xa6040>;
					dual_video_fhd_mif = <0x14a140>;
					dual_video_fhd_int = <0x186a0>;
					dual_video_fhd_hpg = <0x1>;
					dual_video_fhd_capture_int_cam = <0xa3930>;
					dual_video_fhd_capture_cam = <0xa6040>;
					dual_video_fhd_capture_mif = <0x177bb8>;
					dual_video_fhd_capture_int = <0x186a0>;
					dual_video_fhd_capture_hpg = <0x1>;
					dual_video_uhd_int_cam = <0xa3930>;
					dual_video_uhd_cam = <0xa6040>;
					dual_video_uhd_mif = <0x177bb8>;
					dual_video_uhd_int = <0x186a0>;
					dual_video_uhd_hpg = <0x1>;
					dual_video_uhd_capture_int_cam = <0xa6040>;
					dual_video_uhd_capture_cam = <0xa6040>;
					dual_video_uhd_capture_mif = <0x1b5fd0>;
					dual_video_uhd_capture_int = <0x186a0>;
					dual_video_uhd_capture_hpg = <0x1>;
					dual_sync_preview_int_cam = <0xa3930>;
					dual_sync_preview_cam = <0xa6040>;
					dual_sync_preview_mif = <0x177bb8>;
					dual_sync_preview_int = <0x186a0>;
					dual_sync_preview_hpg = <0x1>;
					dual_sync_capture_int_cam = <0xa6040>;
					dual_sync_capture_cam = <0xa6040>;
					dual_sync_capture_mif = <0x1e8c50>;
					dual_sync_capture_int = <0x186a0>;
					dual_sync_capture_hpg = <0x1>;
					dual_sync_preview_whd_int_cam = <0xa6040>;
					dual_sync_preview_whd_cam = <0xa6040>;
					dual_sync_preview_whd_mif = <0x177bb8>;
					dual_sync_preview_whd_int = <0x186a0>;
					dual_sync_preview_whd_hpg = <0x1>;
					dual_sync_whd_capture_int_cam = <0xa6040>;
					dual_sync_whd_capture_cam = <0xa6040>;
					dual_sync_whd_capture_mif = <0x1e8c50>;
					dual_sync_whd_capture_int = <0x186a0>;
					dual_sync_whd_capture_hpg = <0x1>;
					dual_sync_video_fhd_int_cam = <0xa3930>;
					dual_sync_video_fhd_cam = <0xa6040>;
					dual_sync_video_fhd_mif = <0x177bb8>;
					dual_sync_video_fhd_int = <0x186a0>;
					dual_sync_video_fhd_hpg = <0x1>;
					dual_sync_video_fhd_capture_int_cam = <0xa3930>;
					dual_sync_video_fhd_capture_cam = <0xa6040>;
					dual_sync_video_fhd_capture_mif = <0x1e8c50>;
					dual_sync_video_fhd_capture_int = <0x186a0>;
					dual_sync_video_fhd_capture_hpg = <0x1>;
					dual_sync_video_uhd_int_cam = <0xa6040>;
					dual_sync_video_uhd_cam = <0xa6040>;
					dual_sync_video_uhd_mif = <0x1e8c50>;
					dual_sync_video_uhd_int = <0x186a0>;
					dual_sync_video_uhd_hpg = <0x1>;
					dual_sync_video_uhd_capture_int_cam = <0xa6040>;
					dual_sync_video_uhd_capture_cam = <0xa6040>;
					dual_sync_video_uhd_capture_mif = <0x1e8c50>;
					dual_sync_video_uhd_capture_int = <0x186a0>;
					dual_sync_video_uhd_capture_hpg = <0x1>;
					preview_high_speed_fps_int_cam = <0xa6040>;
					preview_high_speed_fps_cam = <0xa6040>;
					preview_high_speed_fps_mif = <0x1fefc8>;
					preview_high_speed_fps_int = <0x186a0>;
					preview_high_speed_fps_hpg = <0x1>;
					video_high_speed_60fps_int_cam = <0xa6040>;
					video_high_speed_60fps_cam = <0xa6040>;
					video_high_speed_60fps_mif = <0x1fefc8>;
					video_high_speed_60fps_int = <0x186a0>;
					video_high_speed_60fps_hpg = <0x1>;
					video_high_speed_120fps_int_cam = <0xa6040>;
					video_high_speed_120fps_cam = <0xa6040>;
					video_high_speed_120fps_mif = <0x1fefc8>;
					video_high_speed_120fps_int = <0x186a0>;
					video_high_speed_120fps_hpg = <0x1>;
					video_high_speed_240fps_int_cam = <0xa6040>;
					video_high_speed_240fps_cam = <0xa6040>;
					video_high_speed_240fps_mif = <0x1fefc8>;
					video_high_speed_240fps_int = <0x186a0>;
					video_high_speed_240fps_hpg = <0x8>;
					video_high_speed_480fps_int_cam = <0xa8750>;
					video_high_speed_480fps_cam = <0xa8750>;
					video_high_speed_480fps_mif = <0x1fefc8>;
					video_high_speed_480fps_int = <0xa2d78>;
					video_high_speed_480fps_hpg = <0x1>;
					video_high_speed_60fps_capture_int_cam = <0xa8750>;
					video_high_speed_60fps_capture_cam = <0xa8750>;
					video_high_speed_60fps_capture_mif = <0x1fefc8>;
					video_high_speed_60fps_capture_int = <0x186a0>;
					video_high_speed_60fps_capture_hpg = <0x1>;
					ext_front_int_cam = <0xa8750>;
					ext_front_cam = <0xa8750>;
					ext_front_mif = <0x1fefc8>;
					ext_front_int = <0x186a0>;
					ext_front_hpg = <0x1>;
					ext_secure_int_cam = <0xa8750>;
					ext_secure_cam = <0xa8750>;
					ext_secure_mif = <0x1fefc8>;
					ext_secure_int = <0x186a0>;
					ext_secure_hpg = <0x1>;
					max_int_cam = <0xa8750>;
					max_cam = <0xa8750>;
					max_mif = <0x1fefc8>;
					max_int = <0xa2d78>;
					max_hpg = <0x1>;
				};
			};
		};
	};

	fragment@3 {
		target = <0xffffffff>;

		__overlay__ {
			#address-cells = <0x1>;
			#size-cells = <0x0>;
			gpios = <0xffffffff 0x0 0x0 0xffffffff 0x1 0x0>;
			status = "okay";
			clock-frequency = <0xf4240>;
			samsung,reset-before-trans;
			samsung,fast-plus-mode;
			pinctrl-names = "default", "on_i2c", "off_i2c";
			pinctrl-0 = <0xffffffff>;
			pinctrl-1 = <0xffffffff>;
			pinctrl-2 = <0xffffffff>;

			fimc-is-imx616@1A {
				compatible = "samsung,exynos5-fimc-is-cis-imx616";
				reg = <0x1a>;
				id = <0x1>;
				sensor_f_number = <0xc8>;
				setfile = "setB";
				use_initial_ae;
			};
		};
	};

	fragment@4 {
		target = <0xffffffff>;

		__overlay__ {
			#address-cells = <0x1>;
			#size-cells = <0x0>;
			gpios = <0xffffffff 0x2 0x0 0xffffffff 0x3 0x0>;
			status = "okay";
			clock-frequency = <0xf4240>;
			samsung,reset-before-trans;
			samsung,fast-plus-mode;
			pinctrl-names = "default", "on_i2c", "off_i2c";
			pinctrl-0 = <0xffffffff>;
			pinctrl-1 = <0xffffffff>;
			pinctrl-2 = <0xffffffff>;

			fimc-is-imx582@1A {
				compatible = "samsung,exynos5-fimc-is-cis-imx582";
				reg = <0x1a>;
				id = <0x0>;
				sensor_f_number = <0xc8>;
			};
		};
	};

	fragment@5 {
		target = <0xffffffff>;

		__overlay__ {
			#address-cells = <0x1>;
			#size-cells = <0x0>;
			gpios = <0xffffffff 0x4 0x0 0xffffffff 0x5 0x0>;
			status = "okay";
			clock-frequency = <0x61a80>;
			samsung,reset-before-trans;
			pinctrl-names = "default", "on_i2c", "off_i2c";
			pinctrl-0 = <0xffffffff>;
			pinctrl-1 = <0xffffffff>;
			pinctrl-2 = <0xffffffff>;

			fimc-is-gc5035@6E {
				compatible = "samsung,exynos5-fimc-is-cis-gc5035";
				reg = <0x37>;
				id = <0x2>;
				sensor_f_number = <0xdc>;
				setfile = "setB";
				use_initial_ae;
			};
		};
	};

	fragment@6 {
		target = <0xffffffff>;

		__overlay__ {
			#address-cells = <0x1>;
			#size-cells = <0x0>;
			gpios = <0xffffffff 0x6 0x0 0xffffffff 0x7 0x0>;
			status = "okay";
			clock-frequency = <0x61a80>;
			samsung,reset-before-trans;
			pinctrl-names = "default", "on_i2c", "off_i2c";
			pinctrl-0 = <0xffffffff>;
			pinctrl-1 = <0xffffffff>;
			pinctrl-2 = <0xffffffff>;

			fimc-is-4ha@5A {
				compatible = "samsung,exynos5-fimc-is-cis-4ha";
				reg = <0x2d>;
				id = <0x3>;
				sensor_f_number = <0xdc>;
				setfile = "setB";
			};
		};
	};

	fragment@7 {
		target = <0xffffffff>;

		__overlay__ {
			#address-cells = <0x1>;
			#size-cells = <0x0>;
			gpios = <0xffffffff 0x1 0x0 0xffffffff 0x0 0x0>;
			status = "okay";
			clock-frequency = <0x61a80>;
			samsung,reset-before-trans;
			pinctrl-names = "default", "on_i2c", "off_i2c";
			pinctrl-0 = <0xffffffff>;
			pinctrl-1 = <0xffffffff>;
			pinctrl-2 = <0xffffffff>;

			rear3_eeprom@A8 {
				compatible = "samsung,rear3-eeprom-i2c";
				reg = <0x54>;
			};
		};
	};

	fragment@8 {
		target = <0xffffffff>;

		__overlay__ {
			#address-cells = <0x1>;
			#size-cells = <0x0>;
			gpios = <0xffffffff 0x3 0x0 0xffffffff 0x2 0x0>;
			status = "okay";
			clock-frequency = <0x61a80>;
			samsung,reset-before-trans;
			pinctrl-names = "default", "on_i2c", "off_i2c";
			pinctrl-0 = <0xffffffff>;
			pinctrl-1 = <0xffffffff>;
			pinctrl-2 = <0xffffffff>;

			fimc-is-actuator@18 {
				compatible = "samsung,exynos5-fimc-is-actuator-dw9808";
				reg = <0xc>;
				id = <0x0>;
				place = <0x0>;
			};

			rear_eeprom@B0 {
				compatible = "samsung,rear-eeprom-i2c";
				reg = <0x58>;
				use_common_rom_position = <0x2>;
			};

			front_eeprom@A2 {
				compatible = "samsung,front-eeprom-i2c";
				reg = <0x51>;
			};
		};
	};

	fragment@9 {
		target = <0xffffffff>;

		__overlay__ {

			sm5713-fled@49 {
				compatible = "siliconmitus,sm5713-fled";

				sm5713-fled@0 {
					id = <0x0>;
					status = "okay";
					flash-en-gpio = <0xffffffff 0x6 0x0>;
					torch-en-gpio = <0xffffffff 0x3 0x0>;
					flash-brightness = <0xf>;
					preflash-brightness = <0x4>;
					torch-brightness = <0x4>;
					timeout = <0xff>;
				};
			};
		};
	};

	fragment@10 {
		target = <0xffffffff>;

		__overlay__ {
			scenario = <0x0>;
			id = <0x0>;
			csi_ch = <0x0>;
			dma_ch = <0x0 0x0 0x0 0x0 0x0 0x0 0x2 0x0>;
			vc_ch = <0x0 0x1 0x2 0x3 0x0 0x1 0x0 0x3>;
			flite_ch = <0x64>;
			is_bns = <0x0>;
			csi_mux = <0x2>;
			multi_ch = <0x2>;
			camif_mux_val = <0x182077>;
			use_ssvc2_internal;
			use_ssvc3_internal;
			status = "okay";
		};
	};

	fragment@11 {
		target = <0xffffffff>;

		__overlay__ {
			phys = <0xffffffff 0x1>;
			scenario = <0x0>;
			id = <0x2>;
			csi_ch = <0x1>;
			dma_ch = <0x1 0x1 0x1 0x1 0x2 0x2 0x2 0x2>;
			vc_ch = <0x0 0x1 0x2 0x3 0x1 0x2 0x1 0x3>;
			flite_ch = <0x64>;
			is_bns = <0x0>;
			csi_mux = <0x2>;
			multi_ch = <0x2>;
			camif_mux_val = <0x182077>;
			status = "okay";
		};
	};

	fragment@12 {
		target = <0xffffffff>;

		__overlay__ {
			scenario = <0x0>;
			id = <0x1>;
			csi_ch = <0x2>;
			dma_ch = <0x2 0x2 0x2 0x2>;
			vc_ch = <0x0 0x1 0x2 0x3>;
			flite_ch = <0x64>;
			is_bns = <0x0>;
			csi_mux = <0x2>;
			multi_ch = <0x0>;
			camif_mux_val = <0x2077>;
			status = "okay";
		};
	};

	fragment@13 {
		target = <0xffffffff>;

		__overlay__ {
			reg = <0x0 0x14410700 0x100 0x0 0x14410000 0x700>;
			reg-names = "phy", "csi";
			interrupts = <0x0 0x146 0x0 0x0 0x14c 0x0 0x0 0x14c 0x0 0x0 0x14c 0x0 0x0 0x14c 0x0>;
			interrupt-names = "csi", "mode0_VC0", "mode0_VC1", "mode0_VC2", "mode0_VC3";
			phys = <0xffffffff 0x0>;
			scenario = <0x0>;
			id = <0x3>;
			csi_ch = <0x1>;
			dma_ch = <0x1 0x1 0x1 0x1>;
			vc_ch = <0x0 0x1 0x2 0x3>;
			flite_ch = <0x64>;
			is_bns = <0x0>;
			csi_mux = <0x0>;
			multi_ch = <0x2>;
			camif_mux_val = <0x182077>;
			status = "okay";

			sensor3-ch-mode0 {
				reg = <0x14460000 0x100 0x14460400 0x100 0x14460100 0x100 0x14460400 0x100 0x14460200 0x100 0x14460400 0x100 0x14460300 0x100 0x14460400 0x100>;
				linux,phandle = <0x30>;
				phandle = <0x30>;
			};
		};
	};

	fragment@sound {
		target-path = [2f 00];

		__overlay__ {

			audio_codec_dummy {
				status = "okay";
				compatible = "snd-soc-dummy";
				linux,phandle = <0x3>;
				phandle = <0x3>;
			};

			audio_cpu_dummy {
				compatible = "samsung,dummy-cpu";
				status = "okay";
				linux,phandle = <0x31>;
				phandle = <0x31>;
			};

			sound {
				status = "okay";
				compatible = "samsung,exynos9610-audio";
				clock-names = "xclkout";
				clocks = <0xffffffff 0x321>;
				pinctrl-names = "default";
				pinctrl-0 = <0xffffffff>;
				samsung,routing = "HEADSETMIC", "MICBIAS1", "MAINMIC", "MICBIAS2", "SUBMIC", "MICBIAS3", "IN1P", "HEADSETMIC", "IN1N", "HEADSETMIC", "IN3P", "MAINMIC", "IN3N", "MAINMIC", "IN4P", "SUBMIC", "IN4N", "SUBMIC", "RECEIVER", "MONOOUT", "RECEIVER", "MONOOUT", "HEADPHONE", "HPOL", "HEADPHONE", "HPOR", "VOUTPUT", "ABOX UAIF0 Playback", "SPEAKER", "ABOX UAIF2 Playback", "VOUTPUTCALL", "ABOX SIFS0 Playback", "BLUETOOTH SPK", "ABOX SIFS2 Playback", "ABOX SPDY Capture", "FM IN", "ABOX SIFS2 Capture", "BLUETOOTH MIC", "ABOX SIFS0 Capture", "VINPUTCALL";
				samsung,codec = <0xffffffff 0xffffffff 0xffffffff 0xffffffff 0xffffffff 0xffffffff 0xffffffff>;
				samsung,prefix = "ABOX", "ABOX", "ABOX", "ABOX", "ABOX", "ABOX", "ABOX";
				samsung,aux = <0xffffffff 0xffffffff>;

				rdma@0 {

					cpu {
						sound-dai = <0xffffffff 0x0>;
					};

					platform {
						sound-dai = <0xffffffff>;
					};

					codec {
						sound-dai = <0x3>;
					};
				};

				rdma@1 {

					cpu {
						sound-dai = <0xffffffff 0x1>;
					};

					platform {
						sound-dai = <0xffffffff>;
					};

					codec {
						sound-dai = <0x3>;
					};
				};

				rdma@2 {

					cpu {
						sound-dai = <0xffffffff 0x2>;
					};

					platform {
						sound-dai = <0xffffffff>;
					};

					codec {
						sound-dai = <0x3>;
					};
				};

				rdma@3 {

					cpu {
						sound-dai = <0xffffffff 0x3>;
					};

					platform {
						sound-dai = <0xffffffff>;
					};

					codec {
						sound-dai = <0x3>;
					};
				};

				rdma@4 {

					cpu {
						sound-dai = <0xffffffff 0x4>;
					};

					platform {
						sound-dai = <0xffffffff>;
					};

					codec {
						sound-dai = <0x3>;
					};
				};

				rdma@5 {

					cpu {
						sound-dai = <0xffffffff 0x5>;
					};

					platform {
						sound-dai = <0xffffffff>;
					};

					codec {
						sound-dai = <0x3>;
					};
				};

				rdma@6 {

					cpu {
						sound-dai = <0xffffffff 0x6>;
					};

					platform {
						sound-dai = <0xffffffff>;
					};

					codec {
						sound-dai = <0x3>;
					};
				};

				rdma@7 {

					cpu {
						sound-dai = <0xffffffff 0x7>;
					};

					platform {
						sound-dai = <0xffffffff>;
					};

					codec {
						sound-dai = <0x3>;
					};
				};

				wdma@0 {

					cpu {
						sound-dai = <0xffffffff 0x8>;
					};

					platform {
						sound-dai = <0xffffffff>;
					};

					codec {
						sound-dai = <0x3>;
					};
				};

				wdma@1 {

					cpu {
						sound-dai = <0xffffffff 0x9>;
					};

					platform {
						sound-dai = <0xffffffff>;
					};

					codec {
						sound-dai = <0x3>;
					};
				};

				wdma@2 {

					cpu {
						sound-dai = <0xffffffff 0xa>;
					};

					platform {
						sound-dai = <0xffffffff>;
					};

					codec {
						sound-dai = <0x3>;
					};
				};

				wdma@3 {

					cpu {
						sound-dai = <0xffffffff 0xb>;
					};

					platform {
						sound-dai = <0xffffffff>;
					};

					codec {
						sound-dai = <0x3>;
					};
				};

				wdma@4 {

					cpu {
						sound-dai = <0xffffffff 0xc>;
					};

					platform {
						sound-dai = <0xffffffff>;
					};

					codec {
						sound-dai = <0x3>;
					};
				};

				uaif@0 {
					format = "i2s";

					cpu {
						sound-dai = <0xffffffff>;
					};

					codec {
						sound-dai = <0x4 0x0>;
					};
				};

				uaif@1 {
					format = "i2s";

					cpu {
						sound-dai = <0xffffffff>;
					};

					codec {
						sound-dai = <0x3>;
					};
				};

				uaif@2 {
					format = "i2s";

					cpu {
						sound-dai = <0xffffffff>;
					};

					platform {
						sound-dai = <0xffffffff 0x0>;
					};

					codec {
						sound-dai = <0x5 0x0>;
					};
				};

				uaif@4 {
					format = "i2s";
					bitclock-master;
					frame-master;

					cpu {
						sound-dai = <0xffffffff>;
					};

					codec {
						sound-dai = <0x3>;
					};
				};

				dsif@0 {
					format = "pdm";

					cpu {
						sound-dai = <0xffffffff>;
					};

					codec {
						sound-dai = <0x3>;
					};
				};

				spdy@0 {

					cpu {
						sound-dai = <0xffffffff>;
					};

					codec {
						sound-dai = <0x3>;
					};
				};

				sifs0@0 {

					cpu {
						sound-dai = <0xffffffff 0xd>;
					};

					codec {
						sound-dai = <0x3>;
					};
				};

				sifs1@0 {

					cpu {
						sound-dai = <0xffffffff 0xe>;
					};

					codec {
						sound-dai = <0x3>;
					};
				};

				sifs2@0 {

					cpu {
						sound-dai = <0xffffffff 0xf>;
					};

					codec {
						sound-dai = <0x3>;
					};
				};
			};
		};
	};

	fragment@14 {
		target = <0xffffffff>;

		__overlay__ {

			ext_bin@0 {
				status = "okay";
				samsung,name = "rtdsp.bin";
				samsung,area = <0x1>;
				samsung,offset = <0x502000>;
				linux,phandle = <0x32>;
				phandle = <0x32>;
			};

			ext_bin@1 {
				status = "okay";
				samsung,name = "AP_AUDIO_SLSI.bin";
				samsung,area = <0x1>;
				samsung,offset = <0x7f0000>;
				linux,phandle = <0x33>;
				phandle = <0x33>;
			};

			ext_bin@2 {
				status = "okay";
				samsung,name = "APBargeIn_AUDIO_SLSI.bin";
				samsung,area = <0x1>;
				samsung,offset = <0x7ec000>;
				linux,phandle = <0x34>;
				phandle = <0x34>;
			};

			ext_bin@4 {
				status = "okay";
				samsung,name = "rtdsp_param.bin";
				samsung,area = <0x1>;
				samsung,offset = <0x582000>;
				linux,phandle = <0x35>;
				phandle = <0x35>;
			};

			ext_bin@5 {
				status = "okay";
				samsung,name = "APBiBF_AUDIO_SLSI.bin";
				samsung,area = <0x1>;
				samsung,offset = <0x7ef000>;
				linux,phandle = <0x36>;
				phandle = <0x36>;
			};
		};
	};

	fragment@15 {
		target = <0xffffffff>;

		__overlay__ {
			#address-cells = <0x1>;
			#size-cells = <0x0>;
			status = "okay";

			rt5510@34 {
				status = "disabled";
				compatible = "richtek,rt5510";
				#sound-dai-cells = <0x1>;
				reg = <0x34>;
				linux,phandle = <0x5>;
				phandle = <0x5>;
			};
		};
	};

	fragment@16 {
		target = <0xffffffff>;

		__overlay__ {
			#address-cells = <0x1>;
			#size-cells = <0x0>;
			status = "okay";

			rt5665@1b {
				compatible = "realtek,rt5665";
				reg = <0x1b>;
				pinctrl-names = "default";
				pinctrl-0 = <0x6>;
				interrupt-parent = <0xffffffff>;
				interrupts = <0x2 0x0 0x0>;
				#sound-dai-cells = <0x1>;
				realtek,in1-differential;
				realtek,in3-differential;
				realtek,in4-differential;
				realtek,jd-src = <0x2>;
				realtek,mic-check-in-bg;
				realtek,dmic2-data-pin = <0x2>;
				realtek,sar-hs-type = <0x2bc>;
				realtek,sar-pb-vth0 = <0x5f>;
				realtek,sar-pb-vth1 = <0x8b>;
				realtek,sar-pb-vth2 = <0xf6>;
				realtek,sar-pb-vth3 = <0x244>;
				imp_table = <0x0 0xd 0x3 0x6 0xe 0x19 0x1 0x6 0x1a 0x35 0x0 0x6 0x36 0x67 0x0 0x6 0x68 0xffff 0x0 0x6>;
				realtek,offset-comp = <0x78 0x90 0xb0 0xc0 0xf0 0x110 0x130 0x180 0x1e0 0x200 0x2a0 0x300 0x3a0 0x400 0x500 0x600>;
				realtek,offset-comp-r = <0x1a 0x1f 0x20 0x2a 0x30 0x40 0x50 0x60 0x6f 0x7f 0xa0 0xb0 0xcf 0x100 0x120 0x160>;
				realtek,regulator_1v8 = <0x7>;
				realtek,regulator_3v3 = <0x8>;
				linux,phandle = <0x4>;
				phandle = <0x4>;
			};
		};
	};

	fragment@model {
		target-path = [2f 00];

		__overlay__ {
			#address-cells = <0x2>;
			#size-cells = <0x1>;
			model = "Samsung A50S EUR OPEN BRINGUP board based on Exynos9611";

			sec-mst {
				compatible = "sec-mst";
				sec-mst,mst-pwr-gpio = <0xffffffff 0x0 0x0>;
				sec-mst,mst-en-gpio = <0xffffffff 0x0 0x0>;
				sec-mst,mst-data-gpio = <0xffffffff 0x0 0x0>;
				sec-mst,mst-support-gpio = <0xffffffff 0x1 0x0>;
			};

			fixed-rate-clocks {

				oscclk {
					compatible = "samsung,exynos9610-oscclk";
					clock-frequency = <0x18cba80>;
				};
			};

			secgpio_dvs {
				compatible = "samsung,exynos9610-secgpio-dvs";
				status = "okay";
			};

			sec_abc {
				compatible = "samsung,sec_abc";
				status = "okay";

				gpu {
					gpu,label = "GPU fault";
					gpu,threshold_count = <0x14>;
					gpu,threshold_time = <0x4b0>;
				};

				aicl {
					aicl,label = "battery aicl";
					aicl,threshold_count = <0x5>;
					aicl,threshold_time = <0x12c>;
				};
			};

			abc_hub {
				compatible = "samsung,abc_hub";
				status = "okay";

				bootc {
					bootc,time_spec_user = <0x186a0>;
					bootc,time_spec_eng = <0x186a0>;
					bootc,time_spec_fac = <0x186a0>;
				};
			};

			speedy@11a10000 {
				#address-cells = <0x1>;
				#size-cells = <0x0>;
				status = "okay";

				s2mpu09mfd@00 {
					compatible = "samsung,s2mpu09mfd";
					acpm-ipc-channel = <0x2>;
					i2c-speedy-address;
					s2mpu09,wakeup = "enabled";
					s2mpu09,irq-gpio = <0xffffffff 0x0 0x0>;
					reg = <0x0>;
					interrupts = <0x2 0x0 0x0>;
					interrupt-parent = <0xffffffff>;
					pinctrl-names = "default";
					pinctrl-0 = <0x9 0xa>;
					wtsr_en = "enabled";
					smpl_en = "enabled";
					wtsr_timer_val = <0x3>;
					smpl_timer_val = <0x0>;
					check_jigon = <0x0>;
					init_time,sec = <0x0>;
					init_time,min = <0x0>;
					init_time,hour = <0xc>;
					init_time,mday = <0x1>;
					init_time,mon = <0x0>;
					init_time,year = <0x77>;
					init_time,wday = <0x2>;

					regulators {

						BUCK1 {
							regulator-name = "vdd_mif";
							regulator-min-microvolt = <0x7a120>;
							regulator-max-microvolt = <0x10c8e0>;
							regulator-always-on;
							regulator-ramp-delay = <0x2ee0>;
							regulator-initial-mode = <0x2>;
							linux,phandle = <0x37>;
							phandle = <0x37>;
						};

						BUCK2 {
							regulator-name = "vdd_cpucl1";
							regulator-min-microvolt = <0x7a120>;
							regulator-max-microvolt = <0x13d620>;
							regulator-always-on;
							regulator-ramp-delay = <0x2ee0>;
							regulator-initial-mode = <0x1>;
							linux,phandle = <0x38>;
							phandle = <0x38>;
						};

						BUCK3 {
							regulator-name = "vdd_cpucl0";
							regulator-min-microvolt = <0x7a120>;
							regulator-max-microvolt = <0x13d620>;
							regulator-always-on;
							regulator-ramp-delay = <0x2ee0>;
							regulator-initial-mode = <0x1>;
							linux,phandle = <0x39>;
							phandle = <0x39>;
						};

						BUCK4 {
							regulator-name = "vdd_int";
							regulator-min-microvolt = <0x7a120>;
							regulator-max-microvolt = <0x10c8e0>;
							regulator-always-on;
							regulator-ramp-delay = <0x2ee0>;
							regulator-initial-mode = <0x2>;
							linux,phandle = <0x3a>;
							phandle = <0x3a>;
						};

						BUCK5 {
							regulator-name = "vdd_g3d";
							regulator-min-microvolt = <0x7a120>;
							regulator-max-microvolt = <0x124f80>;
							regulator-always-on;
							regulator-ramp-delay = <0x2ee0>;
							regulator-initial-mode = <0x2>;
							linux,phandle = <0x3b>;
							phandle = <0x3b>;
						};

						BUCK6 {
							regulator-name = "vdd_cam_vipx";
							regulator-min-microvolt = <0x7a120>;
							regulator-max-microvolt = <0x13d620>;
							regulator-always-on;
							regulator-ramp-delay = <0x2ee0>;
							regulator-initial-mode = <0x2>;
							linux,phandle = <0x3c>;
							phandle = <0x3c>;
						};

						BUCK7 {
							regulator-name = "vdd2_mem";
							regulator-min-microvolt = <0x7a120>;
							regulator-max-microvolt = <0x13d620>;
							regulator-always-on;
							regulator-ramp-delay = <0x2ee0>;
							regulator-initial-mode = <0x3>;
							linux,phandle = <0x3d>;
							phandle = <0x3d>;
						};

						BUCK8 {
							regulator-name = "vdd_lldo";
							regulator-min-microvolt = <0x124f80>;
							regulator-max-microvolt = <0x16e360>;
							regulator-always-on;
							regulator-ramp-delay = <0x2ee0>;
							regulator-initial-mode = <0x3>;
							linux,phandle = <0x3e>;
							phandle = <0x3e>;
						};

						BUCK9 {
							regulator-name = "vdd_mldo";
							regulator-min-microvolt = <0x1b7740>;
							regulator-max-microvolt = <0x200b20>;
							regulator-always-on;
							regulator-ramp-delay = <0x2ee0>;
							regulator-initial-mode = <0x3>;
							linux,phandle = <0x3f>;
							phandle = <0x3f>;
						};

						LDO1 {
							regulator-name = "vdd_ldo1";
							regulator-min-microvolt = <0xaae60>;
							regulator-max-microvolt = <0x13d620>;
							regulator-always-on;
							regulator-ramp-delay = <0x2ee0>;
							regulator-initial-mode = <0x3>;
							linux,phandle = <0x40>;
							phandle = <0x40>;
						};

						LDO2 {
							regulator-name = "vqmmc";
							regulator-min-microvolt = <0x1b7740>;
							regulator-max-microvolt = <0x337f98>;
							regulator-ramp-delay = <0x2ee0>;
							linux,phandle = <0x41>;
							phandle = <0x41>;
						};

						LDO3 {
							regulator-name = "vdd_ldo3";
							regulator-min-microvolt = <0xc3500>;
							regulator-max-microvolt = <0x1dc130>;
							regulator-always-on;
							regulator-ramp-delay = <0x2ee0>;
							regulator-initial-mode = <0x3>;
							linux,phandle = <0x42>;
							phandle = <0x42>;
						};

						LDO4 {
							regulator-name = "vdd_ldo4";
							regulator-min-microvolt = <0x7a120>;
							regulator-max-microvolt = <0x10c8e0>;
							regulator-always-on;
							regulator-ramp-delay = <0x2ee0>;
							regulator-initial-mode = <0x1>;
							linux,phandle = <0x43>;
							phandle = <0x43>;
						};

						LDO5 {
							regulator-name = "vdd_ldo5";
							regulator-min-microvolt = <0xc3500>;
							regulator-max-microvolt = <0x13d620>;
							regulator-always-on;
							regulator-ramp-delay = <0x2ee0>;
							regulator-initial-mode = <0x1>;
							linux,phandle = <0x44>;
							phandle = <0x44>;
						};

						LDO6 {
							regulator-name = "vdd_ldo6";
							regulator-min-microvolt = <0xc3500>;
							regulator-max-microvolt = <0x13d620>;
							regulator-always-on;
							regulator-ramp-delay = <0x2ee0>;
							regulator-initial-mode = <0x1>;
							linux,phandle = <0x45>;
							phandle = <0x45>;
						};

						LDO7 {
							regulator-name = "vdd_ldo7";
							regulator-min-microvolt = <0xc3500>;
							regulator-max-microvolt = <0x1dc130>;
							regulator-always-on;
							regulator-ramp-delay = <0x2ee0>;
							regulator-initial-mode = <0x1>;
							linux,phandle = <0x46>;
							phandle = <0x46>;
						};

						LDO8 {
							regulator-name = "vdd_ldo8";
							regulator-min-microvolt = <0x7a120>;
							regulator-max-microvolt = <0x13d620>;
							regulator-always-on;
							regulator-ramp-delay = <0x2ee0>;
							regulator-initial-mode = <0x1>;
							linux,phandle = <0x47>;
							phandle = <0x47>;
						};

						LDO9 {
							regulator-name = "vdd_ldo9";
							regulator-min-microvolt = <0x7a120>;
							regulator-max-microvolt = <0x13d620>;
							regulator-always-on;
							regulator-ramp-delay = <0x2ee0>;
							regulator-initial-mode = <0x1>;
							linux,phandle = <0x48>;
							phandle = <0x48>;
						};

						LDO10 {
							regulator-name = "vdd_ldo10";
							regulator-min-microvolt = <0x7a120>;
							regulator-max-microvolt = <0x13d620>;
							regulator-always-on;
							regulator-ramp-delay = <0x2ee0>;
							regulator-initial-mode = <0x1>;
							linux,phandle = <0x49>;
							phandle = <0x49>;
						};

						LDO11 {
							regulator-name = "vdd_ldo11";
							regulator-min-microvolt = <0x7a120>;
							regulator-max-microvolt = <0x13d620>;
							regulator-always-on;
							regulator-ramp-delay = <0x2ee0>;
							regulator-initial-mode = <0x3>;
							linux,phandle = <0x4a>;
							phandle = <0x4a>;
						};

						LDO12 {
							regulator-name = "vdd_ldo12";
							regulator-min-microvolt = <0xc3500>;
							regulator-max-microvolt = <0x13d620>;
							regulator-ramp-delay = <0x2ee0>;
							regulator-initial-mode = <0x3>;
							linux,phandle = <0x4b>;
							phandle = <0x4b>;
						};

						LDO13 {
							regulator-name = "vdd_ldo13";
							regulator-min-microvolt = <0xc3500>;
							regulator-max-microvolt = <0x1dc130>;
							regulator-ramp-delay = <0x2ee0>;
							regulator-initial-mode = <0x3>;
							linux,phandle = <0x4c>;
							phandle = <0x4c>;
						};

						LDO14 {
							regulator-name = "vdd_ldo14";
							regulator-min-microvolt = <0x1b7740>;
							regulator-max-microvolt = <0x337f98>;
							regulator-ramp-delay = <0x2ee0>;
							regulator-initial-mode = <0x3>;
							linux,phandle = <0x4d>;
							phandle = <0x4d>;
						};

						LDO33 {
							regulator-name = "vdd_ldo33";
							regulator-min-microvolt = <0xc3500>;
							regulator-max-microvolt = <0x1dc130>;
							regulator-ramp-delay = <0x2ee0>;
							linux,phandle = <0x4e>;
							phandle = <0x4e>;
						};

						LDO34 {
							regulator-name = "vdd_ldo34";
							regulator-min-microvolt = <0x1b7740>;
							regulator-max-microvolt = <0x337f98>;
							regulator-ramp-delay = <0x2ee0>;
							linux,phandle = <0x4f>;
							phandle = <0x4f>;
						};

						LDO35 {
							regulator-name = "vmmc";
							regulator-min-microvolt = <0x1b7740>;
							regulator-max-microvolt = <0x337f98>;
							regulator-ramp-delay = <0x2ee0>;
							linux,phandle = <0x50>;
							phandle = <0x50>;
						};

						LDO36 {
							regulator-name = "vdd_ldo36";
							regulator-min-microvolt = <0x7a120>;
							regulator-max-microvolt = <0x13d620>;
							regulator-always-on;
							regulator-ramp-delay = <0x2ee0>;
							regulator-initial-mode = <0x1>;
							linux,phandle = <0x51>;
							phandle = <0x51>;
						};

						LDO37 {
							regulator-name = "vdd_ldo37";
							regulator-min-microvolt = <0x2ab980>;
							regulator-max-microvolt = <0x2ab980>;
							regulator-ramp-delay = <0x2ee0>;
							linux,phandle = <0x52>;
							phandle = <0x52>;
						};

						LDO38 {
							regulator-name = "VDD_BTP_3P3";
							regulator-min-microvolt = <0x325aa0>;
							regulator-max-microvolt = <0x325aa0>;
							regulator-ramp-delay = <0x2ee0>;
							linux,phandle = <0x53>;
							phandle = <0x53>;
						};

						LDO39 {
							regulator-name = "vdd_ldo39";
							regulator-min-microvolt = <0x1b7740>;
							regulator-max-microvolt = <0x1b7740>;
							regulator-initial-mode = <0x3>;
							linux,phandle = <0x54>;
							phandle = <0x54>;
						};

						LDO40 {
							regulator-name = "regulator_3v3";
							regulator-min-microvolt = <0x325aa0>;
							regulator-max-microvolt = <0x325aa0>;
							regulator-initial-mode = <0x3>;
							regulator-boot-on;
							linux,phandle = <0x8>;
							phandle = <0x8>;
						};

						LDO41 {
							regulator-name = "vdd_ldo41";
							regulator-min-microvolt = <0x1b7740>;
							regulator-max-microvolt = <0x337f98>;
							regulator-ramp-delay = <0x2ee0>;
							linux,phandle = <0x55>;
							phandle = <0x55>;
						};

						LDO42 {
							regulator-name = "regulator_1v8";
							regulator-min-microvolt = <0x1b7740>;
							regulator-max-microvolt = <0x1b7740>;
							regulator-ramp-delay = <0x2ee0>;
							regulator-initial-mode = <0x3>;
							regulator-boot-on;
							linux,phandle = <0x7>;
							phandle = <0x7>;
						};

						LDO43 {
							regulator-name = "vdd_ldo43";
							regulator-min-microvolt = <0x7a120>;
							regulator-max-microvolt = <0x13d620>;
							regulator-always-on;
							regulator-ramp-delay = <0x2ee0>;
							regulator-initial-mode = <0x1>;
							linux,phandle = <0x56>;
							phandle = <0x56>;
						};

						LDO44 {
							regulator-name = "vdd_ldo44";
							regulator-min-microvolt = <0x124f80>;
							regulator-max-microvolt = <0x124f80>;
							regulator-ramp-delay = <0x2ee0>;
							linux,phandle = <0x57>;
							phandle = <0x57>;
						};
					};
				};
			};

			sec_thermistor@0 {
				compatible = "samsung,sec-thermistor";
				status = "okay";
				thermistor_name = "sec-ap-thermistor";
				id = <0x0>;
				adc_array = <0x113 0x144 0x17c 0x1c2 0x210 0x26b 0x2d9 0x358 0x3eb 0x489 0x541 0x609 0x6e6 0x7bc 0x8ae 0x999 0xa7d 0xb55 0xc1e 0xccf 0xd62 0xddf 0xe4b>;
				temp_array = <0x384 0x352 0x320 0x2ee 0x2bc 0x28a 0x258 0x226 0x1f4 0x1c2 0x190 0x15e 0x12c 0xfa 0xc8 0x96 0x64 0x32 0x0 0xffffffce 0xffffff9c 0xffffff6a 0xffffff38>;
				io-channels = <0xffffffff 0x0>;
				io-channel-names = "adc-ap-temp";
				io-channel-ranges;
			};

			sec_thermistor@6 {
				compatible = "samsung,sec-thermistor";
				status = "okay";
				thermistor_name = "sec-wf-thermistor";
				id = <0x1>;
				adc_array = <0x113 0x144 0x17c 0x1c2 0x210 0x26b 0x2d9 0x358 0x3eb 0x489 0x541 0x609 0x6e6 0x7bc 0x8ae 0x999 0xa7d 0xb55 0xc1e 0xccf 0xd62 0xddf 0xe4b>;
				temp_array = <0x384 0x352 0x320 0x2ee 0x2bc 0x28a 0x258 0x226 0x1f4 0x1c2 0x190 0x15e 0x12c 0xfa 0xc8 0x96 0x64 0x32 0x0 0xffffffce 0xffffff9c 0xffffff6a 0xffffff38>;
				io-channels = <0xffffffff 0x6>;
				io-channel-names = "adc-wf-temp";
				io-channel-ranges;
			};

			exynos_rgt {
				compatible = "samsung,exynos-rgt";
			};

			mcu_ipc@11920000 {
				compatible = "samsung,exynos-shd-ipc-mailbox";
				reg = <0x0 0x11920000 0x180>;
				mcu,name = "mcu_ipc_cp";
				mcu,id = <0x0>;
				interrupts = <0x0 0x28 0x0>;
				mcu,irq_affinity_mask = <0x3>;
				linux,phandle = <0x58>;
				phandle = <0x58>;
			};

			mif_pdata {
				gpios = <0xffffffff 0x2 0x0 0xffffffff 0x3 0x0 0xffffffff 0x4 0x0 0xffffffff 0x5 0x0>;
				pinctrl-names = "default";
			};

			mcu_ipc@11A00000 {
				compatible = "samsung,exynos-shd-ipc-mailbox";
				reg = <0x0 0x11a00000 0x180>;
				mcu,name = "mcu_ipc_gnss";
				mcu,id = <0x1>;
				interrupts = <0x0 0x2b 0x0>;
				linux,phandle = <0xb>;
				phandle = <0xb>;
			};

			gnss_pdata {
				status = "okay";
				compatible = "samsung,gnss_shdmem_if";
				shmem,name = "KEPLER";
				shmem,device_node_name = "gnss_ipc";
				interrupts = <0x0 0x1b 0x0 0x0 0x51 0x0 0x0 0x50 0x0 0x0 0x4f 0x0>;
				interrupt-names = "ACTIVE", "WATCHDOG", "WAKEUP", "REQ_INIT";
				memory-region = <0xffffffff>;
				mbox_info = <0xb>;
				mbx,int_ap2gnss_bcmd = <0x0>;
				mbx,int_ap2gnss_req_fault_info = <0x1>;
				mbx,int_ap2gnss_ipc_msg = <0x2>;
				mbx,int_ap2gnss_ack_wake_set = <0x3>;
				mbx,int_ap2gnss_ack_wake_clr = <0x4>;
				mbx,irq_gnss2ap_bcmd = <0x0>;
				mbx,irq_gnss2ap_rsp_fault_info = <0x1>;
				mbx,irq_gnss2ap_ipc_msg = <0x2>;
				mbx,irq_gnss2ap_req_wake_clr = <0x4>;
				mbx,reg_bcmd_ctrl = <0x0 0x1 0x2 0x3>;
				reg_rx_ipc_msg = <0x1 0x5>;
				reg_tx_ipc_msg = <0x1 0x4>;
				reg_rx_head = <0x1 0x3>;
				reg_rx_tail = <0x1 0x2>;
				reg_tx_head = <0x1 0x1>;
				reg_tx_tail = <0x1 0x0>;
				fault_info = <0x1 0x200000 0x180000>;
				shmem,ipc_offset = <0x380000>;
				shmem,ipc_size = <0x80000>;
				shmem,ipc_reg_cnt = <0x20>;
			};

			gpio_keys {
				#address-cells = <0x1>;
				#size-cells = <0x0>;
				compatible = "gpio-keys";
				status = "okay";
				pinctrl-names = "default";
				pinctrl-0 = <0xc 0xd 0xe>;

				button@2 {
					label = "gpio-keys: KEY_VOLUMEDOWN";
					linux,code = <0x72>;
					gpios = <0xffffffff 0x6 0xf>;
				};

				button@3 {
					label = "gpio-keys: KEY_VOLUMEUP";
					linux,code = <0x73>;
					gpios = <0xffffffff 0x5 0xf>;
				};

				button@4 {
					label = "gpio-keys: KEY_POWER";
					linux,code = <0x74>;
					gpios = <0xffffffff 0x7 0xf>;
					gpio-key,wakeup = <0x1>;
				};
			};

			tsp_ldo_en {
				compatible = "regulator-fixed";
				regulator-name = "tsp_ldo_en";
				regulator-min-microvolt = <0x2dc6c0>;
				regulator-max-microvolt = <0x2dc6c0>;
				gpio = <0xffffffff 0x1 0x0>;
				enable-active-high;
			};

			i2c@13870000 {
				status = "okay";
				samsung,i2c-sda-delay = <0x64>;
				samsung,i2c-max-bus-freq = <0x61a80>;
				#address-cells = <0x1>;
				#size-cells = <0x0>;
				linux,phandle = <0x59>;
				phandle = <0x59>;

				mms_ts@48 {
					compatible = "melfas,mms_ts";
					reg = <0x48>;
					pinctrl-names = "on_state", "off_state";
					pinctrl-0 = <0xf>;
					pinctrl-1 = <0x10>;
					melfas,vdd_en = "tsp_ldo_en";
					melfas,irq-gpio = <0xffffffff 0x0 0x0>;
					melfas,scl-gpio = <0xffffffff 0x1 0x0>;
					melfas,sda-gpio = <0xffffffff 0x0 0x0>;
					melfas,area-size = <0x85 0x10a 0x155>;
					melfas,max_x_y = <0xfff 0xfff>;
					melfas,node_info = <0xf 0x20 0x0>;
					melfas,event_info = <0x8 0xc>;
					melfas,fod_info = <0xf 0xe 0x1b>;
					melfas,support_lpm = "true";
					melfas,fw_name = "tsp_melfas/mss100_a50s.fw";
					support_ear_detect_mode;
					enable_settings_aot;
					support_fod;
					melfas,no_vsync;
				};
			};

			usb_notifier {
				compatible = "samsung,usb-notifier";
				udc = <0xffffffff>;
				disable_host_wakelock;
			};

			fixedregulator@1 {
				compatible = "regulator-fixed";
				regulator-name = "V_SYS";
				regulator-min-microvolt = <0x401640>;
				regulator-max-microvolt = <0x401640>;
				regulator-boot-on;
				regulator-always-on;
				linux,phandle = <0x5a>;
				phandle = <0x5a>;
			};

			dwmmc2@13550000 {
				status = "okay";
				num-slots = <0x1>;
				supports-4bit;
				supports-cmd23;
				supports-erase;
				supports-highspeed;
				sd-uhs-sdr50;
				sd-uhs-sdr104;
				card-detect-gpio;
				bypass-for-allpass;
				card-init-hwacg-ctrl;
				skip-init-mmc-scan;
				qos-dvfs-int-level = <0x82208>;
				qos-dvfs-mif-level = <0xa50a0>;
				fifo-depth = <0x40>;
				desc-size = <0x4>;
				card-detect-delay = <0xc8>;
				data-timeout = <0xc8>;
				hto-timeout = <0x50>;
				samsung,dw-mshc-ciu-div = <0x3>;
				clock-frequency = <0x2faf0800>;
				card-detect-invert;
				samsung,dw-mshc-sdr-timing = <0x3 0x0 0x2 0x0>;
				samsung,dw-mshc-ddr-timing = <0x3 0x0 0x2 0x1>;
				samsung,dw-mshc-sdr50-timing = <0x3 0x0 0x4 0x2>;
				samsung,dw-mshc-sdr104-timing = <0x3 0x0 0x3 0x0>;
				num-ref-clks = <0x9>;
				ciu_clkin = <0x19 0x32 0x32 0x19 0x32 0x64 0xc8 0x32 0x32>;
				clk-drive-number = <0x4>;
				pinctrl-names = "default", "fast-slew-rate-1x", "fast-slew-rate-2x", "fast-slew-rate-3x", "fast-slew-rate-4x";
				pinctrl-0 = <0xffffffff 0xffffffff 0xffffffff 0xffffffff 0x11>;
				pinctrl-1 = <0xffffffff>;
				pinctrl-2 = <0xffffffff>;
				pinctrl-3 = <0xffffffff>;
				pinctrl-4 = <0xffffffff>;
				card-detect = <0xffffffff 0x4 0xf>;
				sec-sd-slot-type = <0x2>;
				#address-cells = <0x1>;
				#size-cells = <0x0>;

				slot@0 {
					reg = <0x0>;
					bus-width = <0x4>;
					disable-wp;
				};
			};

			usb_hs_tune {
				hs_tune_cnt = <0xc>;
				linux,phandle = <0x18>;
				phandle = <0x18>;

				hs_tune1 {
					tune_name = "tx_vref";
					tune_value = <0xf 0xa>;
				};

				hs_tune2 {
					tune_name = "tx_pre_emp";
					tune_value = <0x3 0x3>;
				};

				hs_tune3 {
					tune_name = "tx_pre_emp_plus";
					tune_value = <0x0 0x0>;
				};

				hs_tune4 {
					tune_name = "tx_res";
					tune_value = <0x3 0x3>;
				};

				hs_tune5 {
					tune_name = "tx_rise";
					tune_value = <0x3 0x3>;
				};

				hs_tune6 {
					tune_name = "tx_hsxv";
					tune_value = <0x3 0x3>;
				};

				hs_tune7 {
					tune_name = "tx_fsls";
					tune_value = <0x3 0x3>;
				};

				hs_tune8 {
					tune_name = "rx_sqrx";
					tune_value = <0x7 0x7>;
				};

				hs_tune9 {
					tune_name = "compdis";
					tune_value = <0x7 0x7>;
				};

				hs_tune10 {
					tune_name = "otg";
					tune_value = <0x2 0x2>;
				};

				hs_tune11 {
					tune_name = "enable_user_imp";
					tune_value = <0x0 0x0>;
				};

				hs_tune12 {
					tune_name = "is_phyclock";
					tune_value = <0x1 0x1>;
				};
			};

			ufs-srpmb {
				compatible = "samsung,ufs-srpmb";
				interrupts = <0x0 0x1cc 0x0>;
			};

			usb3_ss_tune {
				ss_tune_cnt = <0xf>;
				linux,phandle = <0x1a>;
				phandle = <0x1a>;

				ss_tune1 {
					tune_name = "tx0_term_offset";
					tune_value = <0x0 0x0>;
				};

				ss_tune2 {
					tune_name = "pcs_tx_swing_full";
					tune_value = <0x7f 0x7f>;
				};

				ss_tune3 {
					tune_name = "pcs_tx_deemph_6db";
					tune_value = <0x1c 0x1c>;
				};

				ss_tune4 {
					tune_name = "pcs_tx_deemph_3p5db";
					tune_value = <0x1c 0x1c>;
				};

				ss_tune5 {
					tune_name = "tx_vboost_lvl_sstx";
					tune_value = <0x7 0x7>;
				};

				ss_tune6 {
					tune_name = "tx_vboost_lvl";
					tune_value = <0x4 0x4>;
				};

				ss_tune7 {
					tune_name = "los_level";
					tune_value = <0x9 0x9>;
				};

				ss_tune8 {
					tune_name = "los_bias";
					tune_value = <0x5 0x5>;
				};

				ss_tune9 {
					tune_name = "pcs_rx_los_mask_val";
					tune_value = <0x104 0x104>;
				};

				ss_tune10 {
					tune_name = "tx_eye_height_cntl_en";
					tune_value = <0x1 0x1>;
				};

				ss_tune11 {
					tune_name = "pipe_tx_deemph_update_delay";
					tune_value = <0x2 0x2>;
				};

				ss_tune12 {
					tune_name = "pcs_tx_swing_full_sstx";
					tune_value = <0x7f 0x7f>;
				};

				ss_tune13 {
					tune_name = "rx_eq_fix_val";
					tune_value = <0x2 0x2>;
				};

				ss_tune14 {
					tune_name = "rx_decode_mode";
					tune_value = <0x1 0x1>;
				};

				ss_tune15 {
					tune_name = "decrese_ss_tx_imp";
					tune_value = <0x1 0x1>;
				};
			};

			usb3_hs_tune {
				hs_tune_cnt = <0xa>;
				linux,phandle = <0x19>;
				phandle = <0x19>;

				hs_tune1 {
					tune_name = "tx_pre_emp";
					tune_value = <0x3 0x3>;
				};

				hs_tune2 {
					tune_name = "tx_pre_emp_plus";
					tune_value = <0x0 0x0>;
				};

				hs_tune3 {
					tune_name = "tx_vref";
					tune_value = <0x7 0x7>;
				};

				hs_tune4 {
					tune_name = "rx_sqrx";
					tune_value = <0x7 0x7>;
				};

				hs_tune5 {
					tune_name = "tx_rise";
					tune_value = <0x3 0x3>;
				};

				hs_tune6 {
					tune_name = "compdis";
					tune_value = <0x7 0x7>;
				};

				hs_tune7 {
					tune_name = "tx_hsxv";
					tune_value = <0x3 0x3>;
				};

				hs_tune8 {
					tune_name = "tx_fsls";
					tune_value = <0x3 0x3>;
				};

				hs_tune9 {
					tune_name = "tx_res";
					tune_value = <0x3 0x3>;
				};

				hs_tune10 {
					tune_name = "utim_clk";
					tune_value = <0x1 0x1>;
				};
			};

			hall {
				status = "okay";
				compatible = "hall";
				pinctrl-names = "default";
				pinctrl-0 = <0x12>;
				hall,gpio_flip_cover = <0xffffffff 0x3 0x0>;
			};

			certify_hall {
				status = "okay";
				compatible = "certify_hall";
				pinctrl-names = "default";
				pinctrl-0 = <0x13>;
				certify_hall,gpio_certify_cover = <0xffffffff 0x2 0x0>;
			};

			nad_balancer {
				compatible = "samsung,sec_nad_balancer";
				status = "okay";
				nad_balancer,timeout = <0x190>;

				qos {

					cl0 {
						qos,label = "LIT";
						qos,delay_time = <0xa>;
						qos,table_size = <0xd>;
						qos,table = <0x1a94b0 0x18fe70 0x176830 0x163780 0x143bb0 0x12a570 0x110f30 0x101148 0xde2b0 0xc4c70 0xab630 0x91ff0 0x62638>;
					};

					cl1 {
						qos,label = "BIG";
						qos,delay_time = <0xa>;
						qos,table_size = <0xf>;
						qos,table = <0x234f10 0x21b8d0 0x215340 0x1fbd00 0x1e26c0 0x1cf610 0x1afa40 0x196400 0x1702a0 0x163780 0x14a140 0x130b00 0x1174c0 0xfde80 0xe4840>;
					};

					mif {
						qos,label = "MIF";
						qos,delay_time = <0xa>;
						qos,table_size = <0xa>;
						qos,table = <0x1fefc8 0x1e8c50 0x1b5fd0 0x177bb8 0xcbbc40 0xf78f0 0xce4c8 0xa50a0 0x854d0 0x664b8>;
					};
				};

				sleep {
					sleep,suspend_threshold = <0x3e8>;
					sleep,resume_threshold = <0x3e8>;
				};
			};

			argos {
				compatible = "samsung,argos";
				#address-cells = <0x1>;

				boot_device@1 {
					net_boost,label = "IPC";
					net_boost,node = "rmnet0 rmnet1 rmnet2 rmnet3 rmnet4 rmnet5 rmnet6 rmnet7 umts_dm0";
					net_boost,table_size = <0x4>;
					net_boost,table = <0x32 0x0 0x0 0xde2b0 0x0 0xce4c8 0x0 0x0 0x0 0x0 0x64 0x0 0x0 0x143bb0 0x0 0xf78f0 0x0 0x0 0x0 0x0 0xc8 0x0 0x0 0x176830 0x0 0x14a140 0x0 0x0 0x0 0x0 0x12c 0xfde800 0x0 0x163780 0x0 0x177bb8 0x0 0x0 0x0 0x0>;
				};

				boot_device@2 {
					net_boost,label = "CLAT";
					net_boost,node = "clat clat4 v4-rmnet0 v4-rmnet1 v4-rmnet2 v4-rmnet3 v4-rmnet4 v4-rmnet5 v4-rmnet6 v4-rmnet7";
					net_boost,table_size = <0x3>;
					net_boost,table = <0x64 0xfde80 0x0 0x0 0x0 0x0 0x0 0xf78f0 0x0 0x0 0x0 0x0 0x96 0x130b00 0x0 0x0 0x0 0x0 0x0 0x14a140 0x0 0x0 0x0 0x0 0xc8 0x163780 0x0 0x0 0x0 0x0 0x0 0x1fefc8 0x0 0x0 0x0 0x0>;
				};

				boot_device@3 {
					net_boost,label = "USB";
					net_boost,node = "rndis0";
					net_boost,table_size = <0x1>;
					net_boost,table = <0x0 0x0 0x0 0x0 0x0 0x0 0x0 0x0 0x1 0x0>;
				};
			};

			i2c@20 {
				compatible = "i2c-gpio";
				gpios = <0xffffffff 0x2 0x0 0xffffffff 0x3 0x0>;
				i2c-gpio,delay-us = <0x5>;
				#address-cells = <0x1>;
				#size-cells = <0x0>;
				pinctrl-names = "default";
				pinctrl-0 = <0x14>;

				sx9360_sub-i2c@28 {
					status = "okay";
					compatible = "sx9360_sub";
					reg = <0x28>;
					pinctrl-names = "default";
					pinctrl-0 = <0x15>;
					interrupt-parent = <0xffffffff>;
					interrupts = <0x7 0x0 0x0>;
					sx9360_sub,nirq-gpio = <0xffffffff 0x7 0x0>;
					sx9360,refresolution_reg = <0xf>;
					sx9360,refagainfreq_reg = <0x36>;
					sx9360,resolution_reg = <0xf>;
					sx9360,againfreq_reg = <0x58>;
					sx9360,refgainrawfilt_reg = <0x22>;
					sx9360,gainrawfilt_reg = <0x1a>;
					sx9360,hyst_reg = <0x15>;
					sx9360,proxthresh_reg = <0x23>;
					sx9360_sub,hallic_detect = <0x1>;
					sx9360_sub,hallic_cert_detect = <0x1>;
				};
			};

			fpcb_type {
				compatible = "fpcb_type";
				gpios = <0xffffffff 0x6 0x0 0xffffffff 0x5 0x0 0xffffffff 0x7 0x0>;
				status = "okay";
			};

			sec_vib {
				compatible = "sec_vib";

				sec_vib_pdata {
					status = "okay";
					sec_vib,max_timeout = <0x2710>;
					sec_vib,ldo_type = <0x1>;
					sec_vib,ldo_en = <0xffffffff 0x1 0x0>;
				};
			};

			sound {
				mixer-paths = "mixer_paths_rev00.xml";

				uaif@2 {

					codec {
						sound-dai = <0x16 0x0>;
					};
				};
			};
		};
	};

	fragment@inputbooster {
		target-path = [2f 00];

		__overlay__ {

			input_booster {
				status = "okay";
				compatible = "input_booster";
				#address-cells = <0x1>;
				#size-cells = <0x0>;

				booster_key@1 {
					input_booster,label = "KEY";
					input_booster,type = <0x0>;
					input_booster,levels = <0x1>;
					input_booster,cpu_freqs = <0x1174c0>;
					input_booster,hmp_boost = <0x1>;
					input_booster,kfc_freqs = <0x0>;
					input_booster,mif_freqs = <0x0>;
					input_booster,int_freqs = <0x0>;
					input_booster,dma_latency = <0x0>;
					input_booster,head_times = <0x1f4>;
					input_booster,tail_times = <0x1f4>;
					input_booster,phase_times = <0x0>;
				};

				booster_key@2 {
					input_booster,label = "TOUCHKEY";
					input_booster,type = <0x1>;
					input_booster,levels = <0x1>;
					input_booster,cpu_freqs = <0x1174c0>;
					input_booster,hmp_boost = <0x1>;
					input_booster,kfc_freqs = <0x0>;
					input_booster,mif_freqs = <0x0>;
					input_booster,int_freqs = <0x0>;
					input_booster,dma_latency = <0x0>;
					input_booster,head_times = <0x0>;
					input_booster,tail_times = <0xc8>;
					input_booster,phase_times = <0x0>;
				};

				booster_key@3 {
					input_booster,label = "TOUCH";
					input_booster,type = <0x2>;
					input_booster,levels = <0x1 0x2 0x3>;
					input_booster,cpu_freqs = <0x1174c0 0x1174c0 0xe4840>;
					input_booster,hmp_boost = <0x1 0x1 0x1>;
					input_booster,kfc_freqs = <0xc4c70 0xc4c70 0xc4c70>;
					input_booster,mif_freqs = <0x0 0x0 0x0>;
					input_booster,int_freqs = <0x0 0x0 0x0>;
					input_booster,dma_latency = <0x0 0x0 0x0>;
					input_booster,head_times = <0x82 0x82 0x0>;
					input_booster,tail_times = <0x0 0x0 0x1f4>;
					input_booster,phase_times = <0x0 0x0 0x0>;
				};

				booster_key@4 {
					input_booster,label = "MULTITOUCH";
					input_booster,type = <0x3>;
					input_booster,levels = <0x1 0x2>;
					input_booster,cpu_freqs = <0x1174c0 0xe4840>;
					input_booster,hmp_boost = <0x1 0x1>;
					input_booster,kfc_freqs = <0xc4c70 0xc4c70>;
					input_booster,mif_freqs = <0x0 0x0>;
					input_booster,int_freqs = <0x0 0x0>;
					input_booster,dma_latency = <0x0 0x0>;
					input_booster,head_times = <0x3e8 0x0>;
					input_booster,tail_times = <0x0 0x1f4>;
					input_booster,phase_times = <0x0 0x0>;
				};

				booster_key@5 {
					input_booster,label = "KEYBOARD";
					input_booster,type = <0x4>;
					input_booster,levels = <0x1 0x2>;
					input_booster,cpu_freqs = <0x1174c0 0x1174c0>;
					input_booster,hmp_boost = <0x1 0x1>;
					input_booster,kfc_freqs = <0xc4c70 0xc4c70>;
					input_booster,mif_freqs = <0x0 0x0>;
					input_booster,int_freqs = <0x0 0x0>;
					input_booster,dma_latency = <0x0 0x0>;
					input_booster,head_times = <0x82 0x82>;
					input_booster,tail_times = <0x0 0x0>;
					input_booster,phase_times = <0x0 0x0>;
				};

				booster_key@6 {
					input_booster,label = "MOUSE";
					input_booster,type = <0x5>;
					input_booster,levels = <0x1 0x2>;
					input_booster,cpu_freqs = <0x1174c0 0xe4840>;
					input_booster,hmp_boost = <0x1 0x1>;
					input_booster,kfc_freqs = <0xc4c70 0xc4c70>;
					input_booster,mif_freqs = <0x0 0x0>;
					input_booster,int_freqs = <0x0 0x0>;
					input_booster,dma_latency = <0x0 0x0>;
					input_booster,head_times = <0x82 0x0>;
					input_booster,tail_times = <0x0 0x1f4>;
					input_booster,phase_times = <0x0 0x0>;
				};

				booster_key@7 {
					input_booster,label = "MOUSE WHEEL";
					input_booster,type = <0x6>;
					input_booster,levels = <0x1 0x2>;
					input_booster,cpu_freqs = <0x1174c0 0x0>;
					input_booster,hmp_boost = <0x1 0x0>;
					input_booster,kfc_freqs = <0xc4c70 0x0>;
					input_booster,mif_freqs = <0x0 0x0>;
					input_booster,int_freqs = <0x0 0x0>;
					input_booster,dma_latency = <0x0 0x0>;
					input_booster,head_times = <0x82 0x0>;
					input_booster,tail_times = <0x0 0x0>;
					input_booster,phase_times = <0x0 0x0>;
				};

				booster_key@8 {
					input_booster,label = "PEN HOVER";
					input_booster,type = <0x7>;
					input_booster,levels = <0x1 0x2>;
					input_booster,cpu_freqs = <0x1174c0 0xe4840>;
					input_booster,hmp_boost = <0x1 0x1>;
					input_booster,kfc_freqs = <0xc4c70 0xc4c70>;
					input_booster,mif_freqs = <0x0 0x0>;
					input_booster,int_freqs = <0x0 0x0>;
					input_booster,dma_latency = <0x0 0x0>;
					input_booster,head_times = <0x82 0x0>;
					input_booster,tail_times = <0x0 0x1f4>;
					input_booster,phase_times = <0x0 0x0>;
				};

				booster_key@9 {
					input_booster,label = "PEN";
					input_booster,type = <0x8>;
					input_booster,levels = <0x1 0x2>;
					input_booster,cpu_freqs = <0x1702a0 0xe4840>;
					input_booster,hmp_boost = <0x1 0x1>;
					input_booster,kfc_freqs = <0xc4c70 0xc4c70>;
					input_booster,bimc_freqs = <0x0 0x0>;
					input_booster,dma_latency = <0x0 0x0>;
					input_booster,head_times = <0xc8 0x0>;
					input_booster,tail_times = <0x0 0x258>;
				};

				booster_key@10 {
					input_booster,label = "KEY_TWO";
					input_booster,type = <0x9>;
					input_booster,levels = <0x1>;
					input_booster,cpu_freqs = <0x1702a0>;
					input_booster,hmp_boost = <0x1>;
					input_booster,kfc_freqs = <0x101148>;
					input_booster,mif_freqs = <0x0>;
					input_booster,int_freqs = <0x0>;
					input_booster,dma_latency = <0x0>;
					input_booster,head_times = <0x2bc>;
					input_booster,tail_times = <0x2bc>;
					input_booster,phase_times = <0x0>;
				};
			};
		};
	};

	fragment@17 {
		target = <0xffffffff>;

		__overlay__ {
			#address-cells = <0x1>;
			#size-cells = <0x0>;
			gpios = <0xffffffff 0x0 0x0 0xffffffff 0x0 0x0>;
			#samsung,i2c-sda-delay = <0x64>;
			#samsung,i2c-max-bus-freq = <0x61a80>;
			clock-frequency = <0x61a80>;
			status = "okay";
			samsung,reset-before-trans;
			pinctrl-names = "default";
			pinctrl-0 = <0xffffffff>;

			sx9360-i2c@28 {
				status = "okay";
				compatible = "sx9360";
				reg = <0x28>;
				pinctrl-names = "default";
				pinctrl-0 = <0x17>;
				interrupt-parent = <0xffffffff>;
				interrupts = <0x5 0x0 0x0>;
				sx9360,nirq-gpio = <0xffffffff 0x5 0x0>;
				sx9360,reggnrlctrl2_reg = <0x19>;
				sx9360,againfreq_reg = <0x37>;
				sx9360,refagainfreq_reg = <0x36>;
				sx9360,gainrawfilt_reg = <0x1a>;
				sx9360,refgainrawfilt_reg = <0x22>;
				sx9360,proxthresh_reg = <0x22>;
				sx9360,hyst_reg = <0x15>;
				sx9360,regproxctrl3_reg = <0xa>;
				sx9360,resolution_reg = <0xf>;
				sx9360,refresolution_reg = <0xf>;
				sx9360,hallic_detect = <0x1>;
				sx9360,hallic_cert_detect = <0x1>;
			};
		};
	};

	fragment@18 {
		target = <0xffffffff>;

		__overlay__ {
			status = "okay";

			dwc3 {
				dr_mode = "otg";
				maximum-speed = "high-speed";
			};
		};
	};

	fragment@19 {
		target = <0xffffffff>;

		__overlay__ {
			dr_mode = "otg";
			maximum-speed = "high-speed";
			ldo-names = "vdd_ldo12", "vdd_ldo13", "vdd_ldo14";
		};
	};

	fragment@20 {
		target = <0xffffffff>;

		__overlay__ {
			status = "okay";
			usb3phy-isolation = <0x1>;
			hs_tune_param = <0x18>;
		};
	};

	fragment@21 {
		target = <0xffffffff>;

		__overlay__ {
			status = "okay";
			usb3phy-isolation = <0x1>;
			hs_tune_param = <0x19>;
			ss_tune_param = <0x1a>;
		};
	};

	fragment@22 {
		target = <0xffffffff>;

		__overlay__ {
			samsung,uart-logging;
			status = "okay";
		};
	};

	fragment@23 {
		target = <0xffffffff>;

		__overlay__ {

			key-voldown {
				samsung,pins = "gpa1-6";
				samsung,pin-function = <0xf>;
				samsung,pin-pud = <0x0>;
				samsung,pin-drv = <0x0>;
				linux,phandle = <0xc>;
				phandle = <0xc>;
			};

			key-volup {
				samsung,pins = "gpa1-5";
				samsung,pin-function = <0xf>;
				samsung,pin-pud = <0x0>;
				samsung,pin-drv = <0x0>;
				linux,phandle = <0xd>;
				phandle = <0xd>;
			};

			key-power {
				samsung,pins = "gpa1-7";
				samsung,pin-function = <0xf>;
				samsung,pin-pud = <0x0>;
				samsung,pin-drv = <0x0>;
				linux,phandle = <0xe>;
				phandle = <0xe>;
			};

			attn-irq {
				samsung,pins = "gpa0-0";
				samsung,pin-function = <0xf>;
				samsung,pin-pud = <0x0>;
				samsung,pin-drv = <0x0>;
				linux,phandle = <0xf>;
				phandle = <0xf>;
			};

			attn-input {
				samsung,pins = "gpa0-0";
				samsung,pin-function = <0x0>;
				samsung,pin-pud = <0x1>;
				linux,phandle = <0x10>;
				phandle = <0x10>;
			};

			if-pmic-irq {
				samsung,pins = "gpa2-2";
				samsung,pin-function = <0x0>;
				samsung,pin-pud = <0x0>;
				samsung,pin-drv = <0x0>;
				linux,phandle = <0x1d>;
				phandle = <0x1d>;
			};

			pmic-irq {
				samsung,pins = "gpa2-0";
				samsung,pin-pud = <0x3>;
				samsung,pin-drv = <0x3>;
				linux,phandle = <0x9>;
				phandle = <0x9>;
			};

			codec_irq {
				samsung,pins = "gpa1-2";
				samsung,pin-function = <0xf>;
				samsung,pin-pud = <0x0>;
				linux,phandle = <0x6>;
				phandle = <0x6>;
			};

			dwmmc2_cd_ext_irq {
				samsung,pins = "gpa2-4";
				samsung,pin-function = <0xf>;
				samsung,pin-pud = <0x0>;
				samsung,pin-drv = <0x3>;
				linux,phandle = <0x11>;
				phandle = <0x11>;
			};

			hall-irq {
				samsung,pins = "gpa0-3";
				samsung,pin-function = <0xf>;
				samsung,pin-pud = <0x0>;
				samsung,pin-drv = <0x0>;
				linux,phandle = <0x12>;
				phandle = <0x12>;
			};

			certify-hall-irq {
				samsung,pins = "gpa0-2";
				samsung,pin-function = <0xf>;
				samsung,pin-pud = <0x0>;
				samsung,pin-drv = <0x0>;
				linux,phandle = <0x13>;
				phandle = <0x13>;
			};

			usbpd-irq {
				samsung,pins = "gpa2-3";
				samsung,pin-function = <0xf>;
				samsung,pin-pud = <0x0>;
				samsung,pin-drv = <0x0>;
				linux,phandle = <0x1b>;
				phandle = <0x1b>;
			};
		};
	};

	fragment@24 {
		target = <0xffffffff>;

		__overlay__ {

			pm-wrsti {
				samsung,pins = "gpg0-7";
				samsung,pin-con-pdn = <0x3>;
				linux,phandle = <0xa>;
				phandle = <0xa>;
			};

			grip-sub-i2c {
				samsung,pins = "gpp1-2", "gpp1-3";
				samsung,pin-function = <0x2>;
				samsung,pin-pud = <0x0>;
				linux,phandle = <0x14>;
				phandle = <0x14>;
			};
		};
	};

	fragment@25 {
		target = <0xffffffff>;

		__overlay__ {
			exynos,block-type = "sda";
			exynos,fips-block_offset = <0x5>;
		};
	};

	fragment@26 {
		target = <0xffffffff>;

		__overlay__ {
			status = "disabled";
		};
	};

	fragment@27 {
		target = <0xffffffff>;

		__overlay__ {
			status = "disabled";
		};
	};

	fragment@28 {
		target = <0xffffffff>;

		__overlay__ {
			usi_v2_mode = "spi";
			status = "okay";
		};
	};

	fragment@29 {
		target = <0xffffffff>;

		__overlay__ {
			status = "disabled";
		};
	};

	fragment@30 {
		target = <0xffffffff>;

		__overlay__ {
			status = "disabled";
		};
	};

	fragment@31 {
		target = <0xffffffff>;

		__overlay__ {
			usi_v2_mode = "i2c";
			status = "okay";
		};
	};

	fragment@32 {
		target = <0xffffffff>;

		__overlay__ {
			usi_v2_mode = "i2c";
			status = "okay";
		};
	};

	fragment@33 {
		target = <0xffffffff>;

		__overlay__ {
			status = "disabled";
		};
	};

	fragment@34 {
		target = <0xffffffff>;

		__overlay__ {
			usi_v2_mode = "i2c";
			status = "okay";
		};
	};

	fragment@35 {
		target = <0xffffffff>;

		__overlay__ {
			status = "disabled";
		};
	};

	fragment@36 {
		target = <0xffffffff>;

		__overlay__ {
			usi_v2_mode = "spi";
			status = "okay";
		};
	};

	fragment@37 {
		target = <0xffffffff>;

		__overlay__ {
			status = "disabled";
		};
	};

	fragment@38 {
		target = <0xffffffff>;

		__overlay__ {
			usi_v2_mode = "i2c";
			status = "okay";
		};
	};

	fragment@39 {
		target = <0xffffffff>;

		__overlay__ {
			status = "disabled";
		};
	};

	fragment@40 {
		target = <0xffffffff>;

		__overlay__ {
			usi_v2_mode = "spi";
			status = "okay";
		};
	};

	fragment@41 {
		target = <0xffffffff>;

		__overlay__ {
			i2c-gpio,delay-us = <0x5>;
			status = "okay";
			samsung,glitch-filter;
			samsung,fix-doxfer-return;
			#address-cells = <0x1>;
			#size-cells = <0x0>;
			samsung,i2c-max-bus-freq = <0x61a80>;

			usbpd-5713@33 {
				compatible = "sm5713-usbpd,i2c";
				reg = <0x33>;
				pinctrl-names = "default";
				support_pd_role_swap;
				pinctrl-0 = <0x1b>;
				usbpd,usbpd_int = <0xffffffff 0x3 0x0>;
			};
		};
	};

	fragment@42 {
		target = <0xffffffff>;

		__overlay__ {
			#address-cells = <0x1>;
			#size-cells = <0x0>;
			status = "okay";
			samsung,glitch-filter;
			samsung,fix-doxfer-return;
			samsung,i2c-max-bus-freq = <0x61a80>;

			sm5713@49 {
				compatible = "siliconmitus,sm5713mfd";
				reg = <0x49>;
				pinctrl-names = "default";
				pinctrl-0 = <0x1c 0x1d>;
				sm5713,irq-gpio = <0xffffffff 0x2 0x0>;
				sm5713,wakeup;
			};
		};
	};

	fragment@43 {
		target = <0xffffffff>;

		__overlay__ {
			status = "okay";
			#address-cells = <0x1>;
			#size-cells = <0x0>;

			s2mpb03@56 {
				compatible = "samsung,s2mpb03pmic";
				reg = <0x56>;
				s2mpb03,wakeup;

				regulators {

					s2mpb03-ldo1 {
						regulator-name = "CAM_VLDO1";
						regulator-min-microvolt = <0x10c8e0>;
						regulator-max-microvolt = <0x10c8e0>;
						linux,phandle = <0x5b>;
						phandle = <0x5b>;
					};

					s2mpb03-ldo2 {
						regulator-name = "CAM_VLDO2";
						regulator-min-microvolt = <0x100590>;
						regulator-max-microvolt = <0x100590>;
						linux,phandle = <0x5c>;
						phandle = <0x5c>;
					};

					s2mpb03-ldo3 {
						regulator-name = "CAM_VLDO3";
						regulator-min-microvolt = <0x1b7740>;
						regulator-max-microvolt = <0x1b7740>;
						linux,phandle = <0x5d>;
						phandle = <0x5d>;
					};

					s2mpb03-ldo4 {
						regulator-name = "CAM_VLDO4";
						regulator-min-microvolt = <0x124f80>;
						regulator-max-microvolt = <0x124f80>;
						linux,phandle = <0x5e>;
						phandle = <0x5e>;
					};

					s2mpb03-ldo5 {
						regulator-name = "CAM_VLDO5";
						regulator-min-microvolt = <0x2c4020>;
						regulator-max-microvolt = <0x2c4020>;
						linux,phandle = <0x5f>;
						phandle = <0x5f>;
					};

					s2mpb03-ldo6 {
						regulator-name = "CAM_VLDO6";
						regulator-min-microvolt = <0x2c4020>;
						regulator-max-microvolt = <0x2c4020>;
						linux,phandle = <0x60>;
						phandle = <0x60>;
					};

					s2mpb03-ldo7 {
						regulator-name = "CAM_VLDO7";
						regulator-min-microvolt = <0x2ab980>;
						regulator-max-microvolt = <0x2ab980>;
						linux,phandle = <0x61>;
						phandle = <0x61>;
					};
				};
			};
		};
	};

	fragment@battery {
		target-path = [2f 00];

		__overlay__ {

			sm5713-fuelgauge {
				status = "okay";
				fuelgauge,fuel_alert_soc = <0x1>;
				fuelgauge,capacity_max = <0x3e8>;
				fuelgauge,capacity_max_margin = <0x12c>;
				fuelgauge,capacity_min = <0x0>;
				fuelgauge,capacity_calculation_type = <0x1f>;
				fuelgauge,using_temp_compensation;
				fuelgauge,low_temp_limit = <0x64>;
				fuelgauge,using_hw_vempty;
				fuelgauge,sw_v_empty_voltage = <0xc80>;
				fuelgauge,sw_v_empty_voltage_cisd = <0xc1c>;
				fuelgauge,sw_v_empty_recover_voltage = <0xd98>;
				fuelgauge,ttf_capacity = <0xd48>;
				fuelgauge,cv_data = <0x7ac 0x35f 0x79e 0x776 0x369 0x781 0x748 0x373 0x765 0x73d 0x381 0x706 0x714 0x386 0x6cf 0x6b8 0x38f 0x669 0x66c 0x398 0x605 0x5e5 0x3a2 0x580 0x525 0x3ad 0x4e1 0x501 0x3b7 0x443 0x490 0x3c0 0x3ad 0x40b 0x3ca 0x2e4 0x393 0x3d4 0x142 0x328 0x3df 0x8e 0x2d5 0x3e7 0x52 0x185 0x3e8 0x0>;

				battery_params {
					battery,id = <0x0>;
					battery0,battery_type = <0x1130 0x0 0x1d44>;
					battery0,battery_table0 = <0x1400 0x1b33 0x1baf 0x1cdd 0x1d5d 0x1d82 0x1d8a 0x1d9d 0x1ddf 0x1e2c 0x1e50 0x1e7d 0x1ede 0x1f30 0x1f74 0x1fc0 0x1fe0 0x1ff4 0x201e 0x20b8 0x20d7 0x210b 0x2260 0x2400>;
					battery0,battery_table1 = <0x0 0x98 0xf5 0x34c 0x4e6 0x799 0xa4c 0xd00 0x124c 0x1d19 0x2519 0x2d33 0x354c 0x3a99 0x3d4c 0x42b3 0x4566 0x4819 0x4ab3 0x5019 0x52cc 0x5580 0x6400 0x6419>;
					battery0,battery_table2 = <0x4b 0x44 0x40 0x3e 0x3c 0x3b 0x38 0x37 0x35 0x34 0x34 0x33 0x33 0x33 0x33 0x32>;
					battery0,rce_value = <0x4e1 0x3e6 0x1d7>;
					battery0,rs_value = <0xa4 0x147 0x146 0x3800 0x7a>;
					battery0,misc = <0x0>;
					battery0,topoff_soc = <0x0 0x3 0x190>;
					battery0,vit_period = <0xa0a>;
					battery0,dtcd_value = <0x1>;
					battery0,volt_cal = <0x8000 0x8000>;
					battery0,curr_offset = <0x1 0x0 0x0 0x0 0x0 0x0 0x0>;
					battery0,mix_value = <0x103 0x4>;
					battery0,temp_std = <0x19>;
					battery0,temp_cal = <0x0 0x6 0x1 0xb 0xffffffff 0x1 0x6 0x1 0x9 0x1>;
					battery0,ext_temp_cal = <0x0 0x2 0x1 0x2 0x1 0x1 0x2 0x3 0x2 0x3>;
					battery0,temp_volcal = <0x0 0xf 0x1>;
					battery0,temp_offset = <0x1 0xb 0x1 0x1 0x8 0xffffffff>;
					battery0,curr_cal = <0x887d 0x887d 0x887d 0x8080 0x8080 0x8080>;
					battery0,tem_poff = <0xd48 0x32 0xcb2 0x32>;
					battery0,arsm = <0x1 0x3 0x1 0x6>;
					battery0,cycle_cfg = <0x0 0x0 0x0>;
					battery0,full_offset = <0x0 0x32 0x0 0xd1 0x90>;
					battery0,age_cntl = <0x325>;
					battery0,tcal_ioff = <0x2 0x30>;
					battery0,v_offset_cancel = <0x0 0x0 0x64 0xa>;
					battery0,v_alarm = <0xc1c 0x0>;
					battery0,data_ver = <0x1>;
					battery0,v_max_table = <0x2260 0x2220 0x21fd 0x21db 0x2185>;
					battery0,q_max_table = <0x1d44 0x1cc4 0x1c44 0x1bc4 0x1a85>;
					battery0,coeff = <0x2700>;
				};
			};

			pdic-manager {
				pdic,max_power = <0x1388>;
				pdic,op_power = <0x9c4>;
				pdic,max_voltage = <0x1770>;
				pdic,max_current = <0x7d0>;
				pdic,min_current = <0x1f4>;
				pdic,giveback = <0x0>;
				pdic,usb_com_capable = <0x1>;
				pdic,no_usb_suspend = <0x1>;
				source,max_voltage = <0x1388>;
				source,min_voltage = <0xfa0>;
				source,max_power = <0x9c4>;
			};

			battery {
				status = "okay";
				compatible = "samsung,sec-battery";
				pinctrl-names = "default";
				battery,vendor = "Battery";
				battery,charger_name = "sm5713-charger";
				battery,fuelgauge_name = "sm5713-fuelgauge";
				battery,technology = <0x2>;
				battery,fgsrc_switch_name = "sm5713-fuelgauge";
				battery,chip_vendor = "LSI";
				battery,temp_adc_type = <0x1>;
				battery,temp_check_type = <0x2>;
				battery,usb_temp_check_type = <0x0>;
				battery,chg_temp_check_type = <0x2>;
				battery,wpc_temp_check_type = <0x0>;
				battery,thermal_source = <0x3>;
				battery,usb_thermal_source = <0x0>;
				battery,chg_thermal_source = <0x3>;
				battery,wpc_thermal_source = <0x0>;
				battery,polling_time = <0xa 0x1e 0x1e 0x1e 0xe10>;
				battery,temp_table_adc = <0x14f 0x182 0x1b7 0x202 0x256 0x29a 0x31b 0x3a5 0x42e 0x4d9 0x58e 0x63a 0x736 0x820 0x8b6 0x99b 0xab9 0xb84 0xc48 0xcf3 0xd8e 0xdf9 0xe64>;
				battery,temp_table_data = <0x384 0x352 0x320 0x2ee 0x2bc 0x28a 0x258 0x226 0x1f4 0x1c2 0x190 0x15e 0x12c 0xfa 0xc8 0x96 0x64 0x32 0x0 0xffffffce 0xffffff9c 0xffffff6a 0xffffff38>;
				battery,chg_temp_table_adc = <0x138 0x16a 0x19e 0x1e3 0x234 0x284 0x303 0x389 0x410 0x4b0 0x570 0x61b 0x713 0x803 0x894 0x97d 0xaac 0xb6e 0xc41 0xce4 0xd7f 0xde3 0xe5c>;
				battery,chg_temp_table_data = <0x384 0x352 0x320 0x2ee 0x2bc 0x28a 0x258 0x226 0x1f4 0x1c2 0x190 0x15e 0x12c 0xfa 0xc8 0x96 0x64 0x32 0x0 0xffffffce 0xffffff9c 0xffffff6a 0xffffff38>;
				battery,inbat_voltage = <0x1>;
				battery,inbat_voltage_table_adc = <0xaa4 0xa85 0xa6e 0xa5a 0xa3a 0xa25 0x9fe 0x9f8 0x9d3 0x9c2 0x9a0 0x973 0x970 0x953 0x93c 0x921 0x904 0x8ed 0x8d1 0x8c5>;
				battery,inbat_voltage_table_data = <0x1107 0x10fd 0x10cb 0x1099 0x1060 0x1034 0xff7 0xfd1 0xf8c 0xf62 0xf36 0xf04 0xebf 0xe97 0xe61 0xe35 0xdfa 0xdd0 0xd95 0xd74>;
				battery,adc_check_count = <0x5>;
				battery,cable_check_type = <0x4>;
				battery,cable_source_type = <0x1>;
				battery,polling_type = <0x1>;
				battery,monitor_initial_count = <0x0>;
				battery,battery_check_type = <0x0>;
				battery,check_count = <0x0>;
				battery,check_adc_max = <0x5a0>;
				battery,check_adc_min = <0x0>;
				battery,ovp_uvlo_check_type = <0x3>;
				battery,temp_check_count = <0x1>;
				battery,temp_highlimit_threshold_normal = <0x320>;
				battery,temp_highlimit_recovery_normal = <0x30c>;
				battery,temp_high_threshold_normal = <0x1f4>;
				battery,temp_high_recovery_normal = <0x1e0>;
				battery,temp_low_threshold_normal = <0x0>;
				battery,temp_low_recovery_normal = <0x14>;
				battery,temp_highlimit_threshold_lpm = <0x320>;
				battery,temp_highlimit_recovery_lpm = <0x30c>;
				battery,temp_high_threshold_lpm = <0x1f4>;
				battery,temp_high_recovery_lpm = <0x1e0>;
				battery,temp_low_threshold_lpm = <0x0>;
				battery,temp_low_recovery_lpm = <0x14>;
				battery,wpc_high_threshold_normal = <0x1c2>;
				battery,wpc_high_recovery_normal = <0x1ae>;
				battery,wpc_low_threshold_normal = <0x0>;
				battery,wpc_low_recovery_normal = <0x14>;
				battery,full_check_type = <0x2>;
				battery,full_check_type_2nd = <0x2>;
				battery,full_check_count = <0x1>;
				battery,chg_gpio_full_check = <0x0>;
				battery,chg_polarity_full_check = <0x1>;
				battery,chg_heating_prevention_method = <0x0>;
				battery,chg_high_temp = <0x1f4>;
				battery,chg_high_temp_recovery = <0x1e0>;
				battery,chg_input_limit_current = <0x3e8>;
				battery,chg_charging_limit_current = <0x6a4>;
				battery,wpc_temp_control_source = <0x0>;
				battery,wpc_high_temp = <0x17c>;
				battery,wpc_high_temp_recovery = <0x168>;
				battery,wpc_charging_limit_current = <0x258>;
				battery,wpc_temp_lcd_on_control_source = <0x0>;
				battery,wpc_lcd_on_high_temp = <0x17c>;
				battery,wpc_lcd_on_high_temp_rec = <0x168>;
				battery,wpc_lcd_on_charging_limit_current = <0x1c2>;
				battery,wpc_store_high_temp = <0x168>;
				battery,wpc_store_high_temp_recovery = <0x154>;
				battery,wpc_store_lcd_on_high_temp = <0x168>;
				battery,wpc_store_lcd_on_high_temp_rec = <0x12c>;
				battery,wpc_store_lcd_on_charging_limit_current = <0x190>;
				battery,sleep_mode_limit_current = <0x1f4>;
				battery,wc_full_input_limit_current = <0x64>;
				battery,mix_high_temp = <0x1a4>;
				battery,mix_high_chg_temp = <0x1f4>;
				battery,mix_high_temp_recovery = <0x186>;
				battery,full_condition_type = <0xd>;
				battery,full_condition_soc = <0x5d>;
				battery,full_condition_vcell = <0x109a>;
				battery,recharge_check_count = <0x1>;
				battery,recharge_condition_type = <0x4>;
				battery,recharge_condition_soc = <0x62>;
				battery,recharge_condition_vcell = <0x10b8>;
				battery,charging_total_time = <0x3840>;
				battery,hv_charging_total_time = <0x2a30>;
				battery,normal_charging_total_time = <0x4650>;
				battery,usb_charging_total_time = <0x8ca0>;
				battery,recharging_total_time = <0x1518>;
				battery,charging_reset_time = <0x0>;
				battery,chg_float_voltage = <0x10fe>;
				battery,chg_ocp_current = <0x1388>;
				battery,swelling_high_temp_block = <0x19a>;
				battery,swelling_high_temp_recov = <0x186>;
				battery,swelling_low_temp_block_1st = <0x96>;
				battery,swelling_low_temp_recov_1st = <0xaa>;
				battery,swelling_low_temp_block_2nd = <0x32>;
				battery,swelling_low_temp_recov_2nd = <0x46>;
				battery,swelling_low_temp_current = <0x384>;
				battery,swelling_low_temp_current_2nd = <0x15e>;
				battery,swelling_low_temp_topoff = <0xc8>;
				battery,swelling_high_temp_current = <0x578>;
				battery,swelling_high_temp_topoff = <0xc8>;
				battery,swelling_wc_high_temp_current = <0x384>;
				battery,swelling_wc_low_temp_current = <0x384>;
				battery,swelling_wc_low_temp_current_2nd = <0x15e>;
				battery,swelling_drop_float_voltage = <0x1036>;
				battery,swelling_high_rechg_voltage = <0xfa0>;
				battery,swelling_low_rechg_voltage = <0xfa0>;
				battery,siop_event_check_type = <0x1>;
				battery,siop_call_cv_current = <0x14a>;
				battery,siop_call_cc_current = <0x14a>;
				battery,siop_input_limit_current = <0x4b0>;
				battery,siop_charging_limit_current = <0x3e8>;
				battery,siop_hv_input_limit_current = <0x2bc>;
				battery,siop_hv_charging_limit_current = <0x3e8>;
				battery,input_current_by_siop_20 = <0x3e8>;
				battery,siop_wireless_input_limit_current = <0x258>;
				battery,siop_wireless_charging_limit_current = <0x2bc>;
				battery,siop_hv_wireless_input_limit_current = <0x258>;
				battery,siop_hv_wireless_charging_limit_current = <0x2bc>;
				battery,siop_store_hv_wireless_input_limit_current = <0x1c2>;
				battery,ttf_hv_charge_current = <0x87a>;
				battery,ttf_hv_wireless_charge_current = <0x41a>;
				battery,ttf_wireless_charge_current = <0x384>;
				battery,rp_current_rp1 = <0x1f4>;
				battery,rp_current_rp2 = <0x5dc>;
				battery,rp_current_rp3 = <0xbb8>;
				battery,rp_current_rdu_rp3 = <0x834>;
				battery,rp_current_abnormal_rp3 = <0x708>;
				battery,pd_charging_charge_power = <0x3a98>;
				battery,max_charging_current = <0x960>;
				battery,battery_full_capacity = <0xfa0>;
				battery,age_data = <0x0 0x10fe 0x10b8 0x109a 0x5d 0x12c 0x10ea 0x10a4 0x1086 0x5c 0x190 0x10d6 0x1090 0x1072 0x5b 0x2bc 0x10c2 0x107c 0x105e 0x5a 0x3e8 0x1090 0x104a 0x102c 0x59>;
				battery,health_condition = <0x384 0x0 0x4b0 0x0 0x5dc 0x0>;
				battery,pre_afc_input_current = <0x1f4>;
				battery,prepare_ta_delay = <0x0>;
				battery,max_input_voltage = <0x2328>;
				battery,max_input_current = <0xbb8>;
				battery,enable_water_resistance;
				battery,standard_curr = <0x960>;
				battery,expired_time = <0x2c88>;
				battery,recharging_expired_time = <0x1518>;
				battery,cisd_max_voltage_thr = <0x1130>;
				battery,cisd_alg_index = <0x7>;
				battery,ignore_cisd_index = <0x0 0x3c0>;
				battery,ignore_cisd_index_d = <0x0 0x78>;
				io-channels = <0xffffffff 0x1 0xffffffff 0x2 0xffffffff 0x3>;
				io-channel-names = "adc-temp", "adc-in-bat", "adc-chg-temp";
				#io-channel-cells = <0x5>;
				io-channel-ranges;
			};

			cable-info {
				default_input_current = <0x708>;
				default_charging_current = <0x834>;
				full_check_current_1st = <0x190>;
				full_check_current_2nd = <0xc8>;

				current_group_1 {
					cable_number = <0x2 0x13 0x15 0x16 0x17 0x1e>;
					input_current = <0x1f4>;
					charging_current = <0x1f4>;
				};

				current_group_2 {
					cable_number = <0x19 0x1f>;
					input_current = <0x3e8>;
					charging_current = <0x3e8>;
				};

				current_group_3 {
					cable_number = <0x5 0x20>;
					input_current = <0x5dc>;
					charging_current = <0x5dc>;
				};

				current_group_4 {
					cable_number = <0x6 0x7 0x8>;
					input_current = <0x672>;
					charging_current = <0x960>;
				};

				current_group_5 {
					cable_number = <0x9>;
					input_current = <0x672>;
					charging_current = <0x960>;
				};

				current_group_6 {
					cable_number = <0xa 0xc 0xf 0x1b 0x21>;
					input_current = <0x334>;
					charging_current = <0x960>;
				};

				current_group_7 {
					cable_number = <0xd>;
					input_current = <0x2ee>;
					charging_current = <0x960>;
				};

				current_group_8 {
					cable_number = <0x18>;
					input_current = <0x3e8>;
					charging_current = <0x1c2>;
				};

				current_group_9 {
					cable_number = <0x1a>;
					input_current = <0x7d0>;
					charging_current = <0x708>;
				};

				current_group_10 {
					cable_number = <0xb 0xe 0x10 0x1c 0x23>;
					input_current = <0x2ee>;
					charging_current = <0x960>;
				};

				current_group_11 {
					cable_number = <0x1d>;
					input_current = <0x1f4>;
					charging_current = <0x578>;
				};

				current_group_12 {
					cable_number = <0x1 0x4>;
					input_current = <0x1db>;
					charging_current = <0x226>;
				};
			};
		};
	};

	fragment@44 {
		target = <0xffffffff>;

		__overlay__ {

			chg-en {
				samsung,pins = "gpg2-3";
				samsung,pin-function = <0x1>;
				samsung,pin-pud = <0x1>;
				samsung,pin-drv = <0x0>;
				linux,phandle = <0x1c>;
				phandle = <0x1c>;
			};
		};
	};

	fragment@45 {
		target = <0xffffffff>;

		__overlay__ {

			btp-rst {
				samsung,pins = "gpg3-0";
				samsung,pin-function = <0x1>;
				samsung,pin-pud = <0x1>;
				samsung,pin-drv = <0x0>;
				linux,phandle = <0x1e>;
				phandle = <0x1e>;
			};

			spi7-bus-inactive {
				samsung,pins = "gpp2-4", "gpp2-5", "gpp2-7";
				samsung,pin-function = <0x1>;
				samsung,pin-pud = <0x0>;
				samsung,pin-drv = <0x2>;
				samsung,pin-val = <0x0>;
				linux,phandle = <0x23>;
				phandle = <0x23>;
			};

			spi17-miso-inactive {
				samsung,pins = "gpp2-6";
				samsung,pin-function = <0x0>;
				samsung,pin-pud = <0x1>;
				samsung,pin-drv = <0x2>;
				linux,phandle = <0x24>;
				phandle = <0x24>;
			};

			spi7-clk {
				samsung,pins = "gpp2-4";
				samsung,pin-function = <0x2>;
				samsung,pin-pud = <0x1>;
				samsung,pin-drv = <0x2>;
				linux,phandle = <0x1f>;
				phandle = <0x1f>;
			};

			spi7-cs {
				samsung,pins = "gpp2-7";
				samsung,pin-function = <0x2>;
				samsung,pin-pud = <0x3>;
				samsung,pin-drv = <0x2>;
				linux,phandle = <0x20>;
				phandle = <0x20>;
			};

			spi7-miso {
				samsung,pins = "gpp2-6";
				samsung,pin-function = <0x2>;
				samsung,pin-pud = <0x1>;
				samsung,pin-drv = <0x2>;
				linux,phandle = <0x21>;
				phandle = <0x21>;
			};

			spi7-mosi {
				samsung,pins = "gpp2-5";
				samsung,pin-function = <0x2>;
				samsung,pin-pud = <0x1>;
				samsung,pin-drv = <0x2>;
				linux,phandle = <0x22>;
				phandle = <0x22>;
			};
		};
	};

	fragment@46 {
		target = <0xffffffff>;

		__overlay__ {
			status = "okay";
			dma-mode;
			dmas = <0xffffffff 0x15 0xffffffff 0x14>;

			etspi-spi@0 {
				compatible = "etspi,et7xx";
				reg = <0x0>;
				spi-max-frequency = <0x2faf080>;
				pinctrl-names = "default", "pins_poweron", "pins_poweroff";
				pinctrl-0 = <0x1e>;
				pinctrl-1 = <0x1f 0x20 0x21 0x22>;
				pinctrl-2 = <0x23 0x24>;
				gpio-controller;
				#gpio-cells = <0x2>;
				etspi-sleepPin = <0xffffffff 0x0 0x0>;
				etspi-regulator = "VDD_BTP_3P3";
				etspi-chipid = "ET713";
				etspi-modelinfo = "A507";
				etspi-position = "13.77,0.00,7.29,7.29,14.80,14.80,12.00,12.00,5.00";

				controller-data {
					cs-gpio = <0xffffffff 0x7 0x0>;
					samsung,spi-feedback-delay = <0x0>;
					samsung,spi-chip-select-mode = <0x0>;
				};
			};
		};
	};

	fragment@47 {
		target = <0xffffffff>;

		__overlay__ {
			os-type = "sensorhub/shub_exynos9611_a50s.fw";
			chub-irq-pin-len = <0x0>;
			chub-irq-pin;
			clocks = <0xffffffff 0x258 0xffffffff 0x7d>;
			clock-names = "chub_bus", "cmgp_i2c";
			sensor-ldo-en = <0xffffffff 0x0 0x1>;
			ssp-acc-position = <0x4>;
			ssp-mag-position = <0x2>;
			ssp-prox-thresh-addval = [00 50 00 14 00 1e];
			ssp-mag-array = [e9 59 80 8d f3 74 ff eb d2 36 ec 15 5f 81 fe 39 ff de c3 7c c3 fc d0 7a 09 5c d1];
			ssp-light-position = <0x33 0x56 0x2 0x4e 0x1 0x8>;
			ssp-light-cam-lux = <0x64 0xc8>;
			ssp-light-cam-br = <0x3c 0x3c>;
		};
	};

	fragment@48 {
		target = <0xffffffff>;

		__overlay__ {
			pinctrl-names = "default";
			pinctrl-0 = <0x25>;

			initial-state {
				linux,phandle = <0x25>;
				phandle = <0x25>;

				gpa0-6 {
					samsung,pins = "gpa0-6";
					samsung,pin-function = <0x0>;
					samsung,pin-pud = <0x1>;
				};
			};
		};
	};

	fragment@49 {
		target = <0xffffffff>;

		__overlay__ {
			pinctrl-names = "default";
			pinctrl-0 = <0x26>;

			initial-state {
				linux,phandle = <0x26>;
				phandle = <0x26>;

				gpm0-0 {
					samsung,pins = "gpm0-0";
					samsung,pin-function = <0x0>;
					samsung,pin-pud = <0x1>;
				};
			};
		};
	};

	fragment@50 {
		target = <0xffffffff>;

		__overlay__ {
			pinctrl-names = "sleep";
			pinctrl-0 = <0x27>;

			sleep-state {
				linux,phandle = <0x27>;
				phandle = <0x27>;

				gpb2-0 {
					samsung,pins = "gpb2-0";
					samsung,pin-con-pdn = <0x2>;
					samsung,pin-pud-pdn = <0x1>;
				};

				gpb2-1 {
					samsung,pins = "gpb2-1";
					samsung,pin-con-pdn = <0x2>;
					samsung,pin-pud-pdn = <0x1>;
				};

				gpb2-2 {
					samsung,pins = "gpb2-2";
					samsung,pin-con-pdn = <0x2>;
					samsung,pin-pud-pdn = <0x1>;
				};

				gpb2-3 {
					samsung,pins = "gpb2-3";
					samsung,pin-con-pdn = <0x2>;
					samsung,pin-pud-pdn = <0x1>;
				};

				gpb2-4 {
					samsung,pins = "gpb2-4";
					samsung,pin-con-pdn = <0x2>;
					samsung,pin-pud-pdn = <0x1>;
				};
			};
		};
	};

	fragment@51 {
		target = <0xffffffff>;

		__overlay__ {
			pinctrl-names = "default", "sleep";
			pinctrl-0 = <0x28>;
			pinctrl-1 = <0x29>;

			initial-state {
				linux,phandle = <0x28>;
				phandle = <0x28>;

				gpp0-4 {
					samsung,pins = "gpp0-4";
					samsung,pin-function = <0x0>;
					samsung,pin-pud = <0x0>;
				};

				gpp0-5 {
					samsung,pins = "gpp0-5";
					samsung,pin-function = <0x0>;
					samsung,pin-pud = <0x0>;
				};

				gpc2-4 {
					samsung,pins = "gpc2-4";
					samsung,pin-function = <0x0>;
					samsung,pin-pud = <0x1>;
				};

				gpg0-7 {
					samsung,pins = "gpg0-7";
					samsung,pin-function = <0x0>;
					samsung,pin-pud = <0x1>;
				};

				gpg1-4 {
					samsung,pins = "gpg1-4";
					samsung,pin-function = <0x0>;
					samsung,pin-pud = <0x1>;
				};

				gpg1-5 {
					samsung,pins = "gpg1-5";
					samsung,pin-function = <0x1>;
					samsung,pin-pud = <0x0>;
					samsung,pin-drv = <0x0>;
					samsung,pin-val = <0x1>;
				};

				gpg2-1 {
					samsung,pins = "gpg2-1";
					samsung,pin-function = <0x1>;
					samsung,pin-pud = <0x0>;
					samsung,pin-drv = <0x0>;
					samsung,pin-val = <0x1>;
				};

				gpg2-5 {
					samsung,pins = "gpg2-5";
					samsung,pin-function = <0x0>;
					samsung,pin-pud = <0x0>;
				};

				gpg2-6 {
					samsung,pins = "gpg2-6";
					samsung,pin-function = <0x0>;
					samsung,pin-pud = <0x0>;
				};

				gpg3-1 {
					samsung,pins = "gpg3-1";
					samsung,pin-function = <0x1>;
					samsung,pin-pud = <0x0>;
					samsung,pin-drv = <0x0>;
					samsung,pin-val = <0x1>;
				};

				gpg3-2 {
					samsung,pins = "gpg3-2";
					samsung,pin-function = <0x0>;
					samsung,pin-pud = <0x0>;
				};

				gpg3-3 {
					samsung,pins = "gpg3-3";
					samsung,pin-function = <0x0>;
					samsung,pin-pud = <0x0>;
				};

				gpg3-4 {
					samsung,pins = "gpg3-4";
					samsung,pin-function = <0x0>;
					samsung,pin-pud = <0x0>;
				};

				gpg3-5 {
					samsung,pins = "gpg3-5";
					samsung,pin-function = <0x0>;
					samsung,pin-pud = <0x0>;
				};
			};

			sleep-state {
				linux,phandle = <0x29>;
				phandle = <0x29>;

				gpp0-0 {
					samsung,pins = "gpp0-0";
					samsung,pin-con-pdn = <0x2>;
					samsung,pin-pud-pdn = <0x0>;
				};

				gpp0-1 {
					samsung,pins = "gpp0-1";
					samsung,pin-con-pdn = <0x2>;
					samsung,pin-pud-pdn = <0x0>;
				};

				gpp0-2 {
					samsung,pins = "gpp0-2";
					samsung,pin-con-pdn = <0x2>;
					samsung,pin-pud-pdn = <0x0>;
				};

				gpp0-3 {
					samsung,pins = "gpp0-3";
					samsung,pin-con-pdn = <0x2>;
					samsung,pin-pud-pdn = <0x0>;
				};

				gpp0-4 {
					samsung,pins = "gpp0-4";
					samsung,pin-con-pdn = <0x2>;
					samsung,pin-pud-pdn = <0x0>;
				};

				gpp0-5 {
					samsung,pins = "gpp0-5";
					samsung,pin-con-pdn = <0x2>;
					samsung,pin-pud-pdn = <0x0>;
				};

				gpp0-6 {
					samsung,pins = "gpp0-6";
					samsung,pin-con-pdn = <0x2>;
					samsung,pin-pud-pdn = <0x0>;
				};

				gpp0-7 {
					samsung,pins = "gpp0-7";
					samsung,pin-con-pdn = <0x2>;
					samsung,pin-pud-pdn = <0x0>;
				};

				gpp1-0 {
					samsung,pins = "gpp1-0";
					samsung,pin-con-pdn = <0x2>;
					samsung,pin-pud-pdn = <0x0>;
				};

				gpp1-1 {
					samsung,pins = "gpp1-1";
					samsung,pin-con-pdn = <0x2>;
					samsung,pin-pud-pdn = <0x0>;
				};

				gpp1-2 {
					samsung,pins = "gpp1-2";
					samsung,pin-con-pdn = <0x2>;
					samsung,pin-pud-pdn = <0x0>;
				};

				gpp1-3 {
					samsung,pins = "gpp1-3";
					samsung,pin-con-pdn = <0x2>;
					samsung,pin-pud-pdn = <0x0>;
				};

				gpp1-4 {
					samsung,pins = "gpp1-4";
					samsung,pin-con-pdn = <0x2>;
					samsung,pin-pud-pdn = <0x0>;
				};

				gpp1-5 {
					samsung,pins = "gpp1-5";
					samsung,pin-con-pdn = <0x2>;
					samsung,pin-pud-pdn = <0x0>;
				};

				gpc1-2 {
					samsung,pins = "gpc1-2";
					samsung,pin-con-pdn = <0x2>;
					samsung,pin-pud-pdn = <0x1>;
				};

				gpc1-3 {
					samsung,pins = "gpc1-3";
					samsung,pin-con-pdn = <0x2>;
					samsung,pin-pud-pdn = <0x1>;
				};

				gpc2-2 {
					samsung,pins = "gpc2-2";
					samsung,pin-con-pdn = <0x2>;
					samsung,pin-pud-pdn = <0x1>;
				};

				gpc2-4 {
					samsung,pins = "gpc2-4";
					samsung,pin-con-pdn = <0x2>;
					samsung,pin-pud-pdn = <0x1>;
				};

				gpg0-5 {
					samsung,pins = "gpg0-5";
					samsung,pin-con-pdn = <0x3>;
					samsung,pin-pud-pdn = <0x0>;
				};

				gpg0-6 {
					samsung,pins = "gpg0-6";
					samsung,pin-con-pdn = <0x0>;
					samsung,pin-pud-pdn = <0x1>;
				};

				gpg0-7 {
					samsung,pins = "gpg0-7";
					samsung,pin-con-pdn = <0x2>;
					samsung,pin-pud-pdn = <0x1>;
				};

				gpg1-2 {
					samsung,pins = "gpg1-2";
					samsung,pin-con-pdn = <0x3>;
					samsung,pin-pud-pdn = <0x0>;
				};

				gpg1-3 {
					samsung,pins = "gpg1-3";
					samsung,pin-con-pdn = <0x3>;
					samsung,pin-pud-pdn = <0x0>;
				};

				gpg1-4 {
					samsung,pins = "gpg1-4";
					samsung,pin-con-pdn = <0x2>;
					samsung,pin-pud-pdn = <0x1>;
				};

				gpg1-5 {
					samsung,pins = "gpg1-5";
					samsung,pin-con-pdn = <0x1>;
					samsung,pin-pud-pdn = <0x0>;
				};

				gpg2-1 {
					samsung,pins = "gpg2-1";
					samsung,pin-con-pdn = <0x3>;
					samsung,pin-pud-pdn = <0x0>;
				};

				gpg2-3 {
					samsung,pins = "gpg2-3";
					samsung,pin-con-pdn = <0x3>;
					samsung,pin-pud-pdn = <0x1>;
				};

				gpg2-4 {
					samsung,pins = "gpg2-4";
					samsung,pin-con-pdn = <0x3>;
					samsung,pin-pud-pdn = <0x0>;
				};

				gpg2-5 {
					samsung,pins = "gpg2-5";
					samsung,pin-con-pdn = <0x2>;
					samsung,pin-pud-pdn = <0x0>;
				};

				gpg2-6 {
					samsung,pins = "gpg2-6";
					samsung,pin-con-pdn = <0x2>;
					samsung,pin-pud-pdn = <0x0>;
				};

				gpg3-0 {
					samsung,pins = "gpg3-0";
					samsung,pin-con-pdn = <0x0>;
					samsung,pin-pud-pdn = <0x1>;
				};

				gpg3-1 {
					samsung,pins = "gpg3-1";
					samsung,pin-con-pdn = <0x3>;
					samsung,pin-pud-pdn = <0x0>;
				};

				gpg3-2 {
					samsung,pins = "gpg3-2";
					samsung,pin-con-pdn = <0x2>;
					samsung,pin-pud-pdn = <0x0>;
				};

				gpg3-3 {
					samsung,pins = "gpg3-3";
					samsung,pin-con-pdn = <0x2>;
					samsung,pin-pud-pdn = <0x0>;
				};

				gpg3-4 {
					samsung,pins = "gpg3-4";
					samsung,pin-con-pdn = <0x2>;
					samsung,pin-pud-pdn = <0x0>;
				};

				gpg3-5 {
					samsung,pins = "gpg3-5";
					samsung,pin-con-pdn = <0x2>;
					samsung,pin-pud-pdn = <0x0>;
				};

				gpg4-0 {
					samsung,pins = "gpg4-0";
					samsung,pin-con-pdn = <0x3>;
					samsung,pin-pud-pdn = <0x0>;
				};

				gpg4-2 {
					samsung,pins = "gpg4-2";
					samsung,pin-con-pdn = <0x3>;
					samsung,pin-pud-pdn = <0x0>;
				};
			};
		};
	};

	fragment@52 {
		target = <0xffffffff>;

		__overlay__ {
		};
	};

	fragment@53 {
		target = <0xffffffff>;

		__overlay__ {
			#address-cells = <0x1>;
			#size-cells = <0x0>;
			status = "okay";

			tfa98xx@34 {
				status = "okay";
				compatible = "nxp,tfa98xx";
				#sound-dai-cells = <0x1>;
				reg = <0x34>;
				linux,phandle = <0x16>;
				phandle = <0x16>;
			};
		};
	};

	fragment@54 {
		target = <0xffffffff>;

		__overlay__ {

			earant-det {
				samsung,pins = "gpa1-4";
				samsung,pin-function = <0xf>;
				samsung,pin-pud = <0x0>;
				linux,phandle = <0x62>;
				phandle = <0x62>;
			};

			grip-int {
				samsung,pins = "gpa2-5";
				samsung,pin-function = <0xf>;
				samsung,pin-pud = <0x0>;
				linux,phandle = <0x17>;
				phandle = <0x17>;
			};

			grip-sub-int {
				samsung,pins = "gpa2-7";
				samsung,pin-function = <0xf>;
				samsung,pin-pud = <0x0>;
				linux,phandle = <0x15>;
				phandle = <0x15>;
			};
		};
	};

	__symbols__ {
		shmem = "/fragment@modemif/__overlay__/shmem@F0000000";
		decon_board_ea8076 = "/fragment@lcd/__overlay__/decon_board_ea8076";
		ea8076 = "/fragment@lcd/__overlay__/ea8076";
		fimc_is_sensor_imx582 = "/fragment@camera/__overlay__/fimc-fimc_is_sensor_imx582@1A";
		fimc_is_flash_gpio = "/fragment@camera/__overlay__/fimc-is-flash-gpio@0";
		fimc_is_module_gc5035 = "/fragment@camera/__overlay__/fimc-is_sensor_gc5035@6E";
		fimc_is_sensor_4ha = "/fragment@camera/__overlay__/fimc-is_sensor_4ha@5A";
		fimc_is_sensor_imx616 = "/fragment@camera/__overlay__/fimc-is_sensor_imx616@1A";
		sensor3_ch_mode0 = "/fragment@13/__overlay__/sensor3-ch-mode0";
		dummy_audio_codec = "/fragment@sound/__overlay__/audio_codec_dummy";
		dummy_audio_cpu = "/fragment@sound/__overlay__/audio_cpu_dummy";
		ext_bin_0 = "/fragment@14/__overlay__/ext_bin@0";
		ext_bin_1 = "/fragment@14/__overlay__/ext_bin@1";
		ext_bin_2 = "/fragment@14/__overlay__/ext_bin@2";
		ext_bin_4 = "/fragment@14/__overlay__/ext_bin@4";
		ext_bin_5 = "/fragment@14/__overlay__/ext_bin@5";
		rt5510_amp = "/fragment@15/__overlay__/rt5510@34";
		rt5665 = "/fragment@16/__overlay__/rt5665@1b";
		b1_reg = "/fragment@model/__overlay__/speedy@11a10000/s2mpu09mfd@00/regulators/BUCK1";
		b2_reg = "/fragment@model/__overlay__/speedy@11a10000/s2mpu09mfd@00/regulators/BUCK2";
		b3_reg = "/fragment@model/__overlay__/speedy@11a10000/s2mpu09mfd@00/regulators/BUCK3";
		b4_reg = "/fragment@model/__overlay__/speedy@11a10000/s2mpu09mfd@00/regulators/BUCK4";
		b5_reg = "/fragment@model/__overlay__/speedy@11a10000/s2mpu09mfd@00/regulators/BUCK5";
		b6_reg = "/fragment@model/__overlay__/speedy@11a10000/s2mpu09mfd@00/regulators/BUCK6";
		b7_reg = "/fragment@model/__overlay__/speedy@11a10000/s2mpu09mfd@00/regulators/BUCK7";
		b8_reg = "/fragment@model/__overlay__/speedy@11a10000/s2mpu09mfd@00/regulators/BUCK8";
		b9_reg = "/fragment@model/__overlay__/speedy@11a10000/s2mpu09mfd@00/regulators/BUCK9";
		l1_reg = "/fragment@model/__overlay__/speedy@11a10000/s2mpu09mfd@00/regulators/LDO1";
		l2_reg = "/fragment@model/__overlay__/speedy@11a10000/s2mpu09mfd@00/regulators/LDO2";
		l3_reg = "/fragment@model/__overlay__/speedy@11a10000/s2mpu09mfd@00/regulators/LDO3";
		l4_reg = "/fragment@model/__overlay__/speedy@11a10000/s2mpu09mfd@00/regulators/LDO4";
		l5_reg = "/fragment@model/__overlay__/speedy@11a10000/s2mpu09mfd@00/regulators/LDO5";
		l6_reg = "/fragment@model/__overlay__/speedy@11a10000/s2mpu09mfd@00/regulators/LDO6";
		l7_reg = "/fragment@model/__overlay__/speedy@11a10000/s2mpu09mfd@00/regulators/LDO7";
		l8_reg = "/fragment@model/__overlay__/speedy@11a10000/s2mpu09mfd@00/regulators/LDO8";
		l9_reg = "/fragment@model/__overlay__/speedy@11a10000/s2mpu09mfd@00/regulators/LDO9";
		l10_reg = "/fragment@model/__overlay__/speedy@11a10000/s2mpu09mfd@00/regulators/LDO10";
		l11_reg = "/fragment@model/__overlay__/speedy@11a10000/s2mpu09mfd@00/regulators/LDO11";
		l12_reg = "/fragment@model/__overlay__/speedy@11a10000/s2mpu09mfd@00/regulators/LDO12";
		l13_reg = "/fragment@model/__overlay__/speedy@11a10000/s2mpu09mfd@00/regulators/LDO13";
		l14_reg = "/fragment@model/__overlay__/speedy@11a10000/s2mpu09mfd@00/regulators/LDO14";
		l33_reg = "/fragment@model/__overlay__/speedy@11a10000/s2mpu09mfd@00/regulators/LDO33";
		l34_reg = "/fragment@model/__overlay__/speedy@11a10000/s2mpu09mfd@00/regulators/LDO34";
		l35_reg = "/fragment@model/__overlay__/speedy@11a10000/s2mpu09mfd@00/regulators/LDO35";
		l36_reg = "/fragment@model/__overlay__/speedy@11a10000/s2mpu09mfd@00/regulators/LDO36";
		l37_reg = "/fragment@model/__overlay__/speedy@11a10000/s2mpu09mfd@00/regulators/LDO37";
		l38_reg = "/fragment@model/__overlay__/speedy@11a10000/s2mpu09mfd@00/regulators/LDO38";
		l39_reg = "/fragment@model/__overlay__/speedy@11a10000/s2mpu09mfd@00/regulators/LDO39";
		l40_reg = "/fragment@model/__overlay__/speedy@11a10000/s2mpu09mfd@00/regulators/LDO40";
		l41_reg = "/fragment@model/__overlay__/speedy@11a10000/s2mpu09mfd@00/regulators/LDO41";
		l42_reg = "/fragment@model/__overlay__/speedy@11a10000/s2mpu09mfd@00/regulators/LDO42";
		l43_reg = "/fragment@model/__overlay__/speedy@11a10000/s2mpu09mfd@00/regulators/LDO43";
		l44_reg = "/fragment@model/__overlay__/speedy@11a10000/s2mpu09mfd@00/regulators/LDO44";
		mailbox_cp = "/fragment@model/__overlay__/mcu_ipc@11920000";
		mailbox_gnss = "/fragment@model/__overlay__/mcu_ipc@11A00000";
		i2c_4 = "/fragment@model/__overlay__/i2c@13870000";
		V_SYS = "/fragment@model/__overlay__/fixedregulator@1";
		usb_hs_tune = "/fragment@model/__overlay__/usb_hs_tune";
		usb3_ss_tune = "/fragment@model/__overlay__/usb3_ss_tune";
		usb3_hs_tune = "/fragment@model/__overlay__/usb3_hs_tune";
		key_voldown = "/fragment@23/__overlay__/key-voldown";
		key_volup = "/fragment@23/__overlay__/key-volup";
		key_power = "/fragment@23/__overlay__/key-power";
		attn_irq = "/fragment@23/__overlay__/attn-irq";
		attn_input = "/fragment@23/__overlay__/attn-input";
		if_pmic_irq = "/fragment@23/__overlay__/if-pmic-irq";
		pmic_irq = "/fragment@23/__overlay__/pmic-irq";
		codec_irq = "/fragment@23/__overlay__/codec_irq";
		dwmmc2_cd_ext_irq = "/fragment@23/__overlay__/dwmmc2_cd_ext_irq";
		hall_irq = "/fragment@23/__overlay__/hall-irq";
		certify_hall_irq = "/fragment@23/__overlay__/certify-hall-irq";
		usbpd_irq = "/fragment@23/__overlay__/usbpd-irq";
		pm_wrsti = "/fragment@24/__overlay__/pm-wrsti";
		grip_sub_i2c = "/fragment@24/__overlay__/grip-sub-i2c";
		__ldo1_reg = "/fragment@43/__overlay__/s2mpb03@56/regulators/s2mpb03-ldo1";
		__ldo2_reg = "/fragment@43/__overlay__/s2mpb03@56/regulators/s2mpb03-ldo2";
		__ldo3_reg = "/fragment@43/__overlay__/s2mpb03@56/regulators/s2mpb03-ldo3";
		__ldo4_reg = "/fragment@43/__overlay__/s2mpb03@56/regulators/s2mpb03-ldo4";
		__ldo5_reg = "/fragment@43/__overlay__/s2mpb03@56/regulators/s2mpb03-ldo5";
		__ldo6_reg = "/fragment@43/__overlay__/s2mpb03@56/regulators/s2mpb03-ldo6";
		__ldo7_reg = "/fragment@43/__overlay__/s2mpb03@56/regulators/s2mpb03-ldo7";
		chg_en = "/fragment@44/__overlay__/chg-en";
		btp_rst = "/fragment@45/__overlay__/btp-rst";
		spi7_bus_inactive = "/fragment@45/__overlay__/spi7-bus-inactive";
		spi7_miso_inactive = "/fragment@45/__overlay__/spi17-miso-inactive";
		spi7_clk = "/fragment@45/__overlay__/spi7-clk";
		spi7_cs = "/fragment@45/__overlay__/spi7-cs";
		spi7_miso = "/fragment@45/__overlay__/spi7-miso";
		spi7_mosi = "/fragment@45/__overlay__/spi7-mosi";
		initial0 = "/fragment@48/__overlay__/initial-state";
		initial1 = "/fragment@49/__overlay__/initial-state";
		sleep2 = "/fragment@50/__overlay__/sleep-state";
		initial4 = "/fragment@51/__overlay__/initial-state";
		sleep4 = "/fragment@51/__overlay__/sleep-state";
		tfa98xx = "/fragment@53/__overlay__/tfa98xx@34";
		earant_det = "/fragment@54/__overlay__/earant-det";
		grip_int = "/fragment@54/__overlay__/grip-int";
		grip_sub_int = "/fragment@54/__overlay__/grip-sub-int";
	};

	__fixups__ {
		gpa0 = "/fragment@lcd/__overlay__/decon_board_ea8076:gpio_pcd:0", "/fragment@lcd/__overlay__/decon_board_ea8076:gpio_con:0", "/fragment@model/__overlay__/i2c@13870000/mms_ts@48:melfas,irq-gpio:0", "/fragment@model/__overlay__/hall:hall,gpio_flip_cover:0", "/fragment@model/__overlay__/certify_hall:certify_hall,gpio_certify_cover:0";
		gpa1 = "/fragment@lcd/__overlay__/decon_board_ea8076:gpio_err:0", "/fragment@camera/__overlay__/fimc-is-flash-gpio@0:torch-gpio:0", "/fragment@9/__overlay__/sm5713-fled@49/sm5713-fled@0:torch-en-gpio:0", "/fragment@16/__overlay__/rt5665@1b:interrupt-parent:0", "/fragment@model/__overlay__/gpio_keys/button@2:gpios:0", "/fragment@model/__overlay__/gpio_keys/button@3:gpios:0", "/fragment@model/__overlay__/gpio_keys/button@4:gpios:0";
		gpg1 = "/fragment@lcd/__overlay__/decon_board_ea8076:gpio_lcd_rst:0", "/fragment@lcd/__overlay__/decon_board_ea8076:gpio_lcd_en_1p8:0", "/fragment@camera/__overlay__/fimc-fimc_is_sensor_imx582@1A:gpio_reset:0", "/fragment@camera/__overlay__/fimc-is_sensor_4ha@5A:gpio_reset:0", "/fragment@camera/__overlay__/fimc-is_sensor_4ha@5A:gpio_cam_a2p8_en:0", "/fragment@camera/__overlay__/fimc-is_sensor_imx616@1A:gpio_reset:0";
		gpg2 = "/fragment@lcd/__overlay__/decon_board_ea8076:gpio_lcd_en_3p0:0", "/fragment@model/__overlay__/fpcb_type:gpios:0", "/fragment@model/__overlay__/fpcb_type:gpios:12", "/fragment@model/__overlay__/fpcb_type:gpios:24";
		dsim_0 = "/fragment@0:target:0";
		decon_f = "/fragment@1:target:0";
		fimc_is_mclk0_out = "/fragment@camera/__overlay__/fimc-fimc_is_sensor_imx582@1A:pinctrl-0:0", "/fragment@camera/__overlay__/fimc-is_sensor_gc5035@6E:pinctrl-1:0", "/fragment@2/__overlay__:pinctrl-0:0";
		fimc_is_mclk0_fn = "/fragment@camera/__overlay__/fimc-fimc_is_sensor_imx582@1A:pinctrl-1:0", "/fragment@camera/__overlay__/fimc-is_sensor_gc5035@6E:pinctrl-2:0";
		gpc2 = "/fragment@camera/__overlay__/fimc-fimc_is_sensor_imx582@1A:gpio_mclk:0", "/fragment@camera/__overlay__/fimc-is_sensor_gc5035@6E:gpio_mclk:0", "/fragment@camera/__overlay__/fimc-is_sensor_4ha@5A:gpio_mclk:0", "/fragment@camera/__overlay__/fimc-is_sensor_imx616@1A:gpio_mclk:0";
		gpm22 = "/fragment@camera/__overlay__/fimc-fimc_is_sensor_imx582@1A:gpio_ldo_en:0";
		gpg0 = "/fragment@camera/__overlay__/fimc-is-flash-gpio@0:flash-gpio:0", "/fragment@camera/__overlay__/fimc-is_sensor_gc5035@6E:gpio_reset:0", "/fragment@9/__overlay__/sm5713-fled@49/sm5713-fled@0:flash-en-gpio:0", "/fragment@model/__overlay__/sec-mst:sec-mst,mst-support-gpio:0";
		fimc_is_mclk2_out = "/fragment@camera/__overlay__/fimc-is_sensor_4ha@5A:pinctrl-1:0", "/fragment@2/__overlay__:pinctrl-0:8";
		fimc_is_mclk2_fn = "/fragment@camera/__overlay__/fimc-is_sensor_4ha@5A:pinctrl-2:0";
		fimc_is_mclk1_out = "/fragment@camera/__overlay__/fimc-is_sensor_imx616@1A:pinctrl-1:0", "/fragment@2/__overlay__:pinctrl-0:4";
		fimc_is_mclk1_fn = "/fragment@camera/__overlay__/fimc-is_sensor_imx616@1A:pinctrl-2:0";
		fimc_is = "/fragment@2:target:0";
		hsi2c_12 = "/fragment@3:target:0";
		gpc0 = "/fragment@3/__overlay__:gpios:0", "/fragment@3/__overlay__:gpios:12", "/fragment@4/__overlay__:gpios:0", "/fragment@4/__overlay__:gpios:12", "/fragment@5/__overlay__:gpios:0", "/fragment@5/__overlay__:gpios:12", "/fragment@6/__overlay__:gpios:0", "/fragment@6/__overlay__:gpios:12";
		hsi2c12_bus = "/fragment@3/__overlay__:pinctrl-0:0", "/fragment@3/__overlay__:pinctrl-1:0", "/fragment@3/__overlay__:pinctrl-2:0";
		hsi2c_13 = "/fragment@4:target:0";
		hsi2c13_bus = "/fragment@4/__overlay__:pinctrl-0:0", "/fragment@4/__overlay__:pinctrl-1:0", "/fragment@4/__overlay__:pinctrl-2:0";
		hsi2c_14 = "/fragment@5:target:0";
		hsi2c14_bus = "/fragment@5/__overlay__:pinctrl-0:0", "/fragment@5/__overlay__:pinctrl-1:0", "/fragment@5/__overlay__:pinctrl-2:0";
		hsi2c_15 = "/fragment@6:target:0";
		hsi2c15_bus = "/fragment@6/__overlay__:pinctrl-0:0", "/fragment@6/__overlay__:pinctrl-1:0", "/fragment@6/__overlay__:pinctrl-2:0";
		hsi2c_16 = "/fragment@7:target:0";
		gpc1 = "/fragment@7/__overlay__:gpios:0", "/fragment@7/__overlay__:gpios:12", "/fragment@8/__overlay__:gpios:0", "/fragment@8/__overlay__:gpios:12";
		hsi2c16_bus = "/fragment@7/__overlay__:pinctrl-0:0", "/fragment@7/__overlay__:pinctrl-1:0", "/fragment@7/__overlay__:pinctrl-2:0";
		hsi2c_17 = "/fragment@8:target:0";
		hsi2c17_bus = "/fragment@8/__overlay__:pinctrl-0:0", "/fragment@8/__overlay__:pinctrl-1:0", "/fragment@8/__overlay__:pinctrl-2:0";
		i2c_1 = "/fragment@9:target:0", "/fragment@42:target:0";
		fimc_is_sensor0 = "/fragment@10:target:0";
		fimc_is_sensor1 = "/fragment@11:target:0";
		mipi_phy_csis_m2s4s4s2 = "/fragment@11/__overlay__:phys:0", "/fragment@13/__overlay__:phys:0";
		fimc_is_sensor2 = "/fragment@12:target:0";
		fimc_is_sensor3 = "/fragment@13:target:0";
		clock = "/fragment@sound/__overlay__/sound:clocks:0", "/fragment@47/__overlay__:clocks:0", "/fragment@47/__overlay__:clocks:8";
		xclkout0 = "/fragment@sound/__overlay__/sound:pinctrl-0:0";
		abox = "/fragment@sound/__overlay__/sound:samsung,codec:0", "/fragment@sound/__overlay__/sound/rdma@0/cpu:sound-dai:0", "/fragment@sound/__overlay__/sound/rdma@1/cpu:sound-dai:0", "/fragment@sound/__overlay__/sound/rdma@2/cpu:sound-dai:0", "/fragment@sound/__overlay__/sound/rdma@3/cpu:sound-dai:0", "/fragment@sound/__overlay__/sound/rdma@4/cpu:sound-dai:0", "/fragment@sound/__overlay__/sound/rdma@5/cpu:sound-dai:0", "/fragment@sound/__overlay__/sound/rdma@6/cpu:sound-dai:0", "/fragment@sound/__overlay__/sound/rdma@7/cpu:sound-dai:0", "/fragment@sound/__overlay__/sound/wdma@0/cpu:sound-dai:0", "/fragment@sound/__overlay__/sound/wdma@1/cpu:sound-dai:0", "/fragment@sound/__overlay__/sound/wdma@2/cpu:sound-dai:0", "/fragment@sound/__overlay__/sound/wdma@3/cpu:sound-dai:0", "/fragment@sound/__overlay__/sound/wdma@4/cpu:sound-dai:0", "/fragment@sound/__overlay__/sound/sifs0@0/cpu:sound-dai:0", "/fragment@sound/__overlay__/sound/sifs1@0/cpu:sound-dai:0", "/fragment@sound/__overlay__/sound/sifs2@0/cpu:sound-dai:0", "/fragment@14:target:0", "/fragment@52:target:0";
		abox_uaif_0 = "/fragment@sound/__overlay__/sound:samsung,codec:4", "/fragment@sound/__overlay__/sound/uaif@0/cpu:sound-dai:0";
		abox_uaif_1 = "/fragment@sound/__overlay__/sound:samsung,codec:8", "/fragment@sound/__overlay__/sound/uaif@1/cpu:sound-dai:0";
		abox_uaif_2 = "/fragment@sound/__overlay__/sound:samsung,codec:12", "/fragment@sound/__overlay__/sound/uaif@2/cpu:sound-dai:0";
		abox_uaif_4 = "/fragment@sound/__overlay__/sound:samsung,codec:16", "/fragment@sound/__overlay__/sound/uaif@4/cpu:sound-dai:0";
		abox_dsif = "/fragment@sound/__overlay__/sound:samsung,codec:20", "/fragment@sound/__overlay__/sound/dsif@0/cpu:sound-dai:0";
		abox_spdy = "/fragment@sound/__overlay__/sound:samsung,codec:24", "/fragment@sound/__overlay__/sound/spdy@0/cpu:sound-dai:0";
		abox_effect = "/fragment@sound/__overlay__/sound:samsung,aux:0";
		abox_bt = "/fragment@sound/__overlay__/sound:samsung,aux:4";
		abox_rdma_0 = "/fragment@sound/__overlay__/sound/rdma@0/platform:sound-dai:0";
		abox_rdma_1 = "/fragment@sound/__overlay__/sound/rdma@1/platform:sound-dai:0";
		abox_rdma_2 = "/fragment@sound/__overlay__/sound/rdma@2/platform:sound-dai:0";
		abox_rdma_3 = "/fragment@sound/__overlay__/sound/rdma@3/platform:sound-dai:0";
		abox_rdma_4 = "/fragment@sound/__overlay__/sound/rdma@4/platform:sound-dai:0";
		abox_rdma_5 = "/fragment@sound/__overlay__/sound/rdma@5/platform:sound-dai:0";
		abox_rdma_6 = "/fragment@sound/__overlay__/sound/rdma@6/platform:sound-dai:0";
		abox_rdma_7 = "/fragment@sound/__overlay__/sound/rdma@7/platform:sound-dai:0";
		abox_wdma_0 = "/fragment@sound/__overlay__/sound/wdma@0/platform:sound-dai:0";
		abox_wdma_1 = "/fragment@sound/__overlay__/sound/wdma@1/platform:sound-dai:0";
		abox_wdma_2 = "/fragment@sound/__overlay__/sound/wdma@2/platform:sound-dai:0";
		abox_wdma_3 = "/fragment@sound/__overlay__/sound/wdma@3/platform:sound-dai:0";
		abox_wdma_4 = "/fragment@sound/__overlay__/sound/wdma@4/platform:sound-dai:0";
		abox_synchronized_ipc = "/fragment@sound/__overlay__/sound/uaif@2/platform:sound-dai:0";
		hsi2c_3 = "/fragment@15:target:0", "/fragment@53:target:0";
		i2c_6 = "/fragment@16:target:0";
		gpm12 = "/fragment@model/__overlay__/sec-mst:sec-mst,mst-pwr-gpio:0";
		gpm14 = "/fragment@model/__overlay__/sec-mst:sec-mst,mst-en-gpio:0";
		gpm13 = "/fragment@model/__overlay__/sec-mst:sec-mst,mst-data-gpio:0";
		gpa2 = "/fragment@model/__overlay__/speedy@11a10000/s2mpu09mfd@00:s2mpu09,irq-gpio:0", "/fragment@model/__overlay__/speedy@11a10000/s2mpu09mfd@00:interrupt-parent:0", "/fragment@model/__overlay__/dwmmc2@13550000:card-detect:0", "/fragment@model/__overlay__/i2c@20/sx9360_sub-i2c@28:interrupt-parent:0", "/fragment@model/__overlay__/i2c@20/sx9360_sub-i2c@28:sx9360_sub,nirq-gpio:0", "/fragment@model/__overlay__/sec_vib/sec_vib_pdata:sec_vib,ldo_en:0", "/fragment@17/__overlay__/sx9360-i2c@28:interrupt-parent:0", "/fragment@17/__overlay__/sx9360-i2c@28:sx9360,nirq-gpio:0", "/fragment@41/__overlay__/usbpd-5713@33:usbpd,usbpd_int:0", "/fragment@42/__overlay__/sm5713@49:sm5713,irq-gpio:0";
		exynos_adc = "/fragment@model/__overlay__/sec_thermistor@0:io-channels:0", "/fragment@model/__overlay__/sec_thermistor@6:io-channels:0", "/fragment@battery/__overlay__/battery:io-channels:0", "/fragment@battery/__overlay__/battery:io-channels:8", "/fragment@battery/__overlay__/battery:io-channels:16";
		gpg3 = "/fragment@model/__overlay__/mif_pdata:gpios:0", "/fragment@model/__overlay__/mif_pdata:gpios:12", "/fragment@model/__overlay__/mif_pdata:gpios:24", "/fragment@model/__overlay__/mif_pdata:gpios:36", "/fragment@model/__overlay__/tsp_ldo_en:gpio:0", "/fragment@46/__overlay__/etspi-spi@0:etspi-sleepPin:0";
		gnss_reserved = "/fragment@model/__overlay__/gnss_pdata:memory-region:0";
		gpp1 = "/fragment@model/__overlay__/i2c@13870000/mms_ts@48:melfas,scl-gpio:0", "/fragment@model/__overlay__/i2c@13870000/mms_ts@48:melfas,sda-gpio:0", "/fragment@model/__overlay__/i2c@20:gpios:0", "/fragment@model/__overlay__/i2c@20:gpios:12";
		udc = "/fragment@model/__overlay__/usb_notifier:udc:0", "/fragment@18:target:0";
		sd2_clk = "/fragment@model/__overlay__/dwmmc2@13550000:pinctrl-0:0";
		sd2_cmd = "/fragment@model/__overlay__/dwmmc2@13550000:pinctrl-0:4";
		sd2_bus1 = "/fragment@model/__overlay__/dwmmc2@13550000:pinctrl-0:8";
		sd2_bus4 = "/fragment@model/__overlay__/dwmmc2@13550000:pinctrl-0:12";
		sd2_clk_fast_slew_rate_1x = "/fragment@model/__overlay__/dwmmc2@13550000:pinctrl-1:0";
		sd2_clk_fast_slew_rate_2x = "/fragment@model/__overlay__/dwmmc2@13550000:pinctrl-2:0";
		sd2_clk_fast_slew_rate_3x = "/fragment@model/__overlay__/dwmmc2@13550000:pinctrl-3:0";
		sd2_clk_fast_slew_rate_4x = "/fragment@model/__overlay__/dwmmc2@13550000:pinctrl-4:0";
		hsi2c_5 = "/fragment@17:target:0";
		gpm6 = "/fragment@17/__overlay__:gpios:0";
		gpm7 = "/fragment@17/__overlay__:gpios:12";
		hsi2c5_bus = "/fragment@17/__overlay__:pinctrl-0:0";
		usbdrd_dwc3 = "/fragment@19:target:0";
		usbdrd_phy = "/fragment@20:target:0";
		usbdrd3_phy = "/fragment@21:target:0";
		serial_0 = "/fragment@22:target:0";
		pinctrl_0 = "/fragment@23:target:0", "/fragment@48:target:0", "/fragment@54:target:0";
		pinctrl_4 = "/fragment@24:target:0", "/fragment@44:target:0", "/fragment@45:target:0", "/fragment@51:target:0";
		fmp_0 = "/fragment@25:target:0";
		usi_0_shub = "/fragment@26:target:0";
		usi_0_shub_i2c = "/fragment@27:target:0";
		usi_0_cmgp = "/fragment@28:target:0";
		usi_0_cmgp_i2c = "/fragment@29:target:0";
		usi_1_cmgp = "/fragment@30:target:0";
		usi_1_cmgp_i2c = "/fragment@31:target:0";
		usi_2_cmgp = "/fragment@32:target:0";
		usi_2_cmgp_i2c = "/fragment@33:target:0";
		usi_3_cmgp = "/fragment@34:target:0";
		usi_3_cmgp_i2c = "/fragment@35:target:0";
		usi_4_cmgp = "/fragment@36:target:0";
		usi_4_cmgp_i2c = "/fragment@37:target:0";
		usi_peri_usi_0 = "/fragment@38:target:0";
		usi_peri_usi_0_i2c = "/fragment@39:target:0";
		usi_peri_spi_1 = "/fragment@40:target:0";
		i2c_0 = "/fragment@41:target:0";
		i2c_3 = "/fragment@43:target:0";
		spi_7 = "/fragment@46:target:0";
		pdma0 = "/fragment@46/__overlay__:dmas:0", "/fragment@46/__overlay__:dmas:8";
		gpp2 = "/fragment@46/__overlay__/etspi-spi@0/controller-data:cs-gpio:0";
		contexthub_0 = "/fragment@47:target:0";
		gpm21 = "/fragment@47/__overlay__:sensor-ldo-en:0";
		pinctrl_1 = "/fragment@49:target:0";
		pinctrl_2 = "/fragment@50:target:0";
	};

	__local_fixups__ {

		fragment@lcd {

			__overlay__ {

				ea8076 {
					decon_board = <0x0>;
				};
			};
		};

		fragment@0 {

			__overlay__ {
				lcd_info = <0x0>;
			};
		};

		fragment@sound {

			__overlay__ {

				sound {

					rdma@0 {

						codec {
							sound-dai = <0x0>;
						};
					};

					rdma@1 {

						codec {
							sound-dai = <0x0>;
						};
					};

					rdma@2 {

						codec {
							sound-dai = <0x0>;
						};
					};

					rdma@3 {

						codec {
							sound-dai = <0x0>;
						};
					};

					rdma@4 {

						codec {
							sound-dai = <0x0>;
						};
					};

					rdma@5 {

						codec {
							sound-dai = <0x0>;
						};
					};

					rdma@6 {

						codec {
							sound-dai = <0x0>;
						};
					};

					rdma@7 {

						codec {
							sound-dai = <0x0>;
						};
					};

					wdma@0 {

						codec {
							sound-dai = <0x0>;
						};
					};

					wdma@1 {

						codec {
							sound-dai = <0x0>;
						};
					};

					wdma@2 {

						codec {
							sound-dai = <0x0>;
						};
					};

					wdma@3 {

						codec {
							sound-dai = <0x0>;
						};
					};

					wdma@4 {

						codec {
							sound-dai = <0x0>;
						};
					};

					uaif@0 {

						codec {
							sound-dai = <0x0>;
						};
					};

					uaif@1 {

						codec {
							sound-dai = <0x0>;
						};
					};

					uaif@2 {

						codec {
							sound-dai = <0x0>;
						};
					};

					uaif@4 {

						codec {
							sound-dai = <0x0>;
						};
					};

					dsif@0 {

						codec {
							sound-dai = <0x0>;
						};
					};

					spdy@0 {

						codec {
							sound-dai = <0x0>;
						};
					};

					sifs0@0 {

						codec {
							sound-dai = <0x0>;
						};
					};

					sifs1@0 {

						codec {
							sound-dai = <0x0>;
						};
					};

					sifs2@0 {

						codec {
							sound-dai = <0x0>;
						};
					};
				};
			};
		};

		fragment@16 {

			__overlay__ {

				rt5665@1b {
					pinctrl-0 = <0x0>;
					realtek,regulator_1v8 = <0x0>;
					realtek,regulator_3v3 = <0x0>;
				};
			};
		};

		fragment@model {

			__overlay__ {

				speedy@11a10000 {

					s2mpu09mfd@00 {
						pinctrl-0 = <0x0 0x4>;
					};
				};

				gnss_pdata {
					mbox_info = <0x0>;
				};

				gpio_keys {
					pinctrl-0 = <0x0 0x4 0x8>;
				};

				i2c@13870000 {

					mms_ts@48 {
						pinctrl-0 = <0x0>;
						pinctrl-1 = <0x0>;
					};
				};

				dwmmc2@13550000 {
					pinctrl-0 = <0x10>;
				};

				hall {
					pinctrl-0 = <0x0>;
				};

				certify_hall {
					pinctrl-0 = <0x0>;
				};

				i2c@20 {
					pinctrl-0 = <0x0>;

					sx9360_sub-i2c@28 {
						pinctrl-0 = <0x0>;
					};
				};

				sound {

					uaif@2 {

						codec {
							sound-dai = <0x0>;
						};
					};
				};
			};
		};

		fragment@17 {

			__overlay__ {

				sx9360-i2c@28 {
					pinctrl-0 = <0x0>;
				};
			};
		};

		fragment@20 {

			__overlay__ {
				hs_tune_param = <0x0>;
			};
		};

		fragment@21 {

			__overlay__ {
				hs_tune_param = <0x0>;
				ss_tune_param = <0x0>;
			};
		};

		fragment@41 {

			__overlay__ {

				usbpd-5713@33 {
					pinctrl-0 = <0x0>;
				};
			};
		};

		fragment@42 {

			__overlay__ {

				sm5713@49 {
					pinctrl-0 = <0x0 0x4>;
				};
			};
		};

		fragment@46 {

			__overlay__ {

				etspi-spi@0 {
					pinctrl-0 = <0x0>;
					pinctrl-1 = <0x0 0x4 0x8 0xc>;
					pinctrl-2 = <0x0 0x4>;
				};
			};
		};

		fragment@48 {

			__overlay__ {
				pinctrl-0 = <0x0>;
			};
		};

		fragment@49 {

			__overlay__ {
				pinctrl-0 = <0x0>;
			};
		};

		fragment@50 {

			__overlay__ {
				pinctrl-0 = <0x0>;
			};
		};

		fragment@51 {

			__overlay__ {
				pinctrl-0 = <0x0>;
				pinctrl-1 = <0x0>;
			};
		};
	};
};
