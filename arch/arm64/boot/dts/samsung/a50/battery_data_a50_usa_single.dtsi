/*
 * Vogue battery device tree common
 *
 * Copyright (c) 2018 Samsung Electronics Co., Ltd.
 *		http://www.samsung.com
 *
 * This program is free software; you can redistribute it and/or modify
 * it under the terms of the GNU General Public License version 2 as
 * published by the Free Software Foundation.
 */

#include "battery_data_a50_common.dtsi"

/ {
	fragment@battery {
		target-path = "/";
		__overlay__ {
				battery {
					battery,chg_ocp_current = <5000>;
				};
		}; /* end of __overlay__ */
	}; /* end of fragment */
};
