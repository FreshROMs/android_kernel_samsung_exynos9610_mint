## drivers/soc/samsung/Kconfig
```kconfig
#
# SAMSUNG SoC drivers
#
menuconfig SOC_SAMSUNG
	bool "Samsung SoC driver support" if COMPILE_TEST

if SOC_SAMSUNG
config EXYNOS_CHIPID
	bool "Exynos Chip ID Driver Support"
	depends on ARCH_EXYNOS
	select SOC_BUS

config EXYNOS_BCM_DBG
	bool "EXYNOS_BCM_DBG driver support"
	default y
	help
	  Enable exynos-bcm_dbg driver support

config EXYNOS_BCM_DBG_GNR
	bool "EXYNOS_BCM_DBG general interface support"
	depends on !EXYNOS_ADV_TRACER
	default y
	help
	  Enable exynos-bcm_dbg general interface support.
	  The general interface is not used ADV-tracer IPC interface.

config EXYNOS_BCM_DBG_DUMP
	bool "EXYNOS_BCM_DBG dump support"
	depends on EXYNOS_BCM_DBG
	help
	  Enable exynos-bcm_dbg dump support

config EXYNOS_BCM
	bool "EXYNOS_BCM driver support"
	help
	  Enable exynos_bcm driver support

config CAL_IF
	bool "Exynos Chip Abstraction Layer Interface"
	help
	  Support CMU CAL for Exynos SoC.

config EXYNOS_REBOOT
	bool "Exynos Chip Reboot Driver Support"
	depends on ARCH_EXYNOS

config CMUCAL
	bool "Exynos CMU Chip Abstraction Layer"
	depends on CAL_IF
	default y
	help
	Support CMUCAL for Exynos SoC.

config CMUCAL_DEBUG
	bool "CMUCAL Debug Interface"
	depends on CMUCAL

config CMUCAL_QCH_IGNORE_SUPPORT
	bool "CMUCAL QCH IGNORE Support"
	depends on CMUCAL

source "drivers/soc/samsung/acpm/Kconfig"

config ACPM_DVFS
	bool "Exynos ACPM DVFS manager"
	depends on CAL_IF && CMUCAL
	default y
	help
	Support ACPM DVFS for Exynos SoC.

config PMUCAL
	bool "Exynos PMU Chip Abstraction Layer"
	depends on CAL_IF
	default y
	help
	Support PMUCAL for Exynos SoC.

config CP_PMUCAL
	bool "Exynos PMU(for CP) Chip Abstraction Layer"
	depends on CAL_IF
	help
	  Support CP_PMUCAL for Exynos SoC.

config GNSS_PMUCAL
	bool "Exynos PMU(for GNSS) Chip Abstraction Layer"
	depends on CAL_IF
	help
	  Support GNSS_PMUCAL for Exynos SoC.

config SHUB_PMUCAL
	bool "Exynos PMU(for SHUB) Chip Abstraction Layer"
	default y
	depends on CAL_IF
	help
	  Support SHUB_PMUCAL for Exynos SoC.

config CMUCAL_DEBUG
	bool "CMUCAL Debug Interface"
	depends on CMUCAL

config EXYNOS_PMU
	bool "Exynos Power Management Unit Driver Support"
	depends on ARCH_EXYNOS
	select MFD_SYSCON

config ECT
	bool "Enable Exynos Characteristic Table File"
	default n
	depends on ARCH_EXYNOS

config ECT_DUMP
	bool "Enable Exynos Characteristic Table File Dump sysfs"
	default n
	depends on ECT

config EXYNOS_RGT
	bool "Exynos Regulator Debug Support"
	depends on REGULATOR
	depends on DEBUG_FS
	depends on OF
	help
	  dummy device driver for debugging samsung PMIC

# There is no need to enable these drivers for ARMv8
config EXYNOS_PM_DOMAINS
	bool "Exynos PM domains" if COMPILE_TEST
	depends on PM_GENERIC_DOMAINS || COMPILE_TEST

config EXYNOS_CONTENT_PATH_PROTECTION
	bool "Exynos Content Path Protection"
	default y
	help
	  Enable content path protection of EXYNOS.

source "drivers/soc/samsung/debug/Kconfig"

config EXYNOS_OCP
	bool "Exynos OCP Handler"
	depends on CPU_FREQ
	default n
	help
	  Enable OCP handler for Exynos SoC.

config EXYNOS_HIU
	bool "Exynos HIU Handler"
	depends on CPU_FREQ
	default n
	help
	  Enable HIU handler for Exynos SoC.

config EXYNOS_DVFS_MANAGER
	bool "Exynos DVFS Manager"
	default n
	depends on ARCH_EXYNOS
	help
	  Enable DVFS Manager for Exynos SoC.
	  This module controls constraint between each DVFS domains.

config EXYNOS_PD
	bool "Exynos PM domain Support"
		depends on ARCH_EXYNOS
		depends on PM
		select PM_GENERIC_DOMAINS

config EXYNOS_SECURE_LOG
	bool "Exynos Secure Log"
	default y
	help
	  Support Exynos Secure Log

config EXYNOS_KERNEL_PROTECTION
	bool "Exynos Kernel Code Protection"
	help
	  Support Exynos Kernel Code Protection

config EXYNOS_SDM
	bool "Exynos Security Dump Manager Support"
	depends on DEBUG_SNAPSHOT
	default y
	help
	  Exynos Security Dump Manager

config USI_V2
	bool "Enable Universal Serial Interface version 2"
	default y

config EXYNOS_SMC_LOG_THRESHOLD
	int "threshold of detection(microsecond)"
	range 0 1000000
	default 0

config DEBUG_SNAPSHOT_LOGGING_SMC
	bool "Exynos Logging SMC"
	depends on DEBUG_SNAPSHOT
	default y

source "drivers/soc/samsung/exynos-hdcp/Kconfig"

config SENSORS_FP_USI_NUMBER
	depends on SENSORS_FINGERPRINT
	int "Fingerprint usi gpio number"
	default 0

endif
```

## drivers/soc/samsung/debug/Kconfig
```kconfig
menuconfig EXYNOS_DEBUG
        bool "Exynos Debug Features"
        default y
        depends on ARCH_EXYNOS

if EXYNOS_DEBUG

config EXYNOS_ITMON
        bool "Exynos IPs Traffic Monitor"
        default y
        depends on ARCH_EXYNOS

menuconfig EXYNOS_CORESIGHT
        bool "Enable Coresight of exynos"
        depends on ARCH_EXYNOS && EXYNOS_DEBUG
        default n

config EXYNOS_CORESIGHT_PC_INFO
        bool "Show Porgram Counter information"
        depends on EXYNOS_CORESIGHT
        default y
        help
          Show Program Counter information When kernel panic.

config PC_ITERATION
        int "Number of Program Coutner information"
        depends on EXYNOS_CORESIGHT_PC_INFO
        range 1 10
        default 5
        help
          Print out Program Counter as iteration value.

config EXYNOS_CORESIGHT_MAINTAIN_DBG_REG
        bool "Save/Restore Debug Registers"
        depends on EXYNOS_CORESIGHT
        default n
        help
          When core power is down, debug registers are not mainained data
          and OS-lock is set. To maintain data, debug registers's data must
          save in /restore from memory. If OS-lock is set, debugging to use
          trace32 is impossible. So OS-lock must clear when core power is up.
          This config must enable only using iTSP program.
endif
```

## drivers/staging/nanohub/Kconfig
```kconfig
config NANOHUB
	tristate "Nanohub"
	default N
	select IIO
	help
	  Enable support for the nanohub sensorhub driver.

	  This driver supports the android nanohub sensorhub.

	  If in doubt, say N here.

if NANOHUB

config NANOHUB_SPI
	bool "Nanohub SPI"
	default N
	help
	  Enable nanohub SPI support.

	  Either this or NANOHUB_I2C should be selected.

	  If in doubt, say Y here.

config NANOHUB_I2C
	bool "Nanohub I2C"
	default N
	help
	  Enable nanohub I2C support.

	  Either this or NANOHUB_SPI should be selected.

	  If in doubt, say N here.

config NANOHUB_MAILBOX
	bool "Nanohub Mailbox"
	default Y
	help
	  Enable nanohub Mailbox support.

	  Either this or NANOHUB_MAILBOX should be selected.

	  If in doubt, say N here.

config CHRE_SENSORHUB_HAL
	bool "CHRE sensor Hal support"
	default Y
	help
	  Enable chre sensorhub hal support.

config CONTEXTHUB_DEBUG
	bool "Nanohub debug"
	default N
	help
	  Eanble nanohub device debug message

endif # NANOHUB
```

## drivers/usb/typec/Kconfig
```kconfig
menu "USB Power Delivery and Type-C drivers"

config USE_CCIC
	bool "Using USBPD device driver"
	depends on I2C
	default n
	help
	  If you say yes here you will get support for
	  the USB PD(Power Delivery) device driver.

config TYPEC
	bool "Using USB Type-C device driver"
	depends on USE_CCIC
	depends on ANDROID_MAJOR_VERSION != "o"
	default n
	help
	  If you say yes here you will get support for
	  the USB Type-C device driver.

config TYPEC_WCOVE
	tristate "Intel WhiskeyCove PMIC USB Type-C PHY driver"
	depends on ACPI
	depends on INTEL_SOC_PMIC
	depends on INTEL_PMC_IPC
	depends on BXT_WC_PMIC_OPREGION
	select TYPEC
	help
	  This driver adds support for USB Type-C detection on Intel Broxton
	  platforms that have Intel Whiskey Cove PMIC. The driver can detect the
	  role and cable orientation.

	  To compile this driver as module, choose M here: the module will be
	  called typec_wcove

source "drivers/usb/typec/ucsi/Kconfig"

source "drivers/usb/typec/manager/Kconfig"

source "drivers/usb/typec/sm5713/Kconfig"

source "drivers/usb/typec/sep/Kconfig"

endmenu
```

## drivers/usb/typec/manager/Kconfig
```kconfig
#
# USB TypeC Manager driver
#

comment "USB TypeC Manager configs"

config USB_TYPEC_MANAGER_NOTIFIER
    bool "USB TypeC Manager driver"
    help
    If you say yes here you will get support for
      USB TypeC Manager function

config IF_CB_MANAGER
    bool "IF CallBack function Manager"
    default n
    help
    If you say yes here you will use if_cb_manager structure
    that makes functions to callback functions
```

## drivers/usb/typec/sep/Kconfig
```kconfig
#
# USB PDIC common driver
#

comment "USB PDIC common configs"

config CCIC_NOTIFIER
	bool "CCIC notifier support"
	depends on I2C
	default n
	help
	  If you say yes here you will get support for
	  the CCIC attached device status change notification.
```

## drivers/usb/typec/sm5713/Kconfig
```kconfig
#
# sm5713 driver
#

comment "SM5713 configs"

config CCIC_SM5713
	bool "Using SM5713 USB PD"
	depends on USE_CCIC
	default n
	help
	  If you say yes here you will get support for
	  the SM5713 USBPD chip.

config SM5713_FACTORY_MODE
	bool "Using SM5713 USB PD"
	depends on CCIC_SM5713
	default n
	help
	  If you say yes here you will get support for
	  the SM5713 FACTORY MODE. 

config SM5713_WATER_DETECTION_ENABLE	  
	bool "Water detection function control"
	default n
	help
	  If you say yes here you will get support for
	  the Water Detection functions.

config PDIC_PD30
	bool "support PD3.0"
	depends on CCIC_SM5713
	default n
	help
	  If you say yes here you will get support for PD3.0
```

## drivers/video/fbdev/exynos/Kconfig
```kconfig
if SOC_EXYNOS9610

source "drivers/video/fbdev/exynos/dpu20/Kconfig"

endif # SOC_EXYNOS9610
```

## drivers/video/fbdev/exynos/dpu20/Kconfig
```kconfig
config EXYNOS_DPU20
	bool "Samsung Exynos Display Sub-system (DPP, DECON, MIPI, DISPLAYPORT)"
	default n
	depends on FB

if EXYNOS_DPU20
config EXYNOS_DPP
	bool "Samsung Exynos Display Post Processor driver"
	depends on EXYNOS_DPU20
	default y

config EXYNOS_MIPI_DSIM
	bool "Samsung Exynos MIPI-DSI driver"
	depends on EXYNOS_DPU20
	default y
	help
	  Enable MIPI-DSI driver.

config EXYNOS_DISPLAYPORT
	bool "Samsung Exynos DISPLAYPORT driver"
	depends on EXYNOS_DPU20
	default n
	help
	  Enable DISPLAYPORT driver.

config EXYNOS_WINDOW_UPDATE
        bool "Support Window Update Mode"
        depends on EXYNOS_DPU20
        default n

config EXYNOS_BLOCK_MODE
	bool "Support Blocking Mode"
        depends on EXYNOS_DPU20
        default y

config EXYNOS_HIBERNATION
	bool "Support Display Hibernation Mode"
        depends on EXYNOS_DPU20
        default n

config EXYNOS_DOZE
	bool "Support DOZE mode"
        depends on EXYNOS_DPU20
        default n

config EXYNOS_AFBC_DEBUG
	bool "Support AFBC Decoder Debug"
        depends on EXYNOS_DPU20
        default n

config EXYNOS_MULTIRESOLUTION
	bool "Support Multi Resolution LCD"
	depends on EXYNOS_DPU20 && EXYNOS_WINDOW_UPDATE
	default n

config EXYNOS_VIRTUAL_DISPLAY
	bool "Support Virtual Display Mode"
	depends on EXYNOS_DPU20
	default n
	help
	  If this menu is enabled, you can boot up board without LCD.

config EXYNOS_READ_ESD_SOLUTION
	bool "Support ESD solution using read DDI power state"
	depends on EXYNOS_DPU20
	default n
	help
	  If this menu is enabled, you can detect ESD of panel.

config EXYNOS_LOW_PERSISTENCE
	bool "Support Low Persistence Mode"
        depends on EXYNOS_DPU20
	default n

config EXYNOS_CURSOR
	bool "Support Cursor Async Mode"
        depends on EXYNOS_DPU20
	default n

config EXYNOS_DSIM_DITHER
	bool "DSIM SSCG feature"
        depends on EXYNOS_MIPI_DSIM
        default y

config DECON_BTS_LEGACY
	bool "Legacy BTS scheme of display"
        depends on EXYNOS_DPU20
        default n

config FB_TEST
	bool "Framebuffer test only"
        depends on EXYNOS_DPU20
        default n

config DSIM_CMD_TEST
	bool "DSIM command test only"
        depends on EXYNOS_DPU20
        default n

config SUPPORT_LEGACY_ION
	bool "Support legacy ION API"
        depends on EXYNOS_DPU20
        default n

config SUPPORT_LEGACY_FENCE
	bool "Support legacy fence API"
        depends on EXYNOS_DPU20
        default n

config SUPPORT_KERNEL_4_9
	bool "Support kernel version 4.9"
        depends on EXYNOS_DPU20
        default n

config EXYNOS_PANEL_CABC
	bool "Support CABC using DDI command"
	depends on EXYNOS_DPU20
	default n
	help
	  If this menu is enabled, you can control CABC mode of panel.

endif

source "drivers/video/fbdev/exynos/dpu20/panels/Kconfig"
```

## drivers/video/fbdev/exynos/dpu20/panels/Kconfig
```kconfig
config EXYNOS_DECON_LCD
	depends on EXYNOS_DPU20
	bool "Select LCD panel driver"

config EXYNOS_DECON_LCD_S6E3HA2K
	depends on EXYNOS_DECON_LCD && EXYNOS_MIPI_DSIM
	tristate "S6E3HA2K AMOLED WQHD LCD driver(1440 x 2560)"

config EXYNOS_DECON_LCD_S6E3HF4
	depends on EXYNOS_DECON_LCD && EXYNOS_MIPI_DSIM
	tristate "S6E3HF4 AMOLED WQHD LCD driver(1440 x 2560)"
	default n

config EXYNOS_DECON_LCD_S6E3HA6
	depends on EXYNOS_DECON_LCD && EXYNOS_MIPI_DSIM
	tristate "S6E3HA6 AMOLED WQHD+ LCD driver(1440 x 2960)"
	default n

config EXYNOS_DECON_LCD_S6E3HA8
	depends on EXYNOS_DECON_LCD && EXYNOS_MIPI_DSIM
	tristate "S6E3HA8 AMOLED WQHD+ LCD driver(1440 x 2960)"
	default n

config EXYNOS_DECON_LCD_S6E3AA2
	depends on EXYNOS_DECON_LCD && EXYNOS_MIPI_DSIM
	tristate "S6E3AA2 AMOLED HD LCD driver(720 x 1280)"
	default n

config EXYNOS_DECON_LCD_S6E3FA0
	depends on EXYNOS_DECON_LCD && EXYNOS_MIPI_DSIM
	tristate "S6E3FA0 AMOLED HD LCD driver(1080 x 1920)"
	default n

config EXYNOS_DECON_LCD_S6E3FA7
	depends on EXYNOS_DECON_LCD && EXYNOS_MIPI_DSIM
	tristate "S6E3FA7 AMOLED FHD LCD driver(1080 x 2220)"
	default n

config EXYNOS_DECON_LCD_EA8076
	depends on EXYNOS_DECON_LCD && EXYNOS_MIPI_DSIM
	tristate "EA8076 FHD+ LCD driver(1080 x 2340)"
	default n

config EXYNOS_DECON_LCD_EMUL_DISP
	depends on EXYNOS_DECON_LCD && EXYNOS_MIPI_DSIM
	tristate "Virtual LCD driver for emulator(800 x 1280)"

config DISPLAY_USE_INFO
	tristate "Support display use info logging"
	default n

config EXYNOS_DECON_MDNIE
	tristate "Support MDNIE"
	default n

config SUPPORT_POC_FLASH
	tristate "Support display poc flash"
	default n

config LCD_HMT
	bool "Suppot video emul & aid reverse to VR"
	default n

config SUPPORT_MASK_LAYER
	bool "Support mask layer"
	default y

config LOGGING_BIGDATA_BUG
	bool "Logging extra information when decon bug"
	depends on SEC_DEBUG
	default n

config EXYNOS_DECON_LCD_S6E3FA7_VOGUE
	tristate "S6E3FA7_VOGUE LCD driver"

config EXYNOS_DECON_LCD_EA8076_A50
	tristate "EA8076_A50 LCD driver"

config EXYNOS_DECON_LCD_S6E3FC2_A80
	tristate "S6E3FC2_A80 LCD driver"
```

## drivers/vision/Kconfig
```kconfig
menuconfig VISION_SUPPORT
	bool "Vision Support"
	help
	  If you want to use hardware acceleration for vision
	  enable this option and other options below.

if VISION_SUPPORT

source "drivers/vision/vipx/Kconfig"

endif # VISION_SUPPORT
```

## drivers/vision/vipx/Kconfig
```kconfig
menuconfig EXYNOS_VIPX
	bool "Exynos VIPx driver"
	select EXYNOS_VIPX_PLATFORM
	help
	  This is a vision image processing unit

if EXYNOS_VIPX

source "drivers/vision/vipx/platform/Kconfig"

endif
```

## drivers/vision/vipx/platform/Kconfig
```kconfig
menuconfig EXYNOS_VIPX_PLATFORM
	bool "Select Platform"
	help
	  This is a selection of platform

config EXYNOS_VIPX_EXYNOS9610
	bool "Use Exynos9610 platform"
	depends on EXYNOS_VIPX_PLATFORM
	depends on SOC_EXYNOS9610
	help
	  This is a exynos9610 platform

config EXYNOS_VIPX_EXYNOS9610_A
	bool "Use Exynos9610 platform for target A"
	depends on EXYNOS_VIPX_PLATFORM
	depends on SOC_EXYNOS9610
	depends on EXYNOS_VIPX_EXYNOS9610

config EXYNOS_VIPX_EXYNOS9610_R
	bool "Use Exynos9610 platform for target R"
	depends on EXYNOS_VIPX_PLATFORM
	depends on SOC_EXYNOS9610
	depends on EXYNOS_VIPX_EXYNOS9610
```
