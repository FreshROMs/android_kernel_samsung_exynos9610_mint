## drivers/sensorhub/factory/Accelometer/Kconfig
```kconfig
#
# sensor drivers configuration
#

config SENSORS_SSP_ACCELOMETER_ICM42605M
	tristate "Sensors ssp accelometer sensor icm42605m"
	default n
	depends on SPI
	help
	  accelerometer sensor icm42605m file for factory test in ssp driver.
          If you say yes here you get accelerometer sensor icm42605m support for
	  factory test.
	  To compile this driver as a module, choose M here: the
	  module will be called ssp.

config SENSORS_SSP_ACCELOMETER_LSM6DSL
	tristate "Sensors ssp accelometer sensor lsm6dsl"
	default n
	depends on SPI
	help
	  accelerometer sensor lsm6dsl file for factory test in ssp driver.
          If you say yes here you get accelerometer sensor lsm6dsl support for
	  factory test.
	  To compile this driver as a module, choose M here: the
	  module will be called ssp.

config SENSORS_SSP_ACCELOMETER_K6DS3TR
	tristate "Sensors ssp accelometer sensor k6ds3tr"
	default n
	depends on SPI
	help
	  accelerometer sensor k6ds3tr file for factory test in ssp driver.
          If you say yes here you get accelerometer sensor k6ds3tr support for
	  factory test.
	  To compile this driver as a module, choose M here: the
	  module will be called ssp.
```

## drivers/sensorhub/factory/Barometer/Kconfig
```kconfig
#
# sensor drivers configuration
#

config SENSORS_SSP_BAROMETER_LPS22H
	tristate "Sensors ssp barometer lps22h"
	default n
	depends on SPI
	help
	  barometer lps22h file for factory test in ssp driver.
          If you say yes here you get barometer lps22h support for
	  factory test.
	  To compile this driver as a module, choose M here: the
	  module will be called ssp.

config SENSORS_SSP_BAROMETER_LPS25H
	tristate "Sensors ssp barometer lps25h"
	default n
	depends on SPI
	help
	  barometer lps25h file for factory test in ssp driver.
          If you say yes here you get barometer lps25h support for
	  factory test.
	  To compile this driver as a module, choose M here: the
	  module will be called ssp.
```

## drivers/sensorhub/factory/Gyroscope/Kconfig
```kconfig
#
# sensor drivers configuration
#

config SENSORS_SSP_GYROSCOPE_ICM42605M
	tristate "Sensors ssp gyroscope sensor icm42605m"
	default n
	depends on SPI
	help
	  gyroscope sensor icm42605m file for factory test in ssp driver.
          If you say yes here you get gyroscope sensor icm42605m support for
	  factory test.
	  To compile this driver as a module, choose M here: the
	  module will be called ssp.

config SENSORS_SSP_GYROSCOPE_LSM6DSL
	tristate "Sensors ssp gyroscope sensor lsm6dsl"
	default n
	depends on SPI
	help
	  gyroscope sensor lsm6dsl file for factory test in ssp driver.
          If you say yes here you get gyroscope sensor lsm6dsl support for
	  factory test.
	  To compile this driver as a module, choose M here: the
	  module will be called ssp.

config SENSORS_SSP_GYROSCOPE_K6DS3TR
	tristate "Sensors ssp gyroscope sensor k6ds3tr"
	default n
	depends on SPI
	help
	  gyroscope sensor k6ds3tr file for factory test in ssp driver.
          If you say yes here you get gyroscope sensor k6ds3tr support for
	  factory test.
	  To compile this driver as a module, choose M here: the
	  module will be called ssp.
```

## drivers/sensorhub/factory/Magnetic/Kconfig
```kconfig
#
# sensor drivers configuration
#

config SENSORS_SSP_MAGNETIC_AK09918C
	tristate "Sensors ssp magnetic sensor ak09918c"
	default n
	depends on SPI
	help
	  magnetic sensor ak09918c file for factory test in ssp driver.
          If you say yes here you get magnetic sensor ak09918c support for
	  factory test.
	  To compile this driver as a module, choose M here: the
	  module will be called ssp.

config SENSORS_SSP_MAGNETIC_AK09916C
	tristate "Sensors ssp magnetic sensor ak09916c"
	default n
	depends on SPI
	help
	  magnetic sensor ak09916c file for factory test in ssp driver.
          If you say yes here you get magnetic sensor ak09916c support for
	  factory test.
	  To compile this driver as a module, choose M here: the
	  module will be called ssp.

config SENSORS_SSP_MAGNETIC_LSM303AH
	tristate "Sensors ssp magnetic sensor lsm303ah"
	default n
	depends on SPI
	help
	  magnetic sensor lsm303ah file for factory test in ssp driver.
          If you say yes here you get magnetic sensor lsm303ah support for
	  factory test.
	  To compile this driver as a module, choose M here: the
	  module will be called ssp.

config SENSORS_SSP_MAGNETIC_MMC5603
	tristate "Sensors ssp magnetic sensor mmc5603"
	default n
	depends on SPI
	help
	  magnetic sensor mmc5603 file for factory test in ssp driver.
          If you say yes here you get magnetic sensor mmc5603 support for
	  factory test.
	  To compile this driver as a module, choose M here: the
	  module will be called ssp.
```

## drivers/sensorhub/factory/Proximity/Kconfig
```kconfig
#
# sensor drivers configuration
#

config SENSORS_SSP_PROXIMITY_AUTO_CAL_TMD3725
	tristate "Sensors ssp proximity auto cal tmd3725"
	default n
	depends on SPI
	help
	  proximity tmd3725 file for factory test in ssp driver.
          If you say yes here you get proximity tmd3725 support for
	  factory test.
	  To compile this driver as a module, choose M here: the
	  module will be called ssp.

config SENSORS_SSP_PROXIMITY_STK3X3X
	tristate "Sensors ssp proximity stk3x3x"
	default n
	depends on SPI
	help
	  proximity stk3x3x file for factory test in ssp driver.
          If you say yes here you get proximity stk3x3x support for
	  factory test.
	  To compile this driver as a module, choose M here: the
	  module will be called ssp.

config SENSORS_SSP_PROXIMITY_GP2AP110S
	tristate "Sensors ssp proximity gp2ap110s"
	default n
	depends on SPI
	help
	  proximity gp2ap110s file for factory test in ssp driver.
          If you say yes here you get proximity gp2ap110s support for
	  factory test.
	  To compile this driver as a module, choose M here: the
	  module will be called ssp.

config SENSORS_SSP_PROXIMITY_FACTORY_CAL_THRESH
	tristate "Sensors ssp proximity threshold factory cal"
	default n
	depends on SPI
	help
          If you say yes here you get threshold factory cal support for
	  factory test.
	  To compile this driver as a module, choose M here: the
	  module will be called ssp.

config SENSORS_SSP_PROXIMITY_FACTORY_CAL_OFFSET
	tristate "Sensors ssp proximity offset factory cal"
	default n
	depends on SPI
	help
          If you say yes here you get offset factory cal support for
	  factory test.
	  To compile this driver as a module, choose M here: the
	  module will be called ssp.
```

## drivers/sensorhub_m30s/Kconfig
```kconfig
#
# sensor hub drivers configuration
#

config SENSORS_SSP
	tristate "Sensors ssp"
	default n
	depends on SPI
	help
	  ssp driver for sensor hub.
          If you say yes here you get ssp support for
	  sensor hub.
	  To compile this driver as a module, choose M here: the
	  module will be called ssp.

config SSP_ENG_DEBUG
	tristate "sensor hub eng debug mode"
	default n	
	help	  
	  If you want to use eng debug mode for sensor hub, it should be set.

config SENSORS_SSP_A50
	tristate "Sensors ssp a50"
	default n
	help
	  If you want to use sensor hub for a50 project, it should be set.

config SENSORS_SSP_A50S
	tristate "Sensors ssp a50s"
	default n
	help
	  If you want to use sensor hub for a50s project, it should be set.

config SENSORS_SSP_M30S
	tristate "Sensors ssp m30s"
	default n
	help
	  If you want to use sensor hub for m30s project, it should be set.

config SENSORS_SSP_A51
	tristate "Sensors ssp a51"
	default n
	help
	  If you want to use sensor hub for a51 project, it should be set.

config SENSORS_SSP_GYROFILE_FOR_MAG
	tristate "use gyro cal file for mag cal"
	default n	
	help	  
	  If you want to use gyro cal file for magnetic sensor, it should be set.

config SENSORS_A96T3X6
	depends on I2C
	tristate "A96T3X6 touchkey"
	default n
	help
	  If you say yes here if you use A96T3X6 for grip.
	  This option enables grip sensors using
	  Above A96T3X6 device driver for grip.

config SENSORS_A96T3X6_M30S
	depends on I2C
	tristate "A96T3X6 touchkey"
	default n
	help
	  If you say yes here if you use A96T3X6 for grip.
	  This option enables grip sensors using
	  Above A96T3X6 device driver for grip.

config SENSORS_TC3XXK
	depends on I2C
	tristate "TC3XXK driver for grip Sensor"
	default n
	help
	  Say Y here if you use TC3XXK IC for grip Sensor.
	  This option enables grip sensors using
	  Coreriver TC305K device driver for grip Sensor.

config SENSORS_SX9360
	depends on I2C
	tristate "SX9360 driver"
	default n
	help
	  Say Y here if you use sx9360.
	  This option enables grip sensors using
	  SemTech sx9360 device driver.
	  Say N here if you do not use sx9360.

config SENSORS_SX9360_SUB
	depends on I2C
	tristate "SX9330 sub driver"
	default n
	help
	  Say Y here if you use sx9330 sub.
	  This option enables grip sensors using
	  SemTech sx9330 sub device driver.
	  Say N here if you do not use sx9330 sub.
source "drivers/sensorhub/factory/Kconfig"
```

## drivers/sensorhub_m30s/factory/Kconfig
```kconfig
#
# sensor hub factory drivers configuration
#

config SENSORS_SSP_ACCELOMETER
	tristate "Sensors ssp accelometer sensor"
	default n
	depends on SPI
	help
	  accelerometer sensor file for factory test in ssp driver.
          If you say yes here you get accelerometer sensor support for
	  factory test.
	  To compile this driver as a module, choose M here: the
	  module will be called ssp.

config SENSORS_SSP_GYROSCOPE
	tristate "Sensors ssp gyroscope sensor"
	default n
	depends on SPI
	help
	  gyroscope sensor file for factory test in ssp driver.
          If you say yes here you get gyroscope sensor support for
	  factory test.
	  To compile this driver as a module, choose M here: the
	  module will be called ssp.

config SENSORS_SSP_MAGNETIC
	tristate "Sensors ssp magnetic sensor"
	default n
	depends on SPI
	help
	  magnetic sensor file for factory test in ssp driver.
          If you say yes here you get magnetic sensor support for
	  factory test.
	  To compile this driver as a module, choose M here: the
	  module will be called ssp.

config SENSORS_SSP_PROXIMITY
	tristate "Sensors ssp proximity sensor"
	default n
	depends on SPI
	help
	  proximity sensor file for factory test in ssp driver.
          If you say yes here you get proximity sensor support for
	  factory test.
	  To compile this driver as a module, choose M here: the
	  module will be called ssp.

config SENSORS_SSP_LIGHT
	tristate "Sensors ssp light sensor"
	default n
	depends on SPI
	help
	  light sensor file for factory test in ssp driver.
          If you say yes here you get light sensor support for
	  factory test.
	  To compile this driver as a module, choose M here: the
	  module will be called ssp.

config SENSORS_SSP_BAROMETER
	tristate "Sensors ssp barometer sensor"
	default n
	depends on SPI
	help
	  barometer sensor file for factory test in ssp driver.
          If you say yes here you get barometer sensor support for
	  factory test.
	  To compile this driver as a module, choose M here: the
	  module will be called ssp.

config SENSORS_SSP_MOBEAM
	tristate "Sensors ssp mobeam"
	default n
	depends on SPI
	help
	  mobeam file for ssp driver.
          If you say yes here you get mobeam support using TMG399x.
	  To compile this driver as a module, choose M here: the
	  module will be called ssp.

source "drivers/sensorhub/factory/Accelometer/Kconfig"
source "drivers/sensorhub/factory/Gyroscope/Kconfig"
source "drivers/sensorhub/factory/Magnetic/Kconfig"
source "drivers/sensorhub/factory/Proximity/Kconfig"
source "drivers/sensorhub/factory/Light/Kconfig"
source "drivers/sensorhub/factory/Barometer/Kconfig"
```

## drivers/sensorhub_m30s/factory/Light/Kconfig
```kconfig
#
# sensor drivers configuration
#

config SENSORS_SSP_LIGHT_TMD3725
	tristate "Sensors ssp light tmd3725"
	default n
	depends on SPI
	help
	  light tmd3725 file for factory test in ssp driver.
          If you say yes here you get light tmd3725 support for
	  factory test.
	  To compile this driver as a module, choose M here: the
	  module will be called ssp.

config SENSORS_SSP_LIGHT_TMD3700
	tristate "Sensors ssp light tmd3700"
	default n
	depends on SPI
	help
	  light tmd3700 file for factory test in ssp driver.
          If you say yes here you get light tmd3700 support for
	  factory test.
	  To compile this driver as a module, choose M here: the
	  module will be called ssp.

config SENSORS_SSP_LIGHT_TCS3701
	tristate "Sensors ssp light tcs3701"
	default n
	depends on SPI
	help
	  light tcs3701 file for factory test in ssp driver.
          If you say yes here you get light tcs3701 support for
	  factory test.
	  To compile this driver as a module, choose M here: the
	  module will be called ssp.

config SENSORS_SSP_LIGHT_VEML3328
	tristate "Sensors ssp light veml3328"
	default n
	depends on SPI
	help
	  light veml3328 file for factory test in ssp driver.
          If you say yes here you get light veml3328 support for
	  factory test.
	  To compile this driver as a module, choose M here: the
	  module will be called ssp.	  
```
