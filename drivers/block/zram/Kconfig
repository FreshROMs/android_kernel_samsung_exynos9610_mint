## drivers/block/zram/Kconfig
```kconfig
# SPDX-License-Identifier: GPL-2.0
config ZRAM
	tristate "Compressed RAM block device support"
	depends on BLOCK && SYSFS && ZSMALLOC && CRYPTO
	depends on CRYPTO_LZO || CRYPTO_ZSTD || CRYPTO_LZ4
	default n
	help
	  Creates virtual block devices called /dev/zramX (X = 0, 1, ...).
	  Pages written to these disks are compressed and stored in memory
	  itself. These disks allow very fast I/O and compression provides
	  good amounts of memory savings.

	  It has several use cases, for example: /tmp storage, use as swap
	  disks and maybe many more.

	  See Documentation/blockdev/zram.txt for more information.

choice
	prompt "Default zram compressor"
	default ZRAM_DEF_COMP_LZO
	depends on ZRAM

config ZRAM_DEF_COMP_LZO
	bool "lzo"
	depends on CRYPTO_LZO

config ZRAM_DEF_COMP_LZO_RLE
	bool "lzo-rle"
	depends on CRYPTO_LZO

config ZRAM_DEF_COMP_ZSTD
	bool "zstd"
	depends on CRYPTO_ZSTD

config ZRAM_DEF_COMP_LZ4
	bool "lz4"
	depends on CRYPTO_LZ4

endchoice

config ZRAM_DEF_COMP
	string
	default "lzo" if ZRAM_DEF_COMP_LZO
	default "lzo-rle" if ZRAM_DEF_COMP_LZO_RLE
	default "zstd" if ZRAM_DEF_COMP_ZSTD
	default "lz4" if ZRAM_DEF_COMP_LZ4

config ZRAM_ENTROPY
	bool "Use entropy optimization for zram"
	depends on ZRAM
	help
	  With this feature, entropy will be calculated for each page.
	  Pages above ZRAM_ENTROPY_THRESHOLD entropy will be
	  stored uncompressed. Use this feature if you need a performance
	  boost and a small loss in compression.

config ZRAM_ENTROPY_THRESHOLD
	int
	depends on ZRAM && ZRAM_ENTROPY
	default 90000
	help
	  Pages with entropy above ZRAM_ENTROPY_THRESHOLD will be stored
	  uncompressed. The default value was chosen as a result a lot of
	  experiments. You can try set your own value.

config ZRAM_WRITEBACK
       bool "Write back incompressible or idle page to backing device"
       depends on ZRAM
       default n
       help
	 With incompressible page, there is no memory saving to keep it
	 in memory. Instead, write it out to backing device.
	 For this feature, admin should set up backing device via
	 /sys/block/zramX/backing_dev.

	 With /sys/block/zramX/{idle,writeback}, application could ask
	 idle page's writeback to the backing device to save in memory.

	 See Documentation/blockdev/zram.txt for more information.

config ZRAM_MEMORY_TRACKING
	bool "Track zRam block status"
	depends on ZRAM && DEBUG_FS
	help
	  With this feature, admin can track the state of allocated blocks
	  of zRAM. Admin could see the information via
	  /sys/kernel/debug/zram/zramX/block_state.

	  See Documentation/blockdev/zram.txt for more information.

config ZRAM_LRU_WRITEBACK
	bool
	depends on ZRAM_WRITEBACK
	default y
	help
	  This feature supports zram lru-based writeback (SQZR).

config ZRAM_LRU_WRITEBACK_LIMIT
	int "Limit zram lru writeback"
	default 5120
	depends on ZRAM_LRU_WRITEBACK
```

## drivers/bts/Kconfig
```kconfig
#
# BTS driver configuration
#

menuconfig EXYNOS_BTS
	bool "BTS driver support"
	default y
	help
	  Enable BTS (Bus traffic shaper) support

if EXYNOS_BTS

config EXYNOS8890_BTS
	bool "Bus traffic shaper support"
	default y
	depends on SOC_EXYNOS8890
	help
	  Enable BTS (Bus traffic shaper) support

config EXYNOS8890_BTS_OPTIMIZATION
	bool "Bus traffic shaper optimization mode"
	default n
	depends on EXYNOS8890_BTS
	help
	  Enable BTS (Bus traffic shaper) optimized set

config EXYNOS9610_BTS
	bool "Bus traffic shaper support"
	default y
	depends on SOC_EXYNOS9610
	help
	  With this configuration bts driver will be enabled which is for
	  setting BTS and DVFS to manage bus traffic. Default setting
	  is different to chipset because of the hardware change and DVFS
	  status.
endif
```

## drivers/crypto/fmp/Kconfig
```kconfig
#
# SMU/FMP controller drivers
#
config EXYNOS_FMP
	tristate "Samsung EXYNOS FMP driver"
	depends on CRYPTO_DISKCIPHER && (SCSI_UFS_EXYNOS_FMP || MMC_DW_EXYNOS_FMP)
	help
	  Say yes here to build support for FMP (Flash Memory Protector)
	  to encrypt and decrypt userdata using inline H/W crypto module.
	  If unsure, say N.

	  To compile this driver as a module, choose M here

config EXYNOS_FMP_FIPS
	tristate "Samsung EXYNOS FMP Validation Driver for FIPS"
	depends on EXYNOS_FMP
	depends on !FUNCTION_TRACER
	help
	  Say yes here to build support for FMP (Flash Memory Protector)
	  FIPS validation driver for integrity checking, self and functional test.
	  If unsure, say N.

	  To compile this driver as a module, choose M here

choice
	prompt "Option for self-test failure"
	depends on EXYNOS_FMP_FIPS
	default NODE_FOR_SELFTEST_FAIL

config NODE_FOR_SELFTEST_FAIL
	bool "Set fips fmp node when self-test fails"
	depends on EXYNOS_FMP_FIPS
	help
	  Choose here to select that fips fmp node was set to zero
	  when FMP self-test fails.

config PANIC_FOR_SELFTEST_FAIL
	bool "Panic when self-test fails"
	depends on EXYNOS_FMP_FIPS
	help
	  Choose here to select that kernel panic occurs when FMP self-test fails.

endchoice
```

## drivers/fingerprint/Kconfig
```kconfig
#
# Sensor  drivers configuration
#
menuconfig SENSORS_FINGERPRINT
	bool "Finger Print Sensor devices"
	help
	  Say Y here, and a list of sensors drivers will be displayed.
	  Everything that didn't fit into the other categories is here. This option
	  doesn't affect the kernel.
	  If unsure, say Y.

if SENSORS_FINGERPRINT
config SENSORS_ET5XX
	tristate "ET5XX fingerprint sensor support"
	default n
	help
	  If you say yes here you get support for Egistec's
	  fingerprint sensor ET5XX.
config SENSORS_ET7XX
	tristate "ET7XX fingerprint sensor support"
	default n
	help
	  If you say yes here you get support for Egistec's
	  fingerprint sensor ET7XX.
endif
```

## drivers/gpu/arm/Kconfig
```kconfig
#
# (C) COPYRIGHT 2012 ARM Limited. All rights reserved.
#
# This program is free software and is provided to you under the terms of the GNU General Public License version 2
# as published by the Free Software Foundation, and any use by you of this program is subject to the terms of such GNU licence.
#
# A copy of the licence is included with the program, and can also be obtained from Free Software
# Foundation, Inc., 51 Franklin Street, Fifth Floor, Boston, MA  02110-1301, USA.
#
#

menu "ARM GPU Configuration"
menuconfig MALI_DDK_VERSION
	tristate "Mali support"
	default y
	help
	Enable this option to build support for the ARM Mali-T7xx GPU.

	To compile this driver as a module, choose M here:
	this will generate a single module, called mali_kbase.

choice
	prompt "version Configuration"
	depends on MALI_DDK_VERSION
	default MALI_BIFROST_R32P1 if ANDROID_VERSION >= "120000"
	default MALI_BIFROST_R26P0_R if ANDROID_VERSION = "110000"
	default MALI_BIFROST_R19P0_Q if ANDROID_VERSION < "110000"
	help
	Select the gpu support version.

config MALI_BIFROST_R16P0
	depends on MALI_DDK_VERSION
	bool "Bifrost r16p0 driver"

config MALI_BIFROST_OLD
	depends on MALI_DDK_VERSION
	bool "Bifrost old driver"

config MALI_BIFROST_R19P0_Q
	depends on MALI_DDK_VERSION
	bool "Bifrost r19p0 driver for Android Q"

config MALI_BIFROST_R25P1_R
	depends on MALI_DDK_VERSION
	bool "Bifrost r25p1 driver for Android R"

config MALI_BIFROST_R26P0_R
	depends on MALI_DDK_VERSION
	bool "Bifrost r26p0 driver for Android R"

config MALI_BIFROST_R32P1
	depends on MALI_DDK_VERSION
	bool "Bifrost r32p1 driver for Android S"
endchoice

if MALI_BIFROST_R16P0
source "drivers/gpu/arm/b_r16p0/Kconfig"
endif

if MALI_BIFROST_OLD
source "drivers/gpu/arm/tHEx/Kconfig"
endif

if MALI_BIFROST_R19P0_Q
source "drivers/gpu/arm/b_r19p0/Kconfig"
endif

if MALI_BIFROST_R25P1_R
source "drivers/gpu/arm/b_r25p1/Kconfig"
endif

if MALI_BIFROST_R26P0_R
source "drivers/gpu/arm/b_r26p0/Kconfig"
endif

if MALI_BIFROST_R32P1
source "drivers/gpu/arm/bv_r32p1/Kconfig"
endif

endmenu
```

## drivers/gpu/arm/tHEx/Kconfig
```kconfig
#
# (C) COPYRIGHT 2012-2013 ARM Limited. All rights reserved.
#
# This program is free software and is provided to you under the terms of the
# GNU General Public License version 2 as published by the Free Software
# Foundation, and any use by you of this program is subject to the terms
# of such GNU licence.
#
# A copy of the licence is included with the program, and can also be obtained
# from Free Software Foundation, Inc., 51 Franklin Street, Fifth Floor,
# Boston, MA  02110-1301, USA.
#
#


menuconfig MALI_THEX
	tristate "Mali-THEX support"
	default n
	help
	  Enable this option to build support for the ARM Mali GPU.

	  To compile this driver as a module, choose M here:
	  this will generate a single module, called mali_kbase.

choice
	prompt "version Configuration"
	depends on MALI_THEX
	default MALI_THEX_R10P0
	help
	  Select the gpu support version.

config MALI_THEX_R10P0
	depends on MALI_THEX
	bool "Heimdall r10p0 driver"

endchoice

if MALI_THEX_R10P0
source "drivers/gpu/arm/tHEx/r10p0/Kconfig"
endif
```

## drivers/gpu/exynos/g2d/Kconfig
```kconfig
# SPDX-License-Identifier: GPL-2.0-only
config EXYNOS_GRAPHICS_G2D
	tristate "FIMG2D support"
	select SYNC_FILE
	help
	  This enables FIMG2D driver of Exynos SoCs.
```

## drivers/gud/Kconfig
```kconfig
#
# Mobicore Configuration
#
if SOC_EXYNOS9610
source "drivers/gud/gud-exynos9610/Kconfig"
endif
```

## drivers/gud/gud-exynos9610/sec-os-booster/Kconfig
```kconfig
#
# Secure OS control configuration
#
config SECURE_OS_BOOSTER_API
	bool "Secure OS booster API"
	depends on TRUSTONIC_TEE
	---help---
	  The secure OS booster API is used for secure OS performance
	  enhancement. It can migrate a core that executes secure OS tasks
	  and lock CPU frequency.

config SECURE_OS_SUPPORT_MCT_DISABLE
	bool "Seucre OS booster API supports MCT disable"
	depends on TRUSTONIC_TEE
	default n
	---help---
	   When secure OS boosting, MCT is needed to be disabled
	   because of preventing interrupt of MCT.
```

## drivers/gud/gud-exynos9610/sec-os-ctrl/Kconfig
```kconfig
#
# Secure OS control configuration
#
config SECURE_OS_CONTROL
	bool "Secure OS control"
	depends on TRUSTONIC_TEE
	---help---
	  Enable Secure OS control sysfs.
	  It can migrate a core that executes secure OS tasks
	  and check a current core on secure OS.
```

## drivers/input/touchscreen/imagis_40xx/Kconfig
```kconfig
#
# Imagis IST40XX Touchscreen driver
#

config TOUCHSCREEN_IST40XX
  tristate "IST40XX I2C Touchscreen"
	depends on I2C
	help
	  Say Y here if you have the Imagis IST40XX I2C touchscreen
	  connected to your system.
```

## drivers/input/touchscreen/melfas/mss100/Kconfig
```kconfig
#
# Kconfig for MELFAS MSS100 Touchscreen driver
#

if INPUT_TOUCHSCREEN

config TOUCHSCREEN_MELFAS_MSS100
        tristate "MELFAS MSS100 Touchscreen"
        depends on I2C
        help
          Say Y here if you have a MELFAS MSS100 touchscreen device in your system.

#          If unsure, say N.

#          To compile this driver as a module, choose M here: the module will be called mms_ts.

endif
```

## drivers/input/touchscreen/synaptics_dsx/Kconfig
```kconfig
#
# SYNAPTICS TOUCH driver configuration
#

config TOUCHSCREEN_SYNAPTICS_I2C_DSX
	tristate "Synaptics DSX i2c touchscreen"
	depends on I2C
	help
	  This enables support for Synaptics DSX over I2C based touchscreens.
```

## drivers/media/isdbt/Kconfig
```kconfig
config ISDBT
	bool "isdbt"
	default n

choice
	depends on ISDBT
	prompt "isdbt driver"
	default ISDBT_FC8300_SPI

	config ISDBT_FC83X7_SPI
		bool "ISDBT_FC83X7_SPI"

	config ISDBT_FC8350_SPI
		bool "ISDBT_FC8350_SPI"

	config ISDBT_FC8300_SPI
		bool "ISDBT_FC8300_SPI"

	config ISDBT_FC8180_SPI
		bool "ISDBT_FC8180_SPI"

endchoice

config ISDBT_F_TYPE_ANTENNA
	bool "isdbt F type antenna"
	default n

config ISDBT_GPIO_CLK
	bool "ext isdbt clk cannot controled by clk_prepare"
	default n

config SEC_ISDBT_FORCE_OFF
	bool "release isdbt resource during warmreset"
	default n
```

## drivers/media/platform/exynos/Kconfig
```kconfig
#
# Exynos multimedia device drivers
#
config VIDEO_EXYNOS
        bool "Exynos Multimedia Devices"
        depends on ARCH_EXYNOS
        default y
        help
          This is a representative exynos multimedia device.

if VIDEO_EXYNOS
if MINT_PLATFORM_VERSION <= 11
        source "drivers/media/platform/exynos/mfc_11/Kconfig"
endif
if MINT_PLATFORM_VERSION >= 12
        source "drivers/media/platform/exynos/mfc/Kconfig"
endif
        source "drivers/media/platform/exynos/camera-pp/Kconfig"
endif

config MEDIA_EXYNOS
        bool
        depends on VIDEO_EXYNOS
        default y
        help
          Compile mdev to use exynos media device driver.
```

## drivers/media/platform/exynos/fimc-is2/vendor/mcd/Kconfig
```kconfig
config CAMERA_EEPROM_SUPPORT_REAR
        bool "Enable eeprom for rear cam"
        depends on VENDER_MCD
        default n
        help
          Enable eeprom for rear cam.
config CAMERA_EEPROM_SUPPORT_FRONT
        bool "Enable eeprom for front cam"
        depends on VENDER_MCD
        default n
        help
          Enable eeprom for front cam.
config CAMERA_EEPROM_SUPPORT_REAR3
        bool "Enable eeprom for 3rdrear cam"
        depends on VENDER_MCD
        default n
        help
          Enable EEPROM for 3rd rear cam in triple camera.
          This project has 3 rear camera and each camera has EEPROM for 1st one,
          OTPROM for 2nd one and EEPROM for 3rd camera.
          This option support EEPROM for 3rd rear camera.
config PREPROCESSOR_STANDBY_USE
        bool "Use companion standby"
        depends on VENDER_MCD
        default n
        help
          Use companion standby.
config SENSOR_RETENTION_USE
	bool "Use sensor retention"
	depends on VENDER_MCD
	default n
	help
	  Use sensor retention.
config OIS_USE
        bool "Use ois"
        depends on VENDER_MCD
        default n
        help
          Use ois.
config OIS_FW_UPDATE_THREAD_USE
        bool "Enable ois fw update thread"
        depends on OIS_USE
        default n
        help
          Enable ois fw update thread.
config AF_HOST_CONTROL
        bool "Enable host af control"
        depends on VENDER_MCD
        default n
        help
          Enable host af control.
config TORCH_CURRENT_CHANGE_SUPPORT
        bool "Change torch current in recording mode"
        depends on VENDER_MCD
        default n
        help
          Change torch current in recording mode.
config CAMERA_VOGUE
        bool "This camera is vogue project"
        depends on VENDER_MCD
        default n
        help
          This camera is vogue project.
config CAMERA_A50
        bool "This camera is a50 project"
        depends on VENDER_MCD
        default n
        help
          This camera is a50 project.
config CAMERA_OTPROM_SUPPORT_FRONT
        bool "This camera is otp front project"
        depends on VENDER_MCD
        default n
        help
          This camera is otp front project.
config CAMERA_OTPROM_SUPPORT_REAR
        bool "This camera is otp rear project"
        depends on VENDER_MCD
        default n
        help
          This camera is otp rear project.
```
