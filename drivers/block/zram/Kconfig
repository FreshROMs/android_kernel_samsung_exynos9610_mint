## drivers/media/platform/exynos/fimc-is2/vendor/mcd_v2/Kconfig
```kconfig
config SENSOR_RETENTION_USE
	bool "Use sensor retention"
	depends on VENDER_MCD_V2
	default n
	help
	  Use sensor retention.
config OIS_USE
        bool "Use ois"
        depends on VENDER_MCD_V2
        default n
        help
          Use ois.
config OIS_FW_UPDATE_THREAD_USE
        bool "Enable ois fw update thread"
        depends on OIS_USE
        default n
        help
          Enable ois fw update thread.
config AF_HOST_CONTROL
        bool "Enable host af control"
        depends on VENDER_MCD_V2
        default n
        help
          Enable host af control.
config FIMC_IS_DDK_DATA_LOAD
        bool "Enable signed binary processing."
        depends on VENDER_MCD_V2
        default n
        help
          Enable signed binary processing.
config TORCH_CURRENT_CHANGE_SUPPORT
        bool "Change torch current in recording mode"
        depends on VENDER_MCD_V2
        default n
        help
          Change torch current in recording mode.
config OIS_USE_RUMBA_S4
        bool "Use RUMBA S4 ois driver IC"
        depends on OIS_USE
        default n
        help
          Use RUMBA S4 ois driver IC.
config CAMERA_AAS_V50
        bool "This camera is aas_v50 project"
        depends on VENDER_MCD_V2
        default n
        help
          This camera is aas_v50 project.
config CAMERA_AAS_V80
        bool "This camera is aas_v80 project"
        depends on VENDER_MCD_V2
        default n
        help
          This camera is aas_v80 project.
config CAMERA_AAS_V50S
        bool "This camera is aas_v50s project"
        depends on VENDER_MCD_V2
        default n
        help
          This camera is aas_v50s project.
config CAMERA_MMS_V30S
        bool "This camera is mms_v30s project"
        depends on VENDER_MCD_V2
        default n
        help
          This camera is mms_v30s project.
config CAMERA_AAS_V51
        bool "This camera is aas_v51 project"
        depends on VENDER_MCD_V2
        default n
        help
          This camera is aas_v51 project.
```

## drivers/media/radio/s610/Kconfig
```kconfig
#
# SAMSUNG's S610 FM driver based on SPEEDY driver.
#
menu "Samsung S610 FM driver (SPEEDY based)"
config RADIO_S610
	tristate "Samsung S610 FM Radio"
	depends on VIDEO_V4L2 && RADIO_S5E9610
	help
	Choose Y here if you have this FM radio chip.

endmenu
```

## drivers/misc/gnss_if/Kconfig
```kconfig
config GNSS_SHMEM_IF
	bool "Samsung Shared memory Interface for GNSS"
	depends on MCU_IPC
	default n
	---help---
	  Samsung Shared Memory Interface for GNSS.
```

## drivers/misc/samsung/Kconfig
```kconfig
source "drivers/misc/samsung/gpio_debug/Kconfig"
source "drivers/misc/samsung/scsc/Kconfig"
source "drivers/misc/samsung/scsc_bt/Kconfig"
source "drivers/misc/samsung/kic/Kconfig"
```

## drivers/misc/samsung/kic/Kconfig
```kconfig
config SAMSUNG_KIC
	tristate "Kernel Information and Control (KIC) interface for Samsung Wi-Fi and Bluetooth chips"

if SAMSUNG_KIC != n

config SLSI_KIC_API_ENABLED
	bool "Enable the KIC kernel API"
	depends on SAMSUNG_KIC
endif
```

## drivers/misc/samsung/scsc/Kconfig
```kconfig
config SCSC_CORE_CM
	tristate "Samsung SCSC Maxwell driver Core Module"
	depends on SCSC_CORE

config SCSC_CORE
	tristate "Samsung SCSC Maxwell driver"
	select SCSC_CORE_CM

config SCSC_WLBT_CONFIG_PLATFORM
	string "SCSC WLBT PLATFORM"
	default ""
	---help---
	  Select the platform, e.g. lassen_smdk

config SCSC_CORE_FW_LOCATION
	string "SCSC FW location"
	default "/vendor/etc/wifi"
	---help---
	  Select the FW location, when CONFIG_SCSC_CORE_FW_LOCATION_AUTO=n

config SCSC_CORE_TOOL_LOCATION
	string "SCSC tool location"
	default "/vendor/bin"
	---help---
	  Select the moredump tool location, when CONFIG_SCSC_CORE_FW_LOCATION_AUTO=n

config SCSC_PCIE
	tristate "Samsung SCSC MIF PCIE implementation"
	depends on SCSC_CORE
	depends on PCI

config SCSC_MXLOGGER
	tristate "Samsung SCSC MXLOGGER"
	depends on SCSC_CORE
	default y
	---help---
	   MXLOGGER provides FW level logging in DRAM

config SCSC_SMAPPER
	bool "Samsung SCSC WLAN Smapper support"
	default y
	depends on SCSC_CORE
	---help---
	   SMAPPER provides direct access to Linux SKBs

config SCSC_WLBTD
	bool "Samsung SCSC Daemon support for Android O"
	depends on SCSC_CORE
	default n
	---help---
	   Uses generic netlink messages to communicate events to userspace daemon which takes necessary actions e.g. taking moredump

config SCSC_WRITE_INFO_FILE_WLBTD
	bool "SCSC flag to decide whether to write file via wlbtd or not"
	depends on SCSC_WLBTD
	default n

config SCSC_QOS
	bool "Samsung SCSC kernel PM QoS support"
	default y
	depends on SCSC_CORE
	---help---
	   SCSC_QOS provides support to configure kernel PM QoS to register configuration as per performance expectations

config SCSC_PLATFORM
	tristate "Samsung SCSC MIF Platform driver implementation"
	depends on SCSC_CORE

config SCSC_CM_MX_CLIENT_TEST
	tristate "Samsung SCSC Test Client"
	depends on SCSC_CORE

config SCSC_MX_ALWAYS_ON
	tristate "Samsung SCSC MX140 always booted"
	depends on SCSC_CM_MX_CLIENT_TEST

config SCSC_CLK20MHZ
	tristate "Samsung SCSC USB 20MHz Clock"
	depends on SCSC_CORE

config SCSC_CLK20MHZ_TEST
	tristate "Samsung SCSC USB 20MHz Clock Test"
	depends on SCSC_CLK20MHZ

config SCSC_FM
	tristate "Samsung SCSC MX250 enables LDOs used for FM"
	depends on SCSC_CORE

config SCSC_FM_TEST
	tristate "Samsung SCSC MX250 Test for enabling LDOs used for FM"
	depends on SCSC_FM

config SCSC_MMAP
	tristate "Samsung SCSC MMAP/GDB User space interface"
	depends on SCSC_CORE

config SCSC_DBG_SAMPLER
	tristate "Samsung SCSC Debug Sampler Service"
	depends on SCSC_CORE

config SCSC_DEBUG
	tristate "Samsung SCSC Logging"
	depends on SCSC_CORE && DEBUG_FS
	default n

config SCSC_DEBUG_COMPATIBILITY
	bool "Samsung SCSC Logging mode"
	default y

config SCSC_LOGRING
	tristate "Samsung SCSC Kernel Logging"
	default y
       ---help---
         SCSC Drivers logging mechanism

config SCSC_STATIC_RING
	tristate "Samsung SCSC Logging use static ring"
	depends on SCSC_LOGRING
	default y

config SCSC_STATIC_RING_SIZE
	int "Size of the static ring"
	depends on SCSC_STATIC_RING
	default "1048576"
	range 1024 16777216

config SCSC_CHV_SUPPORT
	bool "Samsung CHV f/w support"
	depends on SCSC_CORE
	default n

config SCSC_GPR4_CON_DEBUG
	bool "GPR4 PIO muxes switching to the Maxwell Subsystem"
	depends on SCSC_PLATFORM
	default n

config SCSC_BUILD_TYPE
       string "Type of Kernel Build"
       ---help---
         Type of Kernel Build: User, User Debug, Engineering

config SCSC_LOGRING_DEBUGFS
        bool "Samsung SCSC Logring DebugFS"
        depends on SCSC_LOGRING && DEBUG_FS
        default y

config SCSC_LOG_COLLECTION
	tristate "Samsung SCSC Log Collection"
	depends on SCSC_CORE
	default y
	---help---
	  Enable LOG collection to collect Chunks (host and FW) and generate a SBL file

config SCSC_COMMON_HCF
	bool "Enable Common HCF loader"
	depends on SCSC_CORE
	default y
	---help---
	  Enable Common HCF loader

config SCSC_WLBT_AUTORECOVERY_PERMANENT_DISABLE
	bool "Permanently disable WLBT autorecovery, ignroring module parameter"
	depends on SCSC_CORE
	default n
	---help---
	  Override module parameter, and disable recovery

config SCSC_MX450_GDB_SUPPORT
	bool "Enable GDB Channels for MX450"
	depends on SCSC_CORE
	default n
	---help---
	  Enable GDB Channels for MX450

config SCSC_WLAN_FAST_RECOVERY
        bool "Enable fast recovery"
        default n
        ---help---
        This option tells if fast recovery is enabled or not.

config SCSC_LAST_PANIC_IN_DRAM
        bool "Enable last panic in DRAM"
        default n
        ---help---
        This option tells if WLBTd will copy the last Sable/panic
	in DRAM

config SCSC_WLBT_CFG_REQ_WQ
	bool "Enable processing CFG REQ by Workqueue"
	depends on SCSC_CORE
	default n
	---help---
	Enable processing CFG REQ by Workqueue

config SCSC_MEMLOG
	tristate "Enable WLBT logging with memlog API"
	depends on SCSC_CORE
	depends on SOC_S5E9815
	---help---
	  Enable memlog feature. So mxlogger doesn't allocated in reserved memory, dynamically by memlog API.
```

## drivers/misc/samsung/scsc_bt/Kconfig
```kconfig
config SCSC_BT
        tristate "SCSC MX BT support"
        depends on SCSC_CORE

config SCSC_BT_BLUEZ
	default N
        tristate "SCSC MX BlueZ support"
        depends on SCSC_CORE

config SCSC_ANT
	default Y
        tristate "SCSC MX ANT support"
        depends on SCSC_CORE
	---help---
	  This module adds support for using a ANT character device.

config SCSC_BT_ADDRESS_IN_FILE
	default N
	tristate "SCSC MX BT support"
	depends on SCSC_CORE
	---help---
	  Allow BT address to be read from a file

config SCSC_BT_ADDRESS_FILENAME
	string "BT address filename"
	depends on SCSC_CORE
	default "/mnt/vendor/efs/bluetooth/bt_addr"
	---help---
	  Select the named BT address override file.
```

## drivers/motor/Kconfig
```kconfig
#
#
#
config ANDROID_TIMED_OUTPUT
	bool "Timed output class driver"
	default y

config ISA1000
	tristate "IMAGIS ISA1000"
	default n
	depends on ANDROID_TIMED_OUTPUT
	help
		If you say yes here you will get support for the
		haptic driver of IMAGIS ISA1000.

config SEC_VIB
	tristate "SEC DC Vibrator"
	default n
	help
		If you say yes here you will get support for the
		SEC DC Vibrator.

config STEP_MOTOR_STSPIN220
	tristate "STSPIN220"
	default n
	help
          Say Y to enable STSPIN220 support
	  You will get supprot for that.

	  If unsure, say N.

config BOOST_POWER_SHARE
	bool "Boost Power Share"
	default n
	help
	  Say Y to enable Boost Power(5V) share.
```
